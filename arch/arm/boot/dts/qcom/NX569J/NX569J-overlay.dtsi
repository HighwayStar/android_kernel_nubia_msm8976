#include "NX569J-msm8976.dtsi"
#include "NX569J-msm8976-pinctrl.dtsi"
#include "msm8976-mtp-usb-typec.dtsi"
#include "NX569J-msm8976-mtp.dtsi"
#include "NX569J-msm8976-mdss.dtsi"
#include "NX569J-msm8976-mdss-panels.dtsi"
#include "NX569J-msm8976-mdss-mtp.dtsi"
#include "NX569J-msm-pm8950.dtsi"
#include "NX569J-msm-pmi8950.dtsi"
#include "NX569J-msm8976-regulator.dtsi"
#include "NX569J-msm8976-camera-sensor-mtp.dtsi"