#include "nubia-boe-otm1906c-1080p-5p2-video.dtsi"
#include "nubia-boe-otm1906c-1080p-5p2-cmd.dtsi"
#include "nubia-jdi-s6d1fa4x01-1080p-5p2-video.dtsi"
#include "nubia-jdi-s6d1fa4x01-1080p-5p2-cmd.dtsi"
#include "nubia-ofilm-otm1906c-1080p-5p2-video.dtsi"
#include "nubia-ofilm-otm1906c-1080p-5p2-cmd.dtsi"
#include "nubia-jdi-nt35695-1080p-5p2-cmd.dtsi"