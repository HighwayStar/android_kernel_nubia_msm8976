/*
 * Copyright (c) 2015, The Linux Foundation. All rights reserved.
 *
 * This program is free software; you can redistribute it and/or modify
 * it under the terms of the GNU General Public License version 2 and
 * only version 2 as published by the Free Software Foundation.
 *
 * This program is distributed in the hope that it will be useful,
 * but WITHOUT ANY WARRANTY; without even the implied warranty of
 * MERCHANTABILITY or FITNESS FOR A PARTICULAR PURPOSE.  See the
 * GNU General Public License for more details.
 */

/*---------------------------------------------------------------------------
 * This file is autogenerated file using gcdb parser. Please do not edit it.
 * Update input XML file to add a new entry or update variable in this file
 * VERSION = "1.0"
 *---------------------------------------------------------------------------*/
&mdss_mdp {
	dsi_jdi_s6d1fa4x01_1080p_5p2_video: qcom,mdss_dsi_jdi_s6d1fa4x01_1080p_5p2_video {
		qcom,mdss-dsi-panel-name = "jdi s6d1fa4x01 1080p 5p2 video dsi panel";
		qcom,mdss-dsi-panel-controller = <&mdss_dsi0>;
		qcom,mdss-dsi-panel-type = "dsi_video_mode";
		qcom,mdss-dsi-panel-destination = "display_1";
		qcom,mdss-dsi-panel-framerate = <60>;
		qcom,mdss-dsi-virtual-channel-id = <0>;
		qcom,mdss-dsi-stream = <0>;
		qcom,mdss-dsi-panel-width = <1080>;
		qcom,mdss-dsi-panel-height = <1920>;
		qcom,mdss-dsi-h-front-porch = <45>;
		qcom,mdss-dsi-h-back-porch = <45>;
		qcom,mdss-dsi-h-pulse-width = <8>;
		qcom,mdss-dsi-h-sync-skew = <0>;
		qcom,mdss-dsi-v-back-porch = <16>;
		qcom,mdss-dsi-v-front-porch = <16>;
		qcom,mdss-dsi-v-pulse-width = <4>;
		qcom,mdss-dsi-h-left-border = <0>;
		qcom,mdss-dsi-h-right-border = <0>;
		qcom,mdss-dsi-v-top-border = <0>;
		qcom,mdss-dsi-v-bottom-border = <0>;
		qcom,mdss-dsi-bpp = <24>;
		qcom,mdss-dsi-color-order = "rgb_swap_rgb";
		qcom,mdss-dsi-underflow-color = <0xff>;
		qcom,mdss-dsi-border-color = <0>;
		qcom,mdss-dsi-on-command = [
			39 01 00 00 00 00 02 00 00
			39 01 00 00 00 00 04 FF 19 06 01
			39 01 00 00 00 00 02 00 80
			39 01 00 00 00 00 03 FF 19 06
			39 01 00 00 00 00 02 00 A0
			39 01 00 00 00 00 04 C1 00 C0 10
			39 01 00 00 00 00 02 00 91
			39 01 00 00 00 00 03 C5 14 28
			39 01 00 00 00 00 02 00 95
			39 01 00 00 00 00 02 C5 11
			39 01 00 00 00 00 02 00 00
			39 01 00 00 00 00 02 D9 00
			39 01 00 00 00 00 02 00 01
			39 01 00 00 00 00 02 D9 A0
			39 01 00 00 00 00 02 00 80
			39 01 00 00 00 00 03 C1 55 55
			39 01 00 00 00 00 02 00 94
			39 01 00 00 00 00 02 C5 67
			39 01 00 00 00 00 02 00 A4
			39 01 00 00 00 00 02 C5 67
			39 01 00 00 00 00 02 00 B0
			39 01 00 00 00 00 04 C5 00 00 01
			39 01 00 00 00 00 02 00 C1
			39 01 00 00 00 00 02 C5 B5
			39 01 00 00 00 00 02 00 B3
			39 01 00 00 00 00 02 C0 88
			39 01 00 00 00 00 02 00 B4
			39 01 00 00 00 00 02 C0 00
			39 01 00 00 00 00 02 00 00
			39 01 00 00 00 00 03 D8 23 23
			39 01 00 00 00 00 02 00 80
			39 01 00 00 00 00 02 C4 81
			39 01 00 00 00 00 02 00 A0
			39 01 00 00 00 00 02 B3 33
			39 01 00 00 00 00 02 00 A6
			39 01 00 00 00 00 02 B3 20
			39 01 00 00 00 00 02 00 E0
			39 01 00 00 00 00 0B B4 1C 19 3F 01 64 5C 01 A0 5F A0
			39 01 00 00 00 00 02 00 F0
			39 01 00 00 00 00 02 B4 64
			39 01 00 00 00 00 02 00 80
			39 01 00 00 00 00 0F C0 00 71 00 0A 0A 00 71 0A 0A 00 71 00 0A 0A
			39 01 00 00 00 00 02 00 90
			39 01 00 00 00 00 07 C0 00 00 00 02 00 04
			39 01 00 00 00 00 02 00 A0
			39 01 00 00 00 00 10 C0 00 00 02 00 04 14 04 33 00 33 00 33 00 33 00
			39 01 00 00 00 00 02 00 D0
			39 01 00 00 00 00 10 C0 00 00 02 00 04 14 04 33 00 33 00 33 00 33 00
			39 01 00 00 00 00 02 00 80
			39 01 00 00 00 00 0D C2 83 01 00 00 82 01 00 00 00 00 00 00
			39 01 00 00 00 00 02 00 90
			39 01 00 00 00 00 0D C2 00 00 00 00 00 00 00 00 00 00 00 00
			39 01 00 00 00 00 02 00 A0
			39 01 00 00 00 00 0E C2 00 00 00 00 00 00 00 00 00 00 00 00 00
			39 01 00 00 00 00 02 00 B0
			39 01 00 00 00 00 10 C2 82 13 00 00 88 81 13 00 00 88 00 13 00 00 88
			39 01 00 00 00 00 02 00 C0
			39 01 00 00 00 00 10 C2 01 13 00 00 88 00 00 00 00 00 00 00 00 00 00
			39 01 00 00 00 00 02 00 D0
			39 01 00 00 00 00 10 C2 00 00 00 00 00 00 00 00 00 00 33 33 33 33 00
			39 01 00 00 00 00 02 00 80
			39 01 00 00 00 00 10 C3 00 00 00 00 00 00 00 00 00 00 00 00 00 00 00
			39 01 00 00 00 00 02 00 A0
			39 01 00 00 00 00 0D C3 83 01 00 00 82 01 00 00 00 00 00 00
			39 01 00 00 00 00 02 00 B0
			39 01 00 00 00 00 0F C3 00 00 00 00 82 02 00 00 88 81 02 00 00 88
			39 01 00 00 00 00 02 00 C0
			39 01 00 00 00 00 10 C3 00 02 00 00 88 01 02 00 00 88 00 00 00 00 00
			39 01 00 00 00 00 02 00 D0
			39 01 00 00 00 00 10 C3 00 00 00 00 00 00 00 00 00 00 00 00 00 00 00
			39 01 00 00 00 00 02 00 E0
			39 01 00 00 00 00 06 C3 33 33 33 33 00
			39 01 00 00 00 00 02 00 80
			39 01 00 00 00 00 0C CB 00 00 00 00 30 00 03 00 00 00 70
			39 01 00 00 00 00 02 00 90
			39 01 00 00 00 00 10 CB 00 00 00 00 00 00 00 00 00 00 00 00 00 00 00
			39 01 00 00 00 00 02 00 A0
			39 01 00 00 00 00 10 CB 00 00 00 BF 00 00 00 00 00 FF 00 00 00 00 00
			39 01 00 00 00 00 02 00 B0
			39 01 00 00 00 00 0D CB 00 00 00 00 00 00 00 00 00 00 77 77
			39 01 00 00 00 00 02 00 C0
			39 01 00 00 00 00 10 CB 01 01 01 01 01 01 01 01 01 01 01 01 01 01 01
			39 01 00 00 00 00 02 00 D0
			39 01 00 00 00 00 10 CB 01 01 01 F3 01 01 01 01 00 F3 00 00 01 00 01
			39 01 00 00 00 00 02 00 E0
			39 01 00 00 00 00 0D CB 00 01 00 01 00 01 00 01 00 00 77 07
			39 01 00 00 00 00 02 00 F0
			39 01 00 00 00 00 0C CB 00 00 FF FF FF FF 03 22 02 00 70
			39 01 00 00 00 00 02 00 80
			39 01 00 00 00 00 0D CC 08 09 18 19 0C 0D 0E 0F 07 07 07 07
			39 01 00 00 00 00 02 00 90
			39 01 00 00 00 00 0D CC 09 08 19 18 0F 0E 0D 0C 07 07 07 07
			39 01 00 00 00 00 02 00 A0
			39 01 00 00 00 00 10 CC 14 15 16 17 1C 1D 1E 1F 01 04 20 07 07 07 00
			39 01 00 00 00 00 02 00 B0
			39 01 00 00 00 00 09 CC 01 02 03 04 05 06 07 07
			39 01 00 00 00 00 02 00 C0
			39 01 00 00 00 00 10 CC 00 00 00 00 00 00 00 00 00 00 00 00 00 00 00
			39 01 00 00 00 00 02 00 D0
			39 01 00 00 00 00 10 CC 00 00 00 00 00 00 00 00 00 00 00 00 00 00 00
			39 01 00 00 00 00 02 00 E0
			39 01 00 00 00 00 10 CC 00 00 00 00 00 00 00 00 00 00 00 00 00 00 00
			39 01 00 00 00 00 02 00 80
			39 01 00 00 00 00 10 CD 1A 01 11 12 1A 05 18 07 1A 1A 23 23 23 1F 1E
			39 01 00 00 00 00 02 00 90
			39 01 00 00 00 00 04 CD 1D 23 23
			39 01 00 00 00 00 02 00 A0
			39 01 00 00 00 00 10 CD 1A 02 11 12 1A 06 18 08 1A 1A 23 23 23 1F 1E
			39 01 00 00 00 00 02 00 B0
			39 01 00 00 00 00 04 CD 1D 23 23
			39 01 00 00 00 00 02 00 80
			39 01 00 00 00 00 0B A4 AF 00 20 04 00 17 15 03 60 00
			39 01 00 00 00 00 02 00 90
			39 01 00 00 00 00 04 A4 00 00 00
			39 01 00 00 00 00 02 00 80
			39 01 00 00 00 00 0D A7 FF 0F 1E 00 1F 00 01 98 00 00 00 00
			39 01 00 00 00 00 02 00 90
			39 01 00 00 00 00 0B A7 1C 1F 3B 00 00 BE 80 BE 05 F0
			39 01 00 00 00 00 02 00 A0
			39 01 00 00 00 00 02 A7 30
			39 01 00 00 00 00 02 00 B0
			39 01 00 00 00 00 06 A7 39 20 10 00 00
			39 01 00 00 00 00 02 00 C0
			39 01 00 00 00 00 0D A7 FF 0F 1E 00 1F 00 01 18 00 00 00 00
			39 01 00 00 00 00 02 00 D0
			39 01 00 00 00 00 0B A7 FF FF 1C 00 01 7C 81 7C 0B E0
			39 01 00 00 00 00 02 00 E0
			39 01 00 00 00 00 02 A7 30
			39 01 00 00 00 00 02 00 F0
			39 01 00 00 00 00 06 A7 1C 3E 3D 00 00
			39 01 00 00 00 00 02 00 80
			39 01 00 00 00 00 0D A9 00 00 00 00 00 00 00 00 00 00 00 00
			39 01 00 00 00 00 02 00 90
			39 01 00 00 00 00 0B A9 00 00 00 00 00 00 00 00 00 00
			39 01 00 00 00 00 02 00 A0
			39 01 00 00 00 00 02 A9 00
			39 01 00 00 00 00 02 00 B0
			39 01 00 00 00 00 06 A9 00 00 00 00 00
			39 01 00 00 00 00 02 00 C0
			39 01 00 00 00 00 0F A9 FF 3A 49 00 1E 00 01 00 00 00 00 00 00 77
			39 01 00 00 00 00 02 00 D0
			39 01 00 00 00 00 0B A9 FF FF 1D 00 01 7C 81 7C 0B E0
			39 01 00 00 00 00 02 00 E0
			39 01 00 00 00 00 02 A9 30
			39 01 00 00 00 00 02 00 F0
			39 01 00 00 00 00 06 A9 00 3C 3C 00 00
			39 01 00 00 00 00 02 00 B0
			39 01 00 00 00 00 09 A4 05 F0 0B E0 00 00 0B E0
			39 01 00 00 00 00 02 00 80
			39 01 00 00 00 00 10 AB 05 14 00 00 50 6A 00 00 00 00 00 00 00 00 00
			39 01 00 00 00 00 02 00 A0
			39 01 00 00 00 00 10 AB 00 00 00 00 00 00 00 07 00 00 00 00 01 00 00
			39 01 00 00 00 00 02 00 B0
			39 01 00 00 00 00 0D AB 00 00 68 0A 00 00 44 04 00 00 00 00
			39 01 00 00 00 00 02 00 93
			39 01 00 00 00 00 02 B3 01
			39 01 00 00 00 00 02 00 80
			39 01 00 00 00 00 08 CE 00 00 00 00 00 00 00
			39 01 00 00 00 00 02 00 87
			39 01 00 00 00 00 08 CE 00 00 33 00 33 00 00
			39 01 00 00 00 00 02 00 F0
			39 01 00 00 00 00 05 CE 00 00 00 00
			39 01 00 00 00 00 02 00 90
			39 01 00 00 00 00 10 CE 00 00 00 F0 00 00 00 00 FC 00 FC 00 00 00 00
			39 01 00 00 00 00 02 00 A0
			39 01 00 00 00 00 08 CE 00 00 40 40 40 00 00
			39 01 00 00 00 00 02 00 B0
			39 01 00 00 00 00 10 CE 01 01 01 01 01 01 01 01 F1 01 F1 01 01 01 01
			39 01 00 00 00 00 02 00 C0
			39 01 00 00 00 00 08 CE 01 01 01 01 01 01 01
			39 01 00 00 00 00 02 00 D0
			39 01 00 00 00 00 10 CE 04 04 04 04 04 04 04 04 F7 04 F7 04 04 00 00
			39 01 00 00 00 00 02 00 E0
			39 01 00 00 00 00 08 CE 00 00 15 15 15 04 04
			39 01 00 00 00 00 02 00 F4
			39 01 00 00 00 00 02 CE 25
			39 01 00 00 00 00 02 00 00
			39 01 00 00 00 00 02 FB 01
			39 01 00 00 00 00 02 00 80
			39 01 00 00 00 00 03 FF 00 00
			39 01 00 00 00 00 02 00 00
			39 01 00 00 00 00 04 FF 00 00 00
#if 0
			39 01 00 00 00 00 02 00 00
			39 01 00 00 00 00 02 D0 E1
			39 01 00 00 00 00 02 00 00
			39 01 00 00 00 00 02 EB 01
			39 01 00 00 00 00 02 00 00
			39 01 00 00 00 00 02 EB 03
			39 01 00 00 00 00 02 00 82
			39 01 00 00 00 00 02 F6 5A
			39 01 00 00 00 00 02 00 00
			39 01 00 00 00 00 04 EB 03 5A A5
			39 01 00 00 00 00 02 00 00
			39 01 00 00 00 00 04 EB 00 00 00
			39 01 00 00 00 00 02 00 00
			39 01 00 00 00 00 19 E1 00 07 0D 17 20 28 34 47 53 64 6E 73 88 83 7C 6C 58 44 37 2E 25 18 08 00
			39 01 00 00 00 00 02 00 00
			39 01 00 00 00 00 19 E2 00 07 0D 17 20 28 34 47 53 64 6E 73 88 83 7C 6C 58 44 37 2E 25 18 08 00
			39 01 00 00 00 00 02 00 00
			39 01 00 00 00 00 19 E3 00 07 0D 17 20 28 34 47 53 64 6E 73 88 83 7C 6C 58 44 37 2E 25 18 08 00
			39 01 00 00 00 00 02 00 00
			39 01 00 00 00 00 19 E4 00 07 0D 17 20 28 34 47 53 64 6E 73 88 83 7C 6C 58 44 37 2E 25 18 08 00
			39 01 00 00 00 00 02 00 00
			39 01 00 00 00 00 19 E5 00 07 0D 17 20 28 34 47 53 64 6E 73 88 83 7C 6C 58 44 37 2E 25 18 08 00
			39 01 00 00 00 00 02 00 00
			39 01 00 00 00 00 19 E6 00 07 0D 17 20 28 34 47 53 64 6E 73 88 83 7C 6C 58 44 37 2E 25 18 08 00
			39 01 00 00 00 00 02 00 F0
			39 01 00 00 00 00 0C CB FF FF FF FF FF FF 03 33 03 00 70
			39 01 00 00 00 00 02 00 82
			39 01 00 00 00 00 02 A5 31
			39 01 00 00 00 00 02 00 81
			39 01 00 00 00 00 02 F5 16
			39 01 00 00 00 00 02 00 83
			39 01 00 00 00 00 02 F5 16
			39 01 00 00 00 00 02 00 8D
			39 01 00 00 00 00 02 F5 17
			39 01 00 00 00 00 02 00 9D
			39 01 00 00 00 00 02 F5 1A
			39 01 00 00 00 00 02 00 A5
			39 01 00 00 00 00 02 F5 16
			39 01 00 00 00 00 02 00 A7
			39 01 00 00 00 00 02 F5 1A
			39 01 00 00 00 00 02 00 E1
			39 01 00 00 00 00 02 F5 16
			39 01 00 00 00 00 02 00 E3
			39 01 00 00 00 00 02 F5 11
			39 01 00 00 00 00 02 00 E5
			39 01 00 00 00 00 02 F5 16
			39 01 00 00 00 00 02 00 ED
			39 01 00 00 00 00 02 F5 16
#endif
			39 01 00 00 00 00 02 35 00
			39 01 00 00 78 00 02 11 00
			//39 01 00 00 00 00 02 2C 00
			39 01 00 00 00 00 02 29 00
			39 01 00 00 00 00 02 2C 00];
		qcom,mdss-dsi-off-command = [05 01 00 00 00 00 02 28 00
					05 01 00 00 78 00 02 10 00];
		qcom,mdss-dsi-on-command-state = "dsi_lp_mode";
		qcom,mdss-dsi-off-command-state = "dsi_hs_mode";
		qcom,mdss-dsi-h-sync-pulse = <0>;
		qcom,mdss-dsi-traffic-mode = "burst_mode";
		qcom,mdss-dsi-lane-map = "lane_map_0123";
		qcom,mdss-dsi-bllp-eof-power-mode;
		qcom,mdss-dsi-bllp-power-mode;
		qcom,mdss-dsi-lp11-init;
		qcom,mdss-dsi-init-delay-us = <5>;
		qcom,mdss-dsi-lane-0-state;
		qcom,mdss-dsi-lane-1-state;
		qcom,mdss-dsi-lane-2-state;
		qcom,mdss-dsi-lane-3-state;
		qcom,mdss-dsi-te-pin-select = <1>;
		qcom,mdss-dsi-wr-mem-start = <0x2c>;
		qcom,mdss-dsi-te-dcs-command = <1>;
		qcom,mdss-dsi-te-check-enable;
		qcom,mdss-dsi-te-using-te-pin;
		qcom,mdss-dsi-panel-timings = [6E 3F 36 00 5A 4F 38 41 54 03 04 00];
		qcom,mdss-dsi-panel-timings-8996 = [23 1e 08 09 05 03 04 a0
			23 1e 08 09 05 03 04 a0
			23 1e 08 09 05 03 04 a0
			23 1e 08 09 05 03 04 a0
			23 1a 08 09 05 03 04 a0];
		qcom,mdss-dsi-t-clk-post = <0x1E>;
		qcom,mdss-dsi-t-clk-pre = <0x30>;
		qcom,mdss-dsi-dma-trigger = "trigger_sw";
		qcom,mdss-dsi-mdp-trigger = "none";
		qcom,mdss-dsi-bl-pmic-control-type = "bl_ctrl_wled";
		qcom,mdss-dsi-bl-min-level = <1>;
		qcom,mdss-dsi-bl-max-level = <4095>;
		qcom,mdss-dsi-reset-sequence = <1 1>, <0 1>, <1 5>;
	};
};
