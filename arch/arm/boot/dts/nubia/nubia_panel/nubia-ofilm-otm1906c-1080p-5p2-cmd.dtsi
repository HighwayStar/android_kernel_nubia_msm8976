/*
 * Copyright (c) 2015, The Linux Foundation. All rights reserved.
 *
 * This program is free software; you can redistribute it and/or modify
 * it under the terms of the GNU General Public License version 2 and
 * only version 2 as published by the Free Software Foundation.
 *
 * This program is distributed in the hope that it will be useful,
 * but WITHOUT ANY WARRANTY; without even the implied warranty of
 * MERCHANTABILITY or FITNESS FOR A PARTICULAR PURPOSE.  See the
 * GNU General Public License for more details.
 */

/*---------------------------------------------------------------------------
 * This file is autogenerated file using gcdb parser. Please do not edit it.
 * Update input XML file to add a new entry or update variable in this file
 * VERSION = "1.0"
 *---------------------------------------------------------------------------*/
&mdss_mdp {
	dsi_ofilm_otm1906c_1080p_5p2_cmd: qcom,mdss_dsi_ofilm_otm1906c_1080p_5p2_cmd {
		qcom,mdss-dsi-panel-name = "ofilm otm1906c 1080p 5p2 cmd dsi panel";
		qcom,mdss-dsi-panel-controller = <&mdss_dsi0>;
		qcom,mdss-dsi-panel-type = "dsi_cmd_mode";
		qcom,mdss-dsi-panel-destination = "display_1";
		qcom,mdss-dsi-panel-framerate = <60>;
		qcom,mdss-dsi-virtual-channel-id = <0>;
		qcom,mdss-dsi-stream = <0>;
		qcom,mdss-dsi-panel-width = <1080>;
		qcom,mdss-dsi-panel-height = <1920>;
		qcom,mdss-dsi-h-front-porch = <44>;
		qcom,mdss-dsi-h-back-porch = <44>;
		qcom,mdss-dsi-h-pulse-width = <8>;
		qcom,mdss-dsi-h-sync-skew = <0>;
		qcom,mdss-dsi-v-back-porch = <48>;
		qcom,mdss-dsi-v-front-porch = <48>;
		qcom,mdss-dsi-v-pulse-width = <4>;
		qcom,mdss-dsi-h-left-border = <0>;
		qcom,mdss-dsi-h-right-border = <0>;
		qcom,mdss-dsi-v-top-border = <0>;
		qcom,mdss-dsi-v-bottom-border = <0>;
		qcom,mdss-dsi-bpp = <24>;
		qcom,mdss-dsi-color-order = "rgb_swap_rgb";
		qcom,mdss-dsi-underflow-color = <0xff>;
		qcom,mdss-dsi-border-color = <0>;

#if NUBIA_LCD_ESD_CHECK
		qcom,esd-check-enabled;
		qcom,mdss-dsi-panel-status-command = [06 01 00 01 05 00 01 0A];
		qcom,mdss-dsi-panel-status-command-mode = "dsi_hs_mode";
		qcom,mdss-dsi-panel-status-check-mode = "reg_read";
		qcom,mdss-dsi-panel-status-read-length = <1>;
		qcom,mdss-dsi-panel-status-value = <0x94>;
		qcom,mdss-dsi-panel-max-error-count = <3>;
#endif
		qcom,mdss-dsi-on-command = [ 
			39 01 00 00 00 00 02 00 00
			39 01 00 00 00 00 04 ff 19 06 01
			39 01 00 00 00 00 02 00 80
			39 01 00 00 00 00 03 ff 19 06
			//color enhance
			39 01 00 00 00 00 02 00 a0
			39 01 00 00 00 00 0d d6 0a 00 0a 00 00 00 00 00 0a 00 00 00
			39 01 00 00 00 00 02 00 b0
			39 01 00 00 00 00 0d d6 80 80 5a b3 b3 b3 b3 b3 b3 b3 b3 b3
			39 01 00 00 00 00 02 00 c0
			39 01 00 00 00 00 0d d6 3c 33 77 77 77 77 77 77 77 77 77 77
			39 01 00 00 00 00 02 00 d0
			39 01 00 00 00 00 0d d6 3c 3c 3c 3c 3c 3c 3c 3c 3c 3c 3c 3c
			39 01 00 00 00 00 02 00 82
			39 01 00 00 00 00 02 d6 02
			//ce end
			
			//cabc start
			39 01 00 00 00 00 02 00 90
			39 01 00 00 00 00 0a ca cc ff cc ff cc ff 00 00 00
			39 01 00 00 00 00 02 00 00
			39 01 00 00 00 00 02 c6 10
			39 01 00 00 00 00 02 00 00
			39 01 00 00 00 00 13 c7 b0 ba bb bc ba bb bb bb bb bb bb 88 67 45 23 22 11 11
			39 01 00 00 00 00 02 00 00
			39 01 00 00 00 00 02 c6 11
			39 01 00 00 00 00 02 00 00
			39 01 00 00 00 00 13 c7 b0 ba ba ab bb ba bb ba ab bb ba 88 78 45 23 22 22 22
			39 01 00 00 00 00 02 00 00
			39 01 00 00 00 00 02 c6 12
			39 01 00 00 00 00 02 00 00
			39 01 00 00 00 00 13 c7 a0 ba ba aa ab ba ab ba ba aa bb 88 78 56 34 23 22 22
			39 01 00 00 00 00 02 00 00
			39 01 00 00 00 00 02 c6 13
			39 01 00 00 00 00 02 00 00
			39 01 00 00 00 00 13 c7 a0 aa aa ab aa aa ba b9 aa aa ab 88 88 56 34 33 33 33
			39 01 00 00 00 00 02 00 00
			39 01 00 00 00 00 02 c6 14
			39 01 00 00 00 00 02 00 00
			39 01 00 00 00 00 13 c7 a0 a9 aa aa aa b9 9a ba 9a aa aa 88 88 67 45 34 33 33
			39 01 00 00 00 00 02 00 00
			39 01 00 00 00 00 02 c6 15
			39 01 00 00 00 00 02 00 00
			39 01 00 00 00 00 13 c7 90 9a aa 9a aa a9 aa a9 9a aa a9 88 88 67 45 44 44 44
			39 01 00 00 00 00 02 00 00
			39 01 00 00 00 00 02 c6 16
			39 01 00 00 00 00 02 00 00
			39 01 00 00 00 00 13 c7 90 9a a9 9a 9a 9a a9 9a a9 a9 a9 88 88 78 56 44 44 44
			39 01 00 00 00 00 02 00 00
			39 01 00 00 00 00 02 c6 17
			39 01 00 00 00 00 02 00 00
			39 01 00 00 00 00 13 c7 90 99 9a 99 9a a9 99 9a a9 99 9a 88 88 78 56 55 55 44
			39 01 00 00 00 00 02 00 00
			39 01 00 00 00 00 02 c6 18
			39 01 00 00 00 00 02 00 00
			39 01 00 00 00 00 13 c7 90 99 99 99 9a 99 99 99 a9 99 99 88 88 88 57 55 55 55
			39 01 00 00 00 00 02 00 00
			39 01 00 00 00 00 02 c6 19
			39 01 00 00 00 00 02 00 00
			39 01 00 00 00 00 13 c7 80 a9 98 99 99 99 99 99 99 99 99 88 88 88 67 66 55 55
			39 01 00 00 00 00 02 00 00
			39 01 00 00 00 00 02 c6 1a
			39 01 00 00 00 00 02 00 00
			39 01 00 00 00 00 13 c7 80 99 99 98 89 99 99 89 99 89 8a 88 88 88 67 66 66 66
			39 01 00 00 00 00 02 00 00
			39 01 00 00 00 00 02 c6 1b
			39 01 00 00 00 00 02 00 00
			39 01 00 00 00 00 13 c7 80 89 99 98 89 89 99 98 98 99 98 88 88 88 78 67 66 66
			39 01 00 00 00 00 02 00 00
			39 01 00 00 00 00 02 c6 1c
			39 01 00 00 00 00 02 00 00
			39 01 00 00 00 00 13 c7 80 98 98 89 89 89 98 98 98 89 89 88 88 88 78 77 77 66
			39 01 00 00 00 00 02 00 00
			39 01 00 00 00 00 02 c6 1d
			39 01 00 00 00 00 02 00 00
			39 01 00 00 00 00 13 c7 80 88 89 98 98 88 89 89 98 88 89 88 88 88 88 77 77 77
			39 01 00 00 00 00 02 00 00
			39 01 00 00 00 00 02 c6 1e
			39 01 00 00 00 00 02 00 00
			39 01 00 00 00 00 13 c7 80 88 98 88 98 88 89 88 98 88 98 88 88 88 88 88 77 77
			39 01 00 00 00 00 02 00 00
			39 01 00 00 00 00 02 c6 1f
			39 01 00 00 00 00 02 00 00
			39 01 00 00 00 00 13 c7 80 88 88 88 88 89 88 88 88 98 88 88 88 88 88 88 88 78
			39 01 00 00 00 00 02 00 00
			39 01 00 00 00 00 02 c6 00
			//cabc end
			39 01 00 00 00 00 02 00 c0
			39 01 00 00 00 00 02 c0 11
			39 01 00 00 00 00 02 00 a8
			39 01 00 00 00 00 02 f5 10
			39 01 00 00 00 00 02 00 c1
			39 01 00 00 00 00 02 c5 b5
			39 01 00 00 00 00 02 00 e1
			39 01 00 00 00 00 02 f5 16
			39 01 00 00 00 00 02 00 80
			39 01 00 00 00 00 09 c5 00 00 c1 44 11 0f 0f 00
			39 01 00 00 00 00 02 00 90
			39 01 00 00 00 00 0b c5 44
			29 34 00 88 11 3c 33 44 40
			39 01 00 00 00 00 02 00 a0
			39 01 00 00 00 00 0b c5 44
			29 34 00 88 11 3c 33 44 40
			39 01 00 00 00 00 02 00 00
			39 01 00 00 00 00 03 d8 27 27 
			39 01 00 00 00 00 02 00 00
			39 01 00 00 00 00 09 d9 00 95 00 95 00 95 00 95
			39 01 00 00 00 00 02 00 90
			39 01 00 00 00 00 05 f5 00 00 00 00
			39 01 00 00 00 00 02 00 00
			39 01 00 00 00 00 19 e1 05 08 0b 12 17 1c 26 36 40 50 5c 67 8f 83 73 5c 45 2e 1d 12 0a 07 06 03
			39 01 00 00 00 00 02 00 00
			39 01 00 00 00 00 19 e2 05 08 0b 12 17 1c 26 36 40 50 5c 67 8f 83 73 5c 45 2e 1d 12 0a 07 06 03
			39 01 00 00 00 00 02 00 00
			39 01 00 00 00 00 19 e3 05 08 0b 12 17 1c 26 36 40 50 5c 67 8f 83 73 5c 45 2e 1d 12 0a 07 06 03
			39 01 00 00 00 00 02 00 00
			39 01 00 00 00 00 19 e4 05 08 0b 12 17 1c 26 36 40 50 5c 67 8f 83 73 5c 45 2e 1d 12 0a 07 06 03
			39 01 00 00 00 00 02 00 00
			39 01 00 00 00 00 19 e5 05 08 0b 12 17 1c 26 36 40 50 5c 67 8f 83 73 5c 45 2e 1d 12 0a 07 06 03
			39 01 00 00 00 00 02 00 00
			39 01 00 00 00 00 19 e6 05 08 0b 12 17 1c 26 36 40 50 5c 67 8f 83 73 5c 45 2e 1d 12 0a 07 06 03
			39 01 00 00 00 00 02 00 80
			39 01 00 00 00 00 02 a5 0c
			39 01 00 00 00 00 02 00 a0
			39 01 00 00 00 00 08 b3 33 04 38 07 80 00 20
			39 01 00 00 00 00 02 00 80
			//modify for blinker
			39 01 00 00 00 00 0f c0 00 71 00 04 06 00 71 04 06 00 71 00 04 06
			39 01 00 00 00 00 02 00 90
			39 01 00 00 00 00 07 c0 00 00 00 02 00 04
			39 01 00 00 00 00 02 00 a0
			39 01 00 00 00 00 10 c0 00 00 00 00 01 19 03 00 00 00 00 00 00 00 00
			39 01 00 00 00 00 02 00 d0
			39 01 00 00 00 00 10 c0 00 00 00 00 01 19 03 00 00 00 00 00 00 00 00
			39 01 00 00 00 00 02 00 80
			39 01 00 00 00 00 0d c2 84 00 05 8d 83 00 05 8d 00 00 00 00 
			39 01 00 00 00 00 02 00 90
			39 01 00 00 00 00 0d c2 00 00 00 00 00 00 00 00 00 00 00 00
			39 01 00 00 00 00 02 00 a0
			39 01 00 00 00 00 0e c2 00 00 00 00 00 00 00 00 00 00 00 00 00
			39 01 00 00 00 00 02 00 b0
			39 01 00 00 00 00 10 c2 00 04 00 05 8d 01 04 00 05 8d 02 04 00 05 8d
			39 01 00 00 00 00 02 00 c0
			39 01 00 00 00 00 10 c2 03 04 00 05 8d 04 04 00 05 8d 05 04 00 05 8d
			39 01 00 00 00 00 02 00 d0
			39 01 00 00 00 00 10 c2 06 04 00 05 8d 07 04 00 05 8d 77 77 77 77 00
			39 01 00 00 00 00 02 00 80
			39 01 00 00 00 00 10 c3 00 00 00 00 00 00 00 00 00 00 00 00 00 00 00
			39 01 00 00 00 00 02 00 a0
			39 01 00 00 00 00 0d c3 84 00 05 8d 83 00 05 8d 00 00 00 00
			39 01 00 00 00 00 02 00 b0
			39 01 00 00 00 00 0f c3 00 00 00 00 00 04 00 05 8d 01 04 00 05 8d
			39 01 00 00 00 00 02 00 c0
			39 01 00 00 00 00 10 c3 02 04 00 05 8d 03 04 00 05 8d 04 04 00 05 8d
			39 01 00 00 00 00 02 00 d0 39 01 00 00 00 00 10 c3 05 04 00 05 8d 06 04 00 05 8d 07 04 00 05 8d
			39 01 00 00 00 00 02 00 e0
			39 01 00 00 00 00 06 c3 77 77 77 77 00
			39 01 00 00 00 00 02 00 80
			39 01 00 00 00 00 0c cb 00 00 00 00 30 00 03 00 00 00 70
			39 01 00 00 00 00 02 00 90
			39 01 00 00 00 00 10 cb 00 00 00 00 00 00 00 00 00 00 00 00 00 00 00
			39 01 00 00 00 00 02 00 a0
			39 01 00 00 00 00 10 cb 00 3f 00 bf 00 00 00 00 3f ff 00 00 00 00 00
			39 01 00 00 00 00 02 00 b0
			39 01 00 00 00 00 0d cb 00 00 00 00 00 00 00 00 00 00 77 77
			39 01 00 00 00 00 02 00 c0
			39 01 00 00 00 00 10 cb 11 11 01 01 01 01 01 01 01 01 01 01 01 01 01
			39 01 00 00 00 00 02 00 d0
			39 01 00 00 00 00 10 cb 01 03 01 f3 01 01 01 01 c3 f3 f0 03 01 03 01
			39 01 00 00 00 00 02 00 e0
			39 01 00 00 00 00 0d cb 03 01 00 01 00 01 00 01 00 00 77 07
			39 01 00 00 00 00 02 00 f0
			39 01 00 00 00 00 0c cb ff ff ff ff ff 3f 0c 33 03 00 70
			39 01 00 00 00 00 02 00 80
			39 01 00 00 00 00 0d cc 08 09 18 19 0c 0d 0e 0f 10 11 12 13
			39 01 00 00 00 00 02 00 90
			39 01 00 00 00 00 0d cc 09 08 19 18 13 12 11 10 0f 0e 0d 0c
			39 01 00 00 00 00 02 00 a0
			39 01 00 00 00 00 10 cc 20 21 22 23 1c 1d 1e 1f 01 04 20 07 07 07 00
			39 01 00 00 00 00 02 00 b0
			39 01 00 00 00 00 0a cc 01 02 03 04 05 06 07 07 00
			39 01 00 00 00 00 02 00 80
			39 01 00 00 00 00 10 cd 0f 11 1a 01 0b 09 07 05 18 1a 24 1d 1e 1f 23
			39 01 00 00 00 00 02 00 90
			39 01 00 00 00 00 04 cd 24 24 24
			39 01 00 00 00 00 02 00 a0
			39 01 00 00 00 00 10 cd 0f 11 1a 02 0c 0a 08 06 18 1a 24 1d 1e 1f 23
			39 01 00 00 00 00 02 00 b0
			39 01 00 00 00 00 04 cd 24 24 24
			39 01 00 00 00 00 02 00 80
			39 01 00 00 00 00 0b a4 af 00 64 04 00 17 15 03 a1 07
			39 01 00 00 00 00 02 00 90
			39 01 00 00 00 00 04 a4 00 00 00
			39 01 00 00 00 00 02 00 80
			39 01 00 00 00 00 0d a7 ff 01 10 20 42 00 01 80 00 00 00 00
			39 01 00 00 00 00 02 00 90
			39 01 00 00 00 00 0b a7 3e 42 1c 20 00 b8 00 b8 06 60
			39 01 00 00 00 00 02 00 a0
			39 01 00 00 00 00 02 a7 30
			39 01 00 00 00 00 02 00 b0
			39 01 00 00 00 00 06 a7 3b 1c 1e 00 00
			39 01 00 00 00 00 02 00 c0
			39 01 00 00 00 00 0d a7 ff 01 10 20 23 00 01 00 00 00 00 00
			39 01 00 00 00 00 02 00 d0
			39 01 00 00 00 00 0b a7 1c 20 ff ff 01 35 01 6a 0b a4
			39 01 00 00 00 00 02 00 e0
			39 01 00 00 00 00 02 a7 30
			39 01 00 00 00 00 02 00 f0
			39 01 00 00 00 00 06 a7 1f 38 40 00 00
			39 01 00 00 00 00 02 00 80
			39 01 00 00 00 00 0d a9 00 00 00 00 00 00 00 00 00 00 00 00
			39 01 00 00 00 00 02 00 90
			39 01 00 00 00 00 0b a9 00 00 00 00 00 00 00 00 00 00
			39 01 00 00 00 00 02 00 a0
			39 01 00 00 00 00 02 a9 23
			39 01 00 00 00 00 02 00 b0
			39 01 00 00 00 00 06 a9 15 21 21 9c 00
			39 01 00 00 00 00 02 00 c0
			39 01 00 00 00 00 0f a9 ff 01 10 00 23 00 01 00 00 00 00 00 00 5a
			39 01 00 00 00 00 02 00 d0
			39 01 00 00 00 00 0b a9 1e 00 40 44 01 66 01 6a 0b a0
			39 01 00 00 00 00 02 00 e0
			39 01 00 00 00 00 02 a9 30
			39 01 00 00 00 00 02 00 f0
			39 01 00 00 00 00 06 a9 1f 38 40 00 00
			39 01 00 00 00 00 02 00 b0
			39 01 00 00 00 00 09 a4 05 93 0b a4 00 00 0b a0
			39 01 00 00 00 00 02 00 80
			39 01 00 00 00 00 10 ab 0a 13 00 00 bf ff 04 00 00 00 00 00 00 01 0f
			39 01 00 00 00 00 02 00 a0
			39 01 00 00 00 00 10 ab 00 00 00 00 00 00 00 05 00 00 00 00 01 00 00
			39 01 00 00 00 00 02 00 b0
			39 01 00 00 00 00 0d ab 00 00 10 02 00 00 44 04 00 00 00 00
			39 01 00 00 00 00 02 00 93
			39 01 00 00 00 00 02 b3 01
			39 01 00 00 00 00 02 00 80
			39 01 00 00 00 00 08 ce 00 00 00 00 00 00 00
			39 01 00 00 00 00 02 00 87
			39 01 00 00 00 00 08 ce ff ff ff 03 33 ff 03
			39 01 00 00 00 00 02 00 f0
			39 01 00 00 00 00 05 ce 00 00 00 00
			39 01 00 00 00 00 02 00 90
			39 01 00 00 00 00 10 ce 00 00 00 00 00 00 00 00 fc 00 fc 00 00 00 00
			39 01 00 00 00 00 02 00 a0
			39 01 00 00 00 00 08 ce 00 00 40 40 40 00 00
			39 01 00 00 00 00 02 00 b0
			39 01 00 00 00 00 10 ce 01 01 01 01 01 01 01 01 f1 01 f1 01 01 01 01
			39 01 00 00 00 00 02 00 c0
			39 01 00 00 00 00 08 ce 01 01 01 01 01 01 01
			39 01 00 00 00 00 02 00 d0
			39 01 00 00 00 00 10 ce 04 04 04 04 04 04 04 04 f7 04 f7 04 04 00 00
			39 01 00 00 00 00 02 00 e0
			39 01 00 00 00 00 08 ce 00 00 15 15 15 04 04
			39 01 00 00 00 00 02 00 f4
			39 01 00 00 00 00 02 ce 25
			39 01 00 00 00 00 02 00 c0
			39 01 00 00 00 00 10 cc 00 00 00 00 00 00 00 00 00 00 00 00 00 00 00
			39 01 00 00 00 00 02 00 d0
			39 01 00 00 00 00 10 cc 00 0c 00 00 00 00 00 00 00 00 00 00 00 00 00
			39 01 00 00 00 00 02 00 e0
			39 01 00 00 00 00 0d cc 00 00 00 00 00 00 00 00 00 00 00 00
			39 01 00 00 00 00 02 00 b3
			39 01 00 00 00 00 02 c0 88
			39 01 00 00 00 00 02 00 a0
			39 01 00 00 00 00 08 b3 33 04 38 07 80 00 20
			39 01 00 00 00 00 02 00 81
			39 01 00 00 00 00 02 a5 01
			39 01 00 00 00 00 02 00 80
			39 01 00 00 00 00 02 c4 81
			39 01 00 00 00 00 02 00 81
			39 01 00 00 00 00 02 f5 16
			39 01 00 00 00 00 02 00 83
			39 01 00 00 00 00 02 f5 16
			//for touch start
			39 01 00 00 00 00 02 00 a0
			39 01 00 00 00 00 02 a7 3f
			39 01 00 00 00 00 02 00 e0
			39 01 00 00 00 00 02 a7 3f
			39 01 00 00 00 00 02 00 89
			39 01 00 00 00 00 02 ab ff
			39 01 00 00 00 00 02 00 8a
			39 01 00 00 00 00 02 ab b8
			39 01 00 00 00 00 02 00 84
			39 01 00 00 00 00 02 ab 30
			//for touch end
			//for flinker
			39 01 00 00 00 00 02 00 e0
			39 01 00 00 00 00 02 b4 5c
			//for flinker
			//change with ABA0 resolved display gap
			39 01 00 00 00 00 02 00 90
			39 01 00 00 00 00 05 f5 09 16 09 16
			//end
			39 01 00 00 00 00 02 35 00 
			39 01 00 00 00 00 02 51 ff
			39 01 00 00 00 00 02 53 24
			39 01 00 00 78 00 02 11 00
			39 01 00 00 00 00 02 29 00
			39 01 00 00 00 00 02 2c 00
			//lock cmd1 for esd
			39 01 00 00 00 00 02 00 00
			39 01 00 00 00 00 03 99 00 00
		];
		qcom,mdss-dsi-off-command = [
    //unlock cmd1
       39 01 00 00 00 00 02 00 00
       39 01 00 00 00 00 03 99 95 27

       39 01 00 00 00 00 02 28 00
       39 01 00 00 78 00 02 10 00];
		qcom,mdss-dsi-on-command-state = "dsi_lp_mode";
		qcom,mdss-dsi-off-command-state = "dsi_hs_mode";

		//ce
		nubia,mdss-dsi-ce-command-off = [
       39 01 00 00 00 00 02 00 00
       39 01 00 00 00 00 03 99 95 27
       39 01 00 00 00 00 02 81 00
       39 01 00 00 00 00 02 00 00
       39 01 00 00 00 00 03 99 00 00
		];
		nubia,mdss-dsi-ce-command-soft = [
       39 01 00 00 00 00 02 00 00
       39 01 00 00 00 00 03 99 95 27
       39 01 00 00 00 00 02 81 00
       39 01 00 00 00 00 02 00 00
       39 01 00 00 00 00 03 99 00 00
		];
		nubia,mdss-dsi-ce-command-std = [
       39 01 00 00 00 00 02 00 00
       39 01 00 00 00 00 03 99 95 27
       39 01 00 00 00 00 02 81 80
       39 01 00 00 00 00 02 00 00
       39 01 00 00 00 00 03 99 00 00
		];
		nubia,mdss-dsi-ce-command-glow = [
       39 01 00 00 00 00 02 00 00
       39 01 00 00 00 00 03 99 95 27
       39 01 00 00 00 00 02 81 83
       39 01 00 00 00 00 02 00 00
       39 01 00 00 00 00 03 99 00 00
		];
		nubia,mdss-dsi-ce-command-state = "dsi_hs_mode";
		nubia,mdss-dsi-ce-cabc-command0 = [
		];
		nubia,mdss-dsi-ce-cabc-command1 = [
		];
		nubia,mdss-dsi-ce-cabc-command2 = [
		];

		//colortmp
		nubia,colortmp-adjustable-blue = <0x3f>;
		nubia,colortmp-adjustable-red = <0x3f>;

		//cabc
		nubia,mdss-dsi-cabc-low-bl = <0x640>;
		nubia,mdss-dsi-cabc-command-off = [
       39 01 00 00 00 00 02 00 00
       39 01 00 00 00 00 03 99 95 27
       39 01 00 00 00 00 02 55 00
       39 01 00 00 00 00 02 00 00
       39 01 00 00 00 00 03 99 00 00
		];
		nubia,mdss-dsi-cabc-command-level1 = [
       39 01 00 00 00 00 02 00 00
       39 01 00 00 00 00 03 99 95 27
       39 01 00 00 00 00 02 55 01
       39 01 00 00 00 00 02 00 00
       39 01 00 00 00 00 03 99 00 00
		];
		nubia,mdss-dsi-cabc-command-level2 = [
       39 01 00 00 00 00 02 00 00
       39 01 00 00 00 00 03 99 95 27
       39 01 00 00 00 00 02 55 02
       39 01 00 00 00 00 02 00 00
       39 01 00 00 00 00 03 99 00 00
		];
		nubia,mdss-dsi-cabc-command-level3 = [
       39 01 00 00 00 00 02 00 00
       39 01 00 00 00 00 03 99 95 27
       39 01 00 00 00 00 02 55 03
       39 01 00 00 00 00 02 00 00
       39 01 00 00 00 00 03 99 00 00
		];

		nubia,mdss-dsi-cabc-command-state = "dsi_hs_mode";
		nubia,mdss-dsi-ce-cabc-command-state = "dsi_lp_mode";

		//backlight
		nubia,mdss-dsi-panel-backlight-curve = [
			00 01 01 01 01 01 01 01 01 01
			01 01 01 01 01 01 01 01 01 01
			01 01 01 01 01 02 02 02 02 02
			02 02 03 03 03 03 03 04 04 04
			04 05 05 05 05 06 06 06 06 07
			07 07 08 08 08 09 09 09 0A 0A
			0B 0B 0B 0C 0C 0D 0D 0D 0E 0E
			0F 0F 10 10 11 11 12 12 13 13
			14 14 15 16 16 17 17 18 19 19
			1A 1A 1B 1C 1C 1D 1E 1E 1F 20
			21 21 22 23 23 24 25 26 27 27
			28 29 2A 2B 2B 2C 2D 2E 2F 30
			31 31 32 33 34 35 36 37 38 39
			3A 3B 3C 3D 3E 3F 40 41 42 43
			44 45 46 47 49 4A 4B 4C 4D 4E
			4F 51 52 53 54 55 57 58 59 5A
			5B 5D 5E 5F 61 62 63 64 66 67
			69 6A 6B 6D 6E 6F 71 72 74 75
			77 78 79 7B 7C 7E 7F 81 82 84
			85 87 89 8A 8C 8D 8F 91 92 94
			95 97 99 9A 9C 9E 9F A1 A3 A5
			A6 A8 AA AC AD AF B1 B3 B5 B6
			B8 BA BC BE C0 C2 C4 C5 C7 C9
			CB CD CF D1 D3 D5 D7 D9 DB DD
			DF E1 E3 E5 E7 EA EC EE F0 F2
			F4 F6 F8 FB FD FF];

		qcom,mdss-dsi-h-sync-pulse = <0>;
		qcom,mdss-dsi-traffic-mode = "burst_mode";
		qcom,mdss-dsi-lane-map = "lane_map_0123";
		qcom,mdss-dsi-bllp-eof-power-mode;
		qcom,mdss-dsi-bllp-power-mode;
		qcom,mdss-dsi-lp11-init;
		qcom,mdss-dsi-init-delay-us = <5>;
		qcom,mdss-dsi-lane-0-state;
		qcom,mdss-dsi-lane-1-state;
		qcom,mdss-dsi-lane-2-state;
		qcom,mdss-dsi-lane-3-state;
		qcom,mdss-dsi-te-pin-select = <1>;
		qcom,mdss-dsi-wr-mem-start = <0x2c>;
		qcom,mdss-dsi-te-dcs-command = <1>;
		qcom,mdss-dsi-te-check-enable;
		qcom,mdss-dsi-te-using-te-pin;
		qcom,mdss-dsi-panel-timings = [E2 36 24 00 66 68 28 38 2A 03 04 00];
		qcom,mdss-dsi-panel-timings-8996 = [
			23 1f 07 09 05 03 04 a0
			23 1f 07 09 05 03 04 a0
			23 1f 07 09 05 03 04 a0
			23 1f 07 09 05 03 04 a0
			23 19 07 08 05 03 04 a0];
		qcom,mdss-dsi-t-clk-post = <0x0d>;
		qcom,mdss-dsi-t-clk-pre = <0x2e>;
		qcom,mdss-dsi-dma-trigger = "trigger_sw";
		qcom,mdss-dsi-mdp-trigger = "none";
		qcom,mdss-dsi-bl-pmic-control-type = "bl_ctrl_wled";
		qcom,mdss-dsi-bl-min-level = <2>;
		qcom,mdss-dsi-bl-max-level = <4095>;
		qcom,mdss-brightness-max-level = <4095>;
		qcom,mdss-dsi-reset-sequence = <1 10>, <0 5>, <1 10>;
		qcom,mdss-pan-physical-width-dimension = <65>;
		qcom,mdss-pan-physical-height-dimension = <115>;
	};
};
