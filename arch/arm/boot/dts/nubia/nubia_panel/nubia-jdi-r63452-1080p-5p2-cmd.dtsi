/*
 * Copyright (c) 2015, The Linux Foundation. All rights reserved.
 *
 * This program is free software; you can redistribute it and/or modify
 * it under the terms of the GNU General Public License version 2 and
 * only version 2 as published by the Free Software Foundation.
 *
 * This program is distributed in the hope that it will be useful,
 * but WITHOUT ANY WARRANTY; without even the implied warranty of
 * MERCHANTABILITY or FITNESS FOR A PARTICULAR PURPOSE.  See the
 * GNU General Public License for more details.
 */

/*---------------------------------------------------------------------------
 * This file is autogenerated file using gcdb parser. Please do not edit it.
 * Update input XML file to add a new entry or update variable in this file
 * VERSION = "1.0"
 *---------------------------------------------------------------------------*/
&mdss_mdp {
	dsi_jdi_R63452_1080p_5p2_cmd: qcom,mdss_dsi_jdi_R63452_1080p_5p2_cmd {
		qcom,mdss-dsi-panel-name = "jdi R63452 1080p 5p2 cmd dsi panel";
		qcom,mdss-dsi-panel-controller = <&mdss_dsi0>;
		qcom,mdss-dsi-panel-type = "dsi_cmd_mode";
		qcom,mdss-dsi-panel-destination = "display_1";
		qcom,mdss-dsi-panel-framerate = <60>;
		qcom,mdss-dsi-virtual-channel-id = <0>;
		qcom,mdss-dsi-stream = <0>;
		qcom,mdss-dsi-panel-width = <1080>;
		qcom,mdss-dsi-panel-height = <1920>;
		qcom,mdss-dsi-h-front-porch = <96>;
		qcom,mdss-dsi-h-back-porch = <64>;
		qcom,mdss-dsi-h-pulse-width = <16>;
		qcom,mdss-dsi-h-sync-skew = <0>;
		qcom,mdss-dsi-v-back-porch = <16>;
		qcom,mdss-dsi-v-front-porch = <4>;
		qcom,mdss-dsi-v-pulse-width = <1>;
		qcom,mdss-dsi-h-left-border = <0>;
		qcom,mdss-dsi-h-right-border = <0>;
		qcom,mdss-dsi-v-top-border = <0>;
		qcom,mdss-dsi-v-bottom-border = <0>;
		qcom,mdss-dsi-bpp = <24>;
		qcom,mdss-dsi-color-order = "rgb_swap_rgb";
		qcom,mdss-dsi-underflow-color = <0xff>;
		qcom,mdss-dsi-border-color = <0>;
		qcom,mdss-dsi-on-command = [
			39 01 00 00 00 00 02 35 00
			39 01 00 00 00 00 02 36 00
			39 01 00 00 00 00 02 3A 77
			39 01 00 00 00 00 05 2A 00 00 04 37 //set column addres
			39 01 00 00 00 00 05 2B 00 00 07 7F //set page address
			39 01 00 00 00 00 03 44 07 76
			39 01 00 00 00 00 02 51 FF//write CABC
			39 01 00 00 00 00 02 53 24
			39 01 00 00 00 00 02 55 00
			39 01 00 00 80 00 02 11 00//Sleep out

			29 01 00 00 00 00 02 b0 04
			29 01 00 00 00 00 1a ce 55 40 49 53 59 5E 63 68 6E 74 7E 8A 98 A8 BB D0 FF 04 00 04 04 42 04 69 5A
			29 01 00 00 00 00 08 b8 57 3d 09 1e 00 00 00
			29 01 00 00 00 00 08 b9 6f 3d 14 3c 00 00 00
			29 01 00 00 00 00 08 ba b5 33 2a 64 00 00 00

			39 01 00 00 00 00 02 2C 00
			39 01 00 00 00 00 02 29 00
			39 01 00 00 00 00 14 C8 01 00 FC 01 06 B5 00 00 F8 03 FC DB 00 00 FA FE 03 FC 00
                ];

		qcom,mdss-dsi-off-command = [39 01 00 00 00 00 02 28 00
					39 01 00 00 78 00 02 10 00];

		nubia,mdss-dsi-ce-command-off = [
			39 01 00 00 00 00 02 B0 00
			39 01 00 00 00 00 02 D6 01
			39 01 00 00 00 00 2C CA 1D FC FC FC 00 F1 F1 EC 00 EC EF EF 00 E2 00 00 00 EC 00 00 00 E7 FF 9F 83 FF 9F 83 7D 00 00 00 00 00 00 00 00 00 00 00 00 00 00
			];
		nubia,mdss-dsi-ce-command-soft = [
			39 01 00 00 00 00 02 B0 00
			39 01 00 00 00 00 02 D6 01
			39 01 00 00 00 00 2C CA 00 FC FC FC 00 D1 D1 A8 00 A8 CE CE 00 9C 00 00 00 BA 00 00 00 9C FF 9F 83 FF 9F 83 7D 00 00 00 00 00 00 00 00 00 00 00 00 00 00
			];
		nubia,mdss-dsi-ce-command-std = [
			39 01 00 00 00 00 02 B0 00
			39 01 00 00 00 00 02 D6 01
			39 01 00 00 00 00 2C CA 1D FC FC FC 00 F1 F1 EC 00 EC EF EF 00 E2 00 00 00 EC 00 00 00 E7 FF 9F 83 FF 9F 83 7D 00 00 00 00 00 00 00 00 00 00 00 00 00 00//10
			];
		nubia,mdss-dsi-ce-command-glow = [
			39 01 00 00 00 00 02 B0 00
			39 01 00 00 00 00 02 D6 01
			39 01 00 00 00 00 2C CA 1D FC FC FC 00 D1 D1 A8 00 A8 CE CE 00 9C 00 00 00 BA 00 00 00 9C FF 9F 83 FF 9F 83 7D 00 00 00 00 00 00 00 00 00 00 00 00 00 00//30
			];

		nubia,mdss-dsi-cabc-command-off = [
			39 01 00 00 00 00 02 53 2c
			39 01 00 00 00 00 02 55 00
			];
		nubia,mdss-dsi-cabc-command-level1 = [
			39 01 00 00 00 00 02 53 2c
			39 01 00 00 00 00 02 55 81
			];
		nubia,mdss-dsi-cabc-command-level2 = [
			39 01 00 00 00 00 02 53 2c
			39 01 00 00 00 00 02 55 82
		];
		nubia,mdss-dsi-cabc-command-level3 = [
			39 01 00 00 00 00 02 53 2c
			39 01 00 00 00 00 02 55 83
		];

		qcom,mdss-dsi-on-command-state = "dsi_lp_mode";
		qcom,mdss-dsi-off-command-state = "dsi_hs_mode";
		nubia,mdss-dsi-ce-command-state = "dsi_lp_mode";
		nubia,mdss-dsi-cabc-command-state = "dsi_lp_mode";

		//backlight
/*
		nubia,mdss-dsi-panel-backlight-curve = [
			00 01 01 01 01 01 01 01 01 01
			01 01 01 01 01 01 01 01 01 01
			01 01 01 01 01 02 02 02 02 02
			02 02 03 03 03 03 03 04 04 04
			04 05 05 05 05 06 06 06 06 07
			07 07 08 08 08 09 09 09 0A 0A
			0B 0B 0B 0C 0C 0D 0D 0D 0E 0E
			0F 0F 10 10 11 11 12 12 13 13
			14 14 15 16 16 17 17 18 19 19
			1A 1A 1B 1C 1C 1D 1E 1E 1F 20
			21 21 22 23 23 24 25 26 27 27
			28 29 2A 2B 2B 2C 2D 2E 2F 30
			31 31 32 33 34 35 36 37 38 39
			3A 3B 3C 3D 3E 3F 40 41 42 43
			44 45 46 47 49 4A 4B 4C 4D 4E
			4F 51 52 53 54 55 57 58 59 5A
			5B 5D 5E 5F 61 62 63 64 66 67
			69 6A 6B 6D 6E 6F 71 72 74 75
			77 78 79 7B 7C 7E 7F 81 82 84
			85 87 89 8A 8C 8D 8F 91 92 94
			95 97 99 9A 9C 9E 9F A1 A3 A5
			A6 A8 AA AC AD AF B1 B3 B5 B6
			B8 BA BC BE C0 C2 C4 C5 C7 C9
			CB CD CF D1 D3 D5 D7 D9 DB DD
			DF E1 E3 E5 E7 EA EC EE F0 F2
			F4 F6 F8 FB FD FF];
*/
		nubia,mdss-dsi-panel-backlight-curve = <
		0 34 34 34 35 35 36 36
		37 37 38 38 39 39 40 40
		41 41 42 43 45 47 49 51
		53 55 57 59 61 63 66 69
		72 75 78 82 86 90 94 98
		101 104 107 110 113 117 121 125
		129 133 137 142 147 152 157 162
		167 172 177 182 187 193 199 205
		211 217 224 231 238 245 252 259
		266 273 280 287 294 301 308 316
		324 332 340 348 356 364 373 382
		391 400 409 418 427 436 445 455
		465 475 485 495 505 516 527 538
		549 560 571 582 593 604 615 626
		638 650 662 675 688 701 714 727
		740 753 766 779 792 805 818 831
		846 861 876 891 906 921 936 951
		966 981 996 1011 1027 1043 1059 1075
		1091 1109 1126 1143 1160 1177 1194 1210
		1229 1248 1267 1286 1305 1324 1343 1362
		1381 1400 1420 1440 1460 1480 1500 1520
		1541 1562 1583 1604 1625 1646 1668 1690
		1712 1734 1756 1778 1801 1824 1847 1870
		1894 1918 1942 1966 1990 2015 2040 2065
		2090 2115 2140 2166 2192 2218 2244 2270
		2297 2324 2351 2378 2405 2432 2459 2487
		2516 2545 2574 2603 2632 2661 2690 2720
		2750 2780 2810 2840 2871 2902 2933 2964
		2995 3026 3058 3090 3122 3154 3186 3218
		3252 3286 3320 3354 3388 3422 3456 3489
		3526 3563 3600 3637 3674 3711 3748 3786
		3829 3862 3900 3938 3976 4014 4052 4095
		>;

		qcom,mdss-dsi-h-sync-pulse = <0>;
		qcom,mdss-dsi-traffic-mode = "burst_mode";
		qcom,mdss-dsi-lane-map = "lane_map_0123";
		qcom,mdss-dsi-bllp-eof-power-mode;
		qcom,mdss-dsi-bllp-power-mode;
		qcom,mdss-dsi-lane-0-state;
		qcom,mdss-dsi-lane-1-state;
		qcom,mdss-dsi-lane-2-state;
		qcom,mdss-dsi-lane-3-state;
		qcom,mdss-dsi-lp11-init;
		qcom,mdss-dsi-te-pin-select = <1>;
		qcom,mdss-dsi-te-dcs-command = <1>;
		qcom,mdss-dsi-te-check-enable;
		qcom,mdss-dsi-te-using-te-pin;
		qcom,mdss-dsi-panel-timings = [E7 36 24 00 66 6A 2A 3A 2D 03 04 00];
		qcom,mdss-dsi-t-clk-post = <0x0d>;
		qcom,mdss-dsi-t-clk-pre = <0x30>;
		qcom,mdss-dsi-dma-trigger = "trigger_sw";
		qcom,mdss-dsi-mdp-trigger = "none";
		qcom,mdss-dsi-bl-pmic-control-type = "bl_ctrl_wled";
		qcom,mdss-dsi-bl-min-level = <35>;
		qcom,mdss-dsi-bl-max-level = <4095>;
		qcom,mdss-dsi-reset-sequence = <0 12>, <1 12>, <0 12>, <1 12>;
	};
};

