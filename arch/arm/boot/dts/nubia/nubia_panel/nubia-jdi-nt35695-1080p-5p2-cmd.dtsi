/* Copyright (c) 2013, The Linux Foundation. All rights reserved.
 *
 * This program is free software; you can redistribute it and/or modify
 * it under the terms of the GNU General Public License version 2 and
 * only version 2 as published by the Free Software Foundation.
 *
 * This program is distributed in the hope that it will be useful,
 * but WITHOUT ANY WARRANTY; without even the implied warranty of
 * MERCHANTABILITY or FITNESS FOR A PARTICULAR PURPOSE.  See the
 * GNU General Public License for more details.
 */

/*---------------------------------------------------------------------------
 * This file is autogenerated file using gcdb parser. Please do not edit it.
 * Update input XML file to add a new entry or update variable in this file
 * VERSION = "1.0"
 *---------------------------------------------------------------------------*/
&mdss_mdp {
	dsi_jdi_nt35695_1080p_5p2_cmd: qcom,mdss_dsi_jdi_nt35695_1080p_5p2_cmd {
		qcom,mdss-dsi-panel-name = "jdi nt35695 1080p 5p2 cmd dsi panel";
		qcom,mdss-dsi-panel-controller = <&mdss_dsi0>;
		qcom,mdss-dsi-panel-type = "dsi_cmd_mode";
		qcom,mdss-dsi-panel-destination = "display_1";
		qcom,mdss-dsi-panel-framerate = <60>;
		qcom,mdss-dsi-virtual-channel-id = <0>;
		qcom,mdss-dsi-stream = <0>;
		qcom,mdss-dsi-panel-width = <1080>;
		qcom,mdss-dsi-panel-height = <1920>;
		qcom,mdss-dsi-h-front-porch = <128>;
		qcom,mdss-dsi-h-back-porch = <24>;
		qcom,mdss-dsi-h-pulse-width = <4>;
		qcom,mdss-dsi-h-sync-skew = <0>;
		qcom,mdss-dsi-v-back-porch = <1>;
		qcom,mdss-dsi-v-front-porch = <18>;
		qcom,mdss-dsi-v-pulse-width = <2>;
		qcom,mdss-dsi-h-left-border = <0>;
		qcom,mdss-dsi-h-right-border = <0>;
		qcom,mdss-dsi-v-top-border = <0>;
		qcom,mdss-dsi-v-bottom-border = <0>;
		qcom,mdss-dsi-bpp = <24>;
		qcom,mdss-dsi-color-order = "rgb_swap_rgb";
		qcom,mdss-dsi-underflow-color = <0xff>;
		qcom,mdss-dsi-border-color = <0>;
		qcom,mdss-dsi-on-command = [
			39 01 00 00 00 00 02 ff 10
			39 01 00 00 00 00 02 35 00
			39 01 00 00 00 00 05 2a 00 00 04 37
			39 01 00 00 00 00 05 2b 00 00 07 7f
			39 01 00 00 78 00 02 11 00
			39 01 00 00 00 00 03 44 03 e4
			39 01 00 00 00 00 02 ff 20
			39 01 00 00 00 00 02 fb 01
			39 01 00 00 00 00 02 75 00
			39 01 00 00 00 00 02 76 17
			39 01 00 00 00 00 02 77 00
			39 01 00 00 00 00 02 78 2d
			39 01 00 00 00 00 02 79 00
			39 01 00 00 00 00 02 7a 51
			39 01 00 00 00 00 02 7b 00
			39 01 00 00 00 00 02 7c 72
			39 01 00 00 00 00 02 7d 00
			39 01 00 00 00 00 02 7e 8e
			39 01 00 00 00 00 02 7f 00
			39 01 00 00 00 00 02 80 a3
			39 01 00 00 00 00 02 81 00
			39 01 00 00 00 00 02 82 bb
			39 01 00 00 00 00 02 83 00
			39 01 00 00 00 00 02 84 cb
			39 01 00 00 00 00 02 85 00
			39 01 00 00 00 00 02 86 de
			39 01 00 00 00 00 02 87 01
			39 01 00 00 00 00 02 88 17
			39 01 00 00 00 00 02 89 01
			39 01 00 00 00 00 02 8a 43
			39 01 00 00 00 00 02 8b 01
			39 01 00 00 00 00 02 8c 8a
			39 01 00 00 00 00 02 8d 01
			39 01 00 00 00 00 02 8e be
			39 01 00 00 00 00 02 8f 02
			39 01 00 00 00 00 02 90 0d
			39 01 00 00 00 00 02 91 02
			39 01 00 00 00 00 02 92 4e
			39 01 00 00 00 00 02 93 02
			39 01 00 00 00 00 02 94 4f
			39 01 00 00 00 00 02 95 02
			39 01 00 00 00 00 02 96 8c
			39 01 00 00 00 00 02 97 02
			39 01 00 00 00 00 02 98 cc
			39 01 00 00 00 00 02 99 02
			39 01 00 00 00 00 02 9a f5
			39 01 00 00 00 00 02 9b 03
			39 01 00 00 00 00 02 9c 25
			39 01 00 00 00 00 02 9d 03
			39 01 00 00 00 00 02 9e 43
			39 01 00 00 00 00 02 9f 03
			39 01 00 00 00 00 02 a0 69
			39 01 00 00 00 00 02 a2 03
			39 01 00 00 00 00 02 a3 74
			39 01 00 00 00 00 02 a4 03
			39 01 00 00 00 00 02 a5 81
			39 01 00 00 00 00 02 a6 03
			39 01 00 00 00 00 02 a7 8e
			39 01 00 00 00 00 02 a9 03
			39 01 00 00 00 00 02 aa 9d
			39 01 00 00 00 00 02 ab 03
			39 01 00 00 00 00 02 ac ae
			39 01 00 00 00 00 02 ad 03
			39 01 00 00 00 00 02 ae be
			39 01 00 00 00 00 02 af 03
			39 01 00 00 00 00 02 b0 cd
			39 01 00 00 00 00 02 b1 03
			39 01 00 00 00 00 02 b2 ff
			39 01 00 00 00 00 02 b3 00
			39 01 00 00 00 00 02 b4 17
			39 01 00 00 00 00 02 b5 00
			39 01 00 00 00 00 02 b6 2d
			39 01 00 00 00 00 02 b7 00
			39 01 00 00 00 00 02 b8 51
			39 01 00 00 00 00 02 b9 00
			39 01 00 00 00 00 02 ba 72
			39 01 00 00 00 00 02 bb 00
			39 01 00 00 00 00 02 bc 8e
			39 01 00 00 00 00 02 bd 00
			39 01 00 00 00 00 02 be a3
			39 01 00 00 00 00 02 bf 00
			39 01 00 00 00 00 02 c0 bb
			39 01 00 00 00 00 02 c1 00
			39 01 00 00 00 00 02 c2 cb
			39 01 00 00 00 00 02 c3 00
			39 01 00 00 00 00 02 c4 de
			39 01 00 00 00 00 02 c5 01
			39 01 00 00 00 00 02 c6 17
			39 01 00 00 00 00 02 c7 01
			39 01 00 00 00 00 02 c8 43
			39 01 00 00 00 00 02 c9 01
			39 01 00 00 00 00 02 ca 8a
			39 01 00 00 00 00 02 cb 01
			39 01 00 00 00 00 02 cc be
			39 01 00 00 00 00 02 cd 02
			39 01 00 00 00 00 02 ce 0d
			39 01 00 00 00 00 02 cf 02
			39 01 00 00 00 00 02 d0 4e
			39 01 00 00 00 00 02 d1 02
			39 01 00 00 00 00 02 d2 4f
			39 01 00 00 00 00 02 d3 02
			39 01 00 00 00 00 02 d4 8c
			39 01 00 00 00 00 02 d5 02
			39 01 00 00 00 00 02 d6 cc
			39 01 00 00 00 00 02 d7 02
			39 01 00 00 00 00 02 d8 f5
			39 01 00 00 00 00 02 d9 03
			39 01 00 00 00 00 02 da 25
			39 01 00 00 00 00 02 db 03
			39 01 00 00 00 00 02 dc 43
			39 01 00 00 00 00 02 dd 03
			39 01 00 00 00 00 02 de 69
			39 01 00 00 00 00 02 df 03
			39 01 00 00 00 00 02 e0 74
			39 01 00 00 00 00 02 e1 03
			39 01 00 00 00 00 02 e2 81
			39 01 00 00 00 00 02 e3 03
			39 01 00 00 00 00 02 e4 8e
			39 01 00 00 00 00 02 e5 03
			39 01 00 00 00 00 02 e6 9d
			39 01 00 00 00 00 02 e7 03
			39 01 00 00 00 00 02 e8 ae
			39 01 00 00 00 00 02 e9 03
			39 01 00 00 00 00 02 ea be
			39 01 00 00 00 00 02 eb 03
			39 01 00 00 00 00 02 ec cd
			39 01 00 00 00 00 02 ed 03
			39 01 00 00 00 00 02 ee ff
			39 01 00 00 00 00 02 ef 00
			39 01 00 00 00 00 02 f0 00
			39 01 00 00 00 00 02 f1 00
			39 01 00 00 00 00 02 f2 1a
			39 01 00 00 00 00 02 f3 00
			39 01 00 00 00 00 02 f4 44
			39 01 00 00 00 00 02 f5 00
			39 01 00 00 00 00 02 f6 66
			39 01 00 00 00 00 02 f7 00
			39 01 00 00 00 00 02 f8 83
			39 01 00 00 00 00 02 f9 00
			39 01 00 00 00 00 02 fa 9d
			39 01 00 00 00 00 02 ff 21
			39 01 00 00 00 00 02 fb 01
			39 01 00 00 00 00 02 00 00
			39 01 00 00 00 00 02 01 b3
			39 01 00 00 00 00 02 02 00
			39 01 00 00 00 00 02 03 c8
			39 01 00 00 00 00 02 04 00
			39 01 00 00 00 00 02 05 da
			39 01 00 00 00 00 02 06 01
			39 01 00 00 00 00 02 07 16
			39 01 00 00 00 00 02 08 01
			39 01 00 00 00 00 02 09 44
			39 01 00 00 00 00 02 0a 01
			39 01 00 00 00 00 02 0b 89
			39 01 00 00 00 00 02 0c 01
			39 01 00 00 00 00 02 0d bd
			39 01 00 00 00 00 02 0e 02
			39 01 00 00 00 00 02 0f 0d
			39 01 00 00 00 00 02 10 02
			39 01 00 00 00 00 02 11 4c
			39 01 00 00 00 00 02 12 02
			39 01 00 00 00 00 02 13 4e
			39 01 00 00 00 00 02 14 02
			39 01 00 00 00 00 02 15 8a
			39 01 00 00 00 00 02 16 02
			39 01 00 00 00 00 02 17 ca
			39 01 00 00 00 00 02 18 02
			39 01 00 00 00 00 02 19 f3
			39 01 00 00 00 00 02 1a 03
			39 01 00 00 00 00 02 1b 23
			39 01 00 00 00 00 02 1c 03
			39 01 00 00 00 00 02 1d 42
			39 01 00 00 00 00 02 1e 03
			39 01 00 00 00 00 02 1f 67
			39 01 00 00 00 00 02 20 03
			39 01 00 00 00 00 02 21 73
			39 01 00 00 00 00 02 22 03
			39 01 00 00 00 00 02 23 7f
			39 01 00 00 00 00 02 24 03
			39 01 00 00 00 00 02 25 8d
			39 01 00 00 00 00 02 26 03
			39 01 00 00 00 00 02 27 9d
			39 01 00 00 00 00 02 28 03
			39 01 00 00 00 00 02 29 af
			39 01 00 00 00 00 02 2a 03
			39 01 00 00 00 00 02 2b c2
			39 01 00 00 00 00 02 2d 03
			39 01 00 00 00 00 02 2f d1
			39 01 00 00 00 00 02 30 03
			39 01 00 00 00 00 02 31 ff
			39 01 00 00 00 00 02 32 00
			39 01 00 00 00 00 02 33 00
			39 01 00 00 00 00 02 34 00
			39 01 00 00 00 00 02 35 1a
			39 01 00 00 00 00 02 36 00
			39 01 00 00 00 00 02 37 44
			39 01 00 00 00 00 02 38 00
			39 01 00 00 00 00 02 39 66
			39 01 00 00 00 00 02 3a 00
			39 01 00 00 00 00 02 3b 83
			39 01 00 00 00 00 02 3d 00
			39 01 00 00 00 00 02 3f 9d
			39 01 00 00 00 00 02 40 00
			39 01 00 00 00 00 02 41 b3
			39 01 00 00 00 00 02 42 00
			39 01 00 00 00 00 02 43 c8
			39 01 00 00 00 00 02 44 00
			39 01 00 00 00 00 02 45 da
			39 01 00 00 00 00 02 46 01
			39 01 00 00 00 00 02 47 16
			39 01 00 00 00 00 02 48 01
			39 01 00 00 00 00 02 49 44
			39 01 00 00 00 00 02 4a 01
			39 01 00 00 00 00 02 4b 89
			39 01 00 00 00 00 02 4c 01
			39 01 00 00 00 00 02 4d bd
			39 01 00 00 00 00 02 4e 02
			39 01 00 00 00 00 02 4f 0d
			39 01 00 00 00 00 02 50 02
			39 01 00 00 00 00 02 51 4c
			39 01 00 00 00 00 02 52 02
			39 01 00 00 00 00 02 53 4e
			39 01 00 00 00 00 02 54 02
			39 01 00 00 00 00 02 55 8a
			39 01 00 00 00 00 02 56 02
			39 01 00 00 00 00 02 58 ca
			39 01 00 00 00 00 02 59 02
			39 01 00 00 00 00 02 5a f3
			39 01 00 00 00 00 02 5b 03
			39 01 00 00 00 00 02 5c 23
			39 01 00 00 00 00 02 5d 03
			39 01 00 00 00 00 02 5e 42
			39 01 00 00 00 00 02 5f 03
			39 01 00 00 00 00 02 60 67
			39 01 00 00 00 00 02 61 03
			39 01 00 00 00 00 02 62 73
			39 01 00 00 00 00 02 63 03
			39 01 00 00 00 00 02 64 7f
			39 01 00 00 00 00 02 65 03
			39 01 00 00 00 00 02 66 8d
			39 01 00 00 00 00 02 67 03
			39 01 00 00 00 00 02 68 9d
			39 01 00 00 00 00 02 69 03
			39 01 00 00 00 00 02 6a af
			39 01 00 00 00 00 02 6b 03
			39 01 00 00 00 00 02 6c c2
			39 01 00 00 00 00 02 6d 03
			39 01 00 00 00 00 02 6e d1
			39 01 00 00 00 00 02 6f 03
			39 01 00 00 00 00 02 70 ff
			39 01 00 00 00 00 02 71 00
			39 01 00 00 00 00 02 72 00
			39 01 00 00 00 00 02 73 00
			39 01 00 00 00 00 02 74 1a
			39 01 00 00 00 00 02 75 00
			39 01 00 00 00 00 02 76 4a
			39 01 00 00 00 00 02 77 00
			39 01 00 00 00 00 02 78 6d
			39 01 00 00 00 00 02 79 00
			39 01 00 00 00 00 02 7a 8c
			39 01 00 00 00 00 02 7b 00
			39 01 00 00 00 00 02 7c a8
			39 01 00 00 00 00 02 7d 00
			39 01 00 00 00 00 02 7e bf
			39 01 00 00 00 00 02 7f 00
			39 01 00 00 00 00 02 80 d5
			39 01 00 00 00 00 02 81 00
			39 01 00 00 00 00 02 82 e7
			39 01 00 00 00 00 02 83 01
			39 01 00 00 00 00 02 84 23
			39 01 00 00 00 00 02 85 01
			39 01 00 00 00 00 02 86 51
			39 01 00 00 00 00 02 87 01
			39 01 00 00 00 00 02 88 94
			39 01 00 00 00 00 02 89 01
			39 01 00 00 00 00 02 8a c7
			39 01 00 00 00 00 02 8b 02
			39 01 00 00 00 00 02 8c 15
			39 01 00 00 00 00 02 8d 02
			39 01 00 00 00 00 02 8e 53
			39 01 00 00 00 00 02 8f 02
			39 01 00 00 00 00 02 90 55
			39 01 00 00 00 00 02 91 02
			39 01 00 00 00 00 02 92 90
			39 01 00 00 00 00 02 93 02
			39 01 00 00 00 00 02 94 cf
			39 01 00 00 00 00 02 95 02
			39 01 00 00 00 00 02 96 f8
			39 01 00 00 00 00 02 97 03
			39 01 00 00 00 00 02 98 29
			39 01 00 00 00 00 02 99 03
			39 01 00 00 00 00 02 9a 47
			39 01 00 00 00 00 02 9b 03
			39 01 00 00 00 00 02 9c 6f
			39 01 00 00 00 00 02 9d 03
			39 01 00 00 00 00 02 9e 77
			39 01 00 00 00 00 02 9f 03
			39 01 00 00 00 00 02 a0 83
			39 01 00 00 00 00 02 a2 03
			39 01 00 00 00 00 02 a3 91
			39 01 00 00 00 00 02 a4 03
			39 01 00 00 00 00 02 a5 a3
			39 01 00 00 00 00 02 a6 03
			39 01 00 00 00 00 02 a7 b5
			39 01 00 00 00 00 02 a9 03
			39 01 00 00 00 00 02 aa c5
			39 01 00 00 00 00 02 ab 03
			39 01 00 00 00 00 02 ac de
			39 01 00 00 00 00 02 ad 03
			39 01 00 00 00 00 02 ae ff
			39 01 00 00 00 00 02 af 00
			39 01 00 00 00 00 02 b0 00
			39 01 00 00 00 00 02 b1 00
			39 01 00 00 00 00 02 b2 1a
			39 01 00 00 00 00 02 b3 00
			39 01 00 00 00 00 02 b4 4a
			39 01 00 00 00 00 02 b5 00
			39 01 00 00 00 00 02 b6 6d
			39 01 00 00 00 00 02 b7 00
			39 01 00 00 00 00 02 b8 8c
			39 01 00 00 00 00 02 b9 00
			39 01 00 00 00 00 02 ba a8
			39 01 00 00 00 00 02 bb 00
			39 01 00 00 00 00 02 bc bf
			39 01 00 00 00 00 02 bd 00
			39 01 00 00 00 00 02 be d5
			39 01 00 00 00 00 02 bf 00
			39 01 00 00 00 00 02 c0 e7
			39 01 00 00 00 00 02 c1 01
			39 01 00 00 00 00 02 c2 23
			39 01 00 00 00 00 02 c3 01
			39 01 00 00 00 00 02 c4 51
			39 01 00 00 00 00 02 c5 01
			39 01 00 00 00 00 02 c6 94
			39 01 00 00 00 00 02 c7 01
			39 01 00 00 00 00 02 c8 c7
			39 01 00 00 00 00 02 c9 02
			39 01 00 00 00 00 02 ca 15
			39 01 00 00 00 00 02 cb 02
			39 01 00 00 00 00 02 cc 53
			39 01 00 00 00 00 02 cd 02
			39 01 00 00 00 00 02 ce 55
			39 01 00 00 00 00 02 cf 02
			39 01 00 00 00 00 02 d0 90
			39 01 00 00 00 00 02 d1 02
			39 01 00 00 00 00 02 d2 cf
			39 01 00 00 00 00 02 d3 02
			39 01 00 00 00 00 02 d4 f8
			39 01 00 00 00 00 02 d5 03
			39 01 00 00 00 00 02 d6 29
			39 01 00 00 00 00 02 d7 03
			39 01 00 00 00 00 02 d8 47
			39 01 00 00 00 00 02 d9 03
			39 01 00 00 00 00 02 da 6f
			39 01 00 00 00 00 02 db 03
			39 01 00 00 00 00 02 dc 77
			39 01 00 00 00 00 02 dd 03
			39 01 00 00 00 00 02 de 83
			39 01 00 00 00 00 02 df 03
			39 01 00 00 00 00 02 e0 91
			39 01 00 00 00 00 02 e1 03
			39 01 00 00 00 00 02 e2 a3
			39 01 00 00 00 00 02 e3 03
			39 01 00 00 00 00 02 e4 b5
			39 01 00 00 00 00 02 e5 03
			39 01 00 00 00 00 02 e6 c5
			39 01 00 00 00 00 02 e7 03
			39 01 00 00 00 00 02 e8 de
			39 01 00 00 00 00 02 e9 03
			39 01 00 00 00 00 02 ea ff
			39 01 00 00 00 00 02 ff 10
			39 01 00 00 00 00 02 ff 23
			39 01 00 00 00 00 02 fb 01
			39 01 00 00 00 00 02 01 84
			39 01 00 00 00 00 02 02 00
			39 01 00 00 00 00 02 03 04
			39 01 00 00 00 00 02 05 36
			39 01 00 00 00 00 02 06 4d
			39 01 00 00 00 00 02 07 20
			39 01 00 00 00 00 02 08 15
			39 01 00 00 00 00 02 46 00
			39 01 00 00 00 00 02 13 ff
			39 01 00 00 00 00 02 14 f6
			39 01 00 00 00 00 02 15 ed
			39 01 00 00 00 00 02 16 e6
			39 01 00 00 00 00 02 17 ff
			39 01 00 00 00 00 02 18 f8
			39 01 00 00 00 00 02 19 f0
			39 01 00 00 00 00 02 1a ea
			39 01 00 00 00 00 02 1b e5
			39 01 00 00 00 00 02 1c df
			39 01 00 00 00 00 02 1d da
			39 01 00 00 00 00 02 1e d5
			39 01 00 00 00 00 02 1f d0
			39 01 00 00 00 00 02 20 cc
			39 01 00 00 00 00 02 21 ff
			39 01 00 00 00 00 02 22 f2
			39 01 00 00 00 00 02 23 e5
			39 01 00 00 00 00 02 24 d8
			39 01 00 00 00 00 02 25 cb
			39 01 00 00 00 00 02 26 bf
			39 01 00 00 00 00 02 27 bb
			39 01 00 00 00 00 02 28 ba
			39 01 00 00 00 00 02 29 b8
			39 01 00 00 00 00 02 2a b4
			39 01 00 00 00 00 02 ff 22
			39 01 00 00 00 00 02 fb 01
			39 01 00 00 00 00 02 00 04
			39 01 00 00 00 00 02 01 06
			39 01 00 00 00 00 02 02 08
			39 01 00 00 00 00 02 03 0c
			39 01 00 00 00 00 02 04 10
			39 01 00 00 00 00 02 05 16
			39 01 00 00 00 00 02 06 18
			39 01 00 00 00 00 02 07 1d
			39 01 00 00 00 00 02 08 20
			39 01 00 00 00 00 02 09 24
			39 01 00 00 00 00 02 0a 28
			39 01 00 00 00 00 02 0b 2e
			39 01 00 00 00 00 02 0c 36
			39 01 00 00 00 00 02 0d 3c
			39 01 00 00 00 00 02 0e 40
			39 01 00 00 00 00 02 0f 44
			39 01 00 00 00 00 02 10 46
			39 01 00 00 00 00 02 11 48
			39 01 00 00 00 00 02 12 4a
			39 01 00 00 00 00 02 13 4c
			39 01 00 00 00 00 02 1b 04
			39 01 00 00 00 00 02 1c 06
			39 01 00 00 00 00 02 1d 08
			39 01 00 00 00 00 02 1e 0c
			39 01 00 00 00 00 02 1f 10
			39 01 00 00 00 00 02 20 14
			39 01 00 00 00 00 02 21 18
			39 01 00 00 00 00 02 22 1d
			39 01 00 00 00 00 02 23 24
			39 01 00 00 00 00 02 24 26
			39 01 00 00 00 00 02 25 28
			39 01 00 00 00 00 02 26 2c
			39 01 00 00 00 00 02 27 30
			39 01 00 00 00 00 02 28 35
			39 01 00 00 00 00 02 29 3a
			39 01 00 00 00 00 02 2a 3c
			39 01 00 00 00 00 02 2b 37
			39 01 00 00 00 00 02 2f 2d
			39 01 00 00 00 00 02 30 23
			39 01 00 00 00 00 02 31 19
			39 01 00 00 00 00 02 32 8b
			39 01 00 00 00 00 02 33 8b
			39 01 00 00 00 00 02 34 8b
			39 01 00 00 00 00 02 35 89
			39 01 00 00 00 00 02 36 87
			39 01 00 00 00 00 02 37 85
			39 01 00 00 00 00 02 38 87
			39 01 00 00 00 00 02 39 89
			39 01 00 00 00 00 02 3a 8b
			39 01 00 00 00 00 02 3b 8f
			39 01 00 00 00 00 02 3f 11
			39 01 00 00 00 00 02 40 11
			39 01 00 00 00 00 02 41 11
			39 01 00 00 00 00 02 42 11
			39 01 00 00 00 00 02 43 11
			39 01 00 00 00 00 02 44 11
			39 01 00 00 00 00 02 45 11
			39 01 00 00 00 00 02 46 11
			39 01 00 00 00 00 02 47 8f
			39 01 00 00 00 00 02 48 8b
			39 01 00 00 00 00 02 49 89
			39 01 00 00 00 00 02 4a 89
			39 01 00 00 00 00 02 4b 8b
			39 01 00 00 00 00 02 4c 8b
			39 01 00 00 00 00 02 1a 00
			39 01 00 00 00 00 02 4d 08
			39 01 00 00 00 00 02 4e 1e
			39 01 00 00 00 00 02 4f 2a
			39 01 00 00 00 00 02 53 77
			39 01 00 00 00 00 02 54 77
			39 01 00 00 00 00 02 55 00
			39 01 00 00 00 00 02 56 00
			39 01 00 00 00 00 02 68 00
			39 01 00 00 00 00 02 a2 20
			39 01 00 00 00 00 02 ff 10
			39 01 00 00 00 00 02 51 ff
			39 01 00 00 00 00 02 53 24
			39 01 00 00 00 00 02 55 00
			39 01 00 00 00 00 02 2c 00
			29 01 00 00 00 00 02 ff 10
			39 01 00 00 00 00 02 35 00
			39 01 00 00 00 00 02 29 00
		];

		qcom,mdss-dsi-off-command = [
			39 01 00 00 00 00 02 FF 10
			39 01 00 00 14 00 02 28 10
			39 01 00 00 78 00 02 10 00];

		qcom,mdss-dsi-on-command-state = "dsi_lp_mode";
		qcom,mdss-dsi-off-command-state = "dsi_hs_mode";

		//ce
		nubia,mdss-dsi-ce-command-off = [];
		nubia,mdss-dsi-ce-command-soft = [];
		nubia,mdss-dsi-ce-command-std = [];
		nubia,mdss-dsi-ce-command-glow = [];
		nubia,mdss-dsi-ce-command-state = "dsi_hs_mode";

		//colortmp
		nubia,colortmp-adjustable-blue = <0x3f>;
		nubia,colortmp-adjustable-red = <0x3f>;

		//cabc
		nubia,mdss-dsi-cabc-command-off = [

		];
		nubia,mdss-dsi-cabc-command-level1 = [
		];
		nubia,mdss-dsi-cabc-command-level2 = [
		];
		nubia,mdss-dsi-cabc-command-level3 = [
		];

        //ce:cabc
		nubia,mdss-dsi-cabc-low-bl = <0x640>;
		nubia,mdss-dsi-ce-cabc-command0 = [
			39 01 00 00 00 00 02 FF 23
			39 01 00 00 00 00 02 FB 01
			39 01 00 00 00 00 02 01 84
			39 01 00 00 00 00 02 02 00
			39 01 00 00 00 00 02 03 04
			39 01 00 00 00 00 02 05 21
			39 01 00 00 00 00 02 06 00

			39 01 00 00 00 00 02 FF 10
			39 01 00 00 00 00 02 55 00];
		nubia,mdss-dsi-ce-cabc-command1 = [
			39 01 00 00 00 00 02 FF 23
			39 01 00 00 00 00 02 FB 01
			39 01 00 00 00 00 02 01 84
			39 01 00 00 00 00 02 02 00
			39 01 00 00 00 00 02 03 04
			39 01 00 00 00 00 02 05 36
			39 01 00 00 00 00 02 06 4D

			39 01 00 00 00 00 02 FF 10
			39 01 00 00 00 00 02 55 01];
		nubia,mdss-dsi-ce-cabc-command2 = [
			39 01 00 00 00 00 02 FF 23
			39 01 00 00 00 00 02 FB 01
			39 01 00 00 00 00 02 01 84
			39 01 00 00 00 00 02 02 00
			39 01 00 00 00 00 02 03 04
			39 01 00 00 00 00 02 05 36
			39 01 00 00 00 00 02 06 4D

			39 01 00 00 00 00 02 FF 10
			39 01 00 00 00 00 02 55 02];
		nubia,mdss-dsi-ce-cabc-command3 = [
			39 01 00 00 00 00 02 FF 23
			39 01 00 00 00 00 02 FB 01
			39 01 00 00 00 00 02 01 84
			39 01 00 00 00 00 02 02 00
			39 01 00 00 00 00 02 03 04
			39 01 00 00 00 00 02 05 36
			39 01 00 00 00 00 02 06 4D

			39 01 00 00 00 00 02 FF 10
			39 01 00 00 00 00 02 55 03];
		nubia,mdss-dsi-ce-cabc-command4 = [
			39 01 00 00 00 00 02 FF 23
			39 01 00 00 00 00 02 FB 01
			39 01 00 00 00 00 02 01 84
			39 01 00 00 00 00 02 02 00
			39 01 00 00 00 00 02 03 04
			39 01 00 00 00 00 02 05 21
			39 01 00 00 00 00 02 06 00

			39 01 00 00 00 00 02 FF 10
			39 01 00 00 00 00 02 55 80];
		nubia,mdss-dsi-ce-cabc-command5 = [
			39 01 00 00 00 00 02 FF 23
			39 01 00 00 00 00 02 FB 01
			39 01 00 00 00 00 02 01 84
			39 01 00 00 00 00 02 02 00
			39 01 00 00 00 00 02 03 04
			39 01 00 00 00 00 02 05 36
			39 01 00 00 00 00 02 06 4D

			39 01 00 00 00 00 02 FF 10
			39 01 00 00 00 00 02 55 81];
		nubia,mdss-dsi-ce-cabc-command6 = [
			39 01 00 00 00 00 02 FF 23
			39 01 00 00 00 00 02 FB 01
			39 01 00 00 00 00 02 01 84
			39 01 00 00 00 00 02 02 00
			39 01 00 00 00 00 02 03 04
			39 01 00 00 00 00 02 05 36
			39 01 00 00 00 00 02 06 4D

			39 01 00 00 00 00 02 FF 10
			39 01 00 00 00 00 02 55 82];
		nubia,mdss-dsi-ce-cabc-command7 = [
			39 01 00 00 00 00 02 FF 23
			39 01 00 00 00 00 02 FB 01
			39 01 00 00 00 00 02 01 84
			39 01 00 00 00 00 02 02 00
			39 01 00 00 00 00 02 03 04
			39 01 00 00 00 00 02 05 36
			39 01 00 00 00 00 02 06 4D

			39 01 00 00 00 00 02 FF 10
			39 01 00 00 00 00 02 55 83];
		nubia,mdss-dsi-ce-cabc-command8 = [
			39 01 00 00 00 00 02 FF 23
			39 01 00 00 00 00 02 FB 01
			39 01 00 00 00 00 02 01 84
			39 01 00 00 00 00 02 02 00
			39 01 00 00 00 00 02 03 04
			39 01 00 00 00 00 02 05 21
			39 01 00 00 00 00 02 06 00

			39 01 00 00 00 00 02 FF 10
			39 01 00 00 00 00 02 55 90];
		nubia,mdss-dsi-ce-cabc-command9 = [
			39 01 00 00 00 00 02 FF 23
			39 01 00 00 00 00 02 FB 01
			39 01 00 00 00 00 02 01 84
			39 01 00 00 00 00 02 02 00
			39 01 00 00 00 00 02 03 04
			39 01 00 00 00 00 02 05 36
			39 01 00 00 00 00 02 06 4D

			39 01 00 00 00 00 02 FF 10
			39 01 00 00 00 00 02 55 91];
		nubia,mdss-dsi-ce-cabc-command10 = [
			39 01 00 00 00 00 02 FF 23
			39 01 00 00 00 00 02 FB 01
			39 01 00 00 00 00 02 01 84
			39 01 00 00 00 00 02 02 00
			39 01 00 00 00 00 02 03 04
			39 01 00 00 00 00 02 05 36
			39 01 00 00 00 00 02 06 4D

			39 01 00 00 00 00 02 FF 10
			39 01 00 00 00 00 02 55 92];
		nubia,mdss-dsi-ce-cabc-command11 = [
			39 01 00 00 00 00 02 FF 23
			39 01 00 00 00 00 02 FB 01
			39 01 00 00 00 00 02 01 84
			39 01 00 00 00 00 02 02 00
			39 01 00 00 00 00 02 03 04
			39 01 00 00 00 00 02 05 36
			39 01 00 00 00 00 02 06 4D

			39 01 00 00 00 00 02 FF 10
			39 01 00 00 00 00 02 55 93];
		nubia,mdss-dsi-ce-cabc-command12 = [
			39 01 00 00 00 00 02 FF 23
			39 01 00 00 00 00 02 FB 01
			39 01 00 00 00 00 02 01 84
			39 01 00 00 00 00 02 02 00
			39 01 00 00 00 00 02 03 04
			39 01 00 00 00 00 02 05 21
			39 01 00 00 00 00 02 06 00

			39 01 00 00 00 00 02 FF 10
			39 01 00 00 00 00 02 55 b0];
		nubia,mdss-dsi-ce-cabc-command13 = [
			39 01 00 00 00 00 02 FF 23
			39 01 00 00 00 00 02 FB 01
			39 01 00 00 00 00 02 01 84
			39 01 00 00 00 00 02 02 00
			39 01 00 00 00 00 02 03 04
			39 01 00 00 00 00 02 05 36
			39 01 00 00 00 00 02 06 4D

			39 01 00 00 00 00 02 FF 10
			39 01 00 00 00 00 02 55 b1];
		nubia,mdss-dsi-ce-cabc-command14 = [
			39 01 00 00 00 00 02 FF 23
			39 01 00 00 00 00 02 FB 01
			39 01 00 00 00 00 02 01 84
			39 01 00 00 00 00 02 02 00
			39 01 00 00 00 00 02 03 04
			39 01 00 00 00 00 02 05 36
			39 01 00 00 00 00 02 06 4D

			39 01 00 00 00 00 02 FF 10
			39 01 00 00 00 00 02 55 b2];
		nubia,mdss-dsi-ce-cabc-command15 = [
			39 01 00 00 00 00 02 FF 23
			39 01 00 00 00 00 02 FB 01
			39 01 00 00 00 00 02 01 84
			39 01 00 00 00 00 02 02 00
			39 01 00 00 00 00 02 03 04
			39 01 00 00 00 00 02 05 36
			39 01 00 00 00 00 02 06 4D

			39 01 00 00 00 00 02 FF 10
			39 01 00 00 00 00 02 55 b3];

		nubia,mdss-dsi-cabc-command-state = "dsi_hs_mode";
		nubia,mdss-dsi-ce-cabc-command-state = "dsi_lp_mode";

		//backlight
		nubia,mdss-dsi-panel-backlight-curve = [
			00 01 01 01 01 01 01 01 01 01
			01 01 01 01 01 01 01 01 01 01
			01 01 01 01 01 02 02 02 02 02
			02 02 03 03 03 03 03 04 04 04
			04 05 05 05 05 06 06 06 06 07
			07 07 08 08 08 09 09 09 0A 0A
			0B 0B 0B 0C 0C 0D 0D 0D 0E 0E
			0F 0F 10 10 11 11 12 12 13 13
			14 14 15 16 16 17 17 18 19 19
			1A 1A 1B 1C 1C 1D 1E 1E 1F 20
			21 21 22 23 23 24 25 26 27 27
			28 29 2A 2B 2B 2C 2D 2E 2F 30
			31 31 32 33 34 35 36 37 38 39
			3A 3B 3C 3D 3E 3F 40 41 42 43
			44 45 46 47 49 4A 4B 4C 4D 4E
			4F 51 52 53 54 55 57 58 59 5A
			5B 5D 5E 5F 61 62 63 64 66 67
			69 6A 6B 6D 6E 6F 71 72 74 75
			77 78 79 7B 7C 7E 7F 81 82 84
			85 87 89 8A 8C 8D 8F 91 92 94
			95 97 99 9A 9C 9E 9F A1 A3 A5
			A6 A8 AA AC AD AF B1 B3 B5 B6
			B8 BA BC BE C0 C2 C4 C5 C7 C9
			CB CD CF D1 D3 D5 D7 D9 DB DD
			DF E1 E3 E5 E7 EA EC EE F0 F2
			F4 F6 F8 FB FD FF];

		qcom,mdss-dsi-h-sync-pulse = <0>;
		qcom,mdss-dsi-traffic-mode = "burst_mode";
		qcom,mdss-dsi-lane-map = "lane_map_0123";
		qcom,mdss-dsi-bllp-eof-power-mode;
		qcom,mdss-dsi-bllp-power-mode;
		qcom,mdss-dsi-lp11-init;
		qcom,mdss-dsi-init-delay-us = <5>;
		qcom,mdss-dsi-lane-0-state;
		qcom,mdss-dsi-lane-1-state;
		qcom,mdss-dsi-lane-2-state;
		qcom,mdss-dsi-lane-3-state;
		qcom,mdss-dsi-te-pin-select = <1>;
		qcom,mdss-dsi-te-dcs-command = <1>;
		qcom,mdss-dsi-te-check-enable;
		qcom,mdss-dsi-te-using-te-pin;
		qcom,mdss-dsi-panel-timings = [E2 36 24 00 66 68 2A 38 2A 03 04 00];
		qcom,mdss-dsi-panel-timings-8996 = [
			24 1f 08 09 05 03 04 a0
			24 1f 08 09 05 03 04 a0
			24 1f 08 09 05 03 04 a0
			24 1f 08 09 05 03 04 a0
			24 1b 08 09 05 03 04 a0];
		qcom,mdss-dsi-t-clk-post = <0x02>;
		qcom,mdss-dsi-t-clk-pre = <0x2A>;
		qcom,mdss-dsi-dma-trigger = "trigger_sw";
		qcom,mdss-dsi-mdp-trigger = "none";
		qcom,mdss-dsi-bl-pmic-control-type = "bl_ctrl_wled";
		qcom,mdss-dsi-bl-min-level = <2>;
		qcom,mdss-dsi-bl-max-level = <4095>;
		qcom,mdss-brightness-max-level = <4095>;
		qcom,mdss-dsi-reset-sequence = <1 15>, <0 15>, <1 10>;
		qcom,mdss-pan-physical-width-dimension = <65>;
		qcom,mdss-pan-physical-height-dimension = <115>;
	};
};
