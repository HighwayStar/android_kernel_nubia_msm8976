/* Create by zougaoxiang@hipad.com  2014/11/04
 * Copyright (c) 2013, The Linux Foundation. All rights reserved.
 *
 * This program is free software; you can redistribute it and/or modify
 * it under the terms of the GNU General Public License version 2 and
 * only version 2 as published by the Free Software Foundation.
 *
 * This program is distributed in the hope that it will be useful,
 * but WITHOUT ANY WARRANTY; without even the implied warranty of
 * MERCHANTABILITY or FITNESS FOR A PARTICULAR PURPOSE.  See the
 * GNU General Public License for more details.
 */

/*---------------------------------------------------------------------------
 * This file is autogenerated file using gcdb parser. Please do not edit it.
 * Update input XML file to add a new entry or update variable in this file
 * VERSION = "1.0"
 *---------------------------------------------------------------------------*/

&mdss_mdp {
	dsi_otm1901a_1080p_video: qcom,mdss_dsi_tianma_otm1901a_1080p_5p5_video {
		qcom,mdss-dsi-panel-name = "tianma otm1901a 1080p 5p5 video mode dsi panel";
		qcom,mdss-dsi-panel-controller = <&mdss_dsi0>;
		qcom,mdss-dsi-panel-type = "dsi_video_mode";
		qcom,mdss-dsi-panel-destination = "display_1";
		qcom,mdss-dsi-panel-framerate = <60>;
		qcom,mdss-dsi-virtual-channel-id = <0>;
		qcom,mdss-dsi-stream = <0>;
		qcom,mdss-dsi-panel-width = <1080>;
		qcom,mdss-dsi-panel-height = <1920>;
		qcom,mdss-dsi-h-front-porch = <24>;
		qcom,mdss-dsi-h-back-porch = <25>;
		qcom,mdss-dsi-h-pulse-width = <20>;
		qcom,mdss-dsi-h-sync-skew = <0>;
		qcom,mdss-dsi-v-back-porch = <8>;
		qcom,mdss-dsi-v-front-porch = <14>;
		qcom,mdss-dsi-v-pulse-width = <2>;
		qcom,mdss-dsi-h-left-border = <0>;
		qcom,mdss-dsi-h-right-border = <0>;
		qcom,mdss-dsi-v-top-border = <0>;
		qcom,mdss-dsi-v-bottom-border = <0>;
		qcom,mdss-dsi-bpp = <24>;
		qcom,mdss-dsi-underflow-color = <0xFF>;
		qcom,mdss-dsi-border-color = <0>;
		qcom,mdss-dsi-on-command = [
			39 01 00 00 00 00 02 00 00
			39 01 00 00 00 00 04 FF 19 01 01
			39 01 00 00 00 00 02 00 80
			39 01 00 00 00 00 03 FF 19 01
			39 01 00 00 00 00 02 00 00
			39 01 00 00 00 00 02 1C 33
			29 01 00 00 00 00 02 00 82
			29 01 00 00 00 00 02 D6 02
			29 01 00 00 00 00 02 00 A0
			29 01 00 00 00 00 0D D6 00 00 00 00 00 00 00 00 00 00 00 00
			29 01 00 00 00 00 02 00 B0
			29 01 00 00 00 00 0D D6 26 26 13 9A 1A 1A 1A 80 33 33 33 33
			29 01 00 00 00 00 02 00 C0
			29 01 00 00 00 00 0D D6 61 1A 00 66 11 11 11 55 22 22 22 22
			29 01 00 00 00 00 02 00 D0
			29 01 00 00 00 00 0D D6 54 54 00 33 09 09 09 2B 11 11 11 11
			39 01 00 00 00 00 02 51 00
			39 01 00 00 00 00 02 53 00
			39 01 00 00 00 00 02 55 00
			39 01 00 00 00 00 02 35 00
			05 01 00 00 78 00 02 11 00
			05 01 00 00 0A 00 02 29 00
		];
		qcom,mdss-dsi-off-command = [
			39 01 00 00 00 00 02 00 00
			39 01 00 00 00 00 04 FF 19 01 01
			39 01 00 00 00 00 02 00 80
			39 01 00 00 00 00 03 FF 19 01
			05 01 00 00 05 00 02 22 00
			05 01 00 00 32 00 02 28 00
			05 01 00 00 46 00 02 10 00
		];
		zte,mdss-dsi-ce-command-off = [
    ];
		zte,mdss-dsi-ce-command-soft = [
			39 01 00 00 00 00 02 81 80
		];
		zte,mdss-dsi-ce-command-std = [
			39 01 00 00 00 00 02 81 81
    ];
		zte,mdss-dsi-ce-command-glow = [
			39 01 00 00 00 00 02 81 83
		];

		zte,mdss-dsi-cabc-command-off = [
		];
		zte,mdss-dsi-ce-command-lever1 = [
		];
		zte,mdss-dsi-ce-command-lever2 = [
		];
		zte,mdss-dsi-ce-command-lever3 = [
		];

		zte,mdss-dsi-ce-cabc-command0 = [
		];
		zte,mdss-dsi-ce-cabc-command1 = [
		];
		zte,mdss-dsi-ce-cabc-command2 = [
		];
		zte,mdss-dsi-ce-cabc-command3 = [
		];
		zte,mdss-dsi-ce-cabc-command4 = [
		];
		zte,mdss-dsi-ce-cabc-command5 = [
		];
    zte,mdss-dsi-ce-cabc-command6 = [
		];
    zte,mdss-dsi-ce-cabc-command7 = [
		];
		zte,mdss-dsi-ce-cabc-command8 = [
		];
    zte,mdss-dsi-ce-cabc-command9 = [
		];
    zte,mdss-dsi-ce-cabc-command10 = [
		];
    zte,mdss-dsi-ce-cabc-command11 = [
		];
		zte,mdss-dsi-ce-cabc-command12 = [
		];
    zte,mdss-dsi-ce-cabc-command13 = [
		];
    zte,mdss-dsi-ce-cabc-command14 = [
		];
    zte,mdss-dsi-ce-cabc-command15 = [
		];

		zte,mdss-dsi-panel-backlight-curve = [
			00 01 02 03 04 05 06 07
			08 09 0A 0B 0C 0D 0E 0F
			10 11 12 13 14 15 16 17
			18 19 1A 1B 1C 1D 1E 1F
			20 21 22 23 24 25 26 27
			28 29 2A 2B 2C 2D 2E 2F
			30 31 32 33 34 35 36 37
			38 39 3A 3B 3C 3D 3E 3F
			40 41 42 43 44 45 46 47
			48 49 4A 4B 4C 4D 4E 4F
			50 51 52 53 54 55 56 57
			58 59 5A 5B 5C 5D 5E 5F
			60 61 62 63 64 65 66 67
			68 69 6A 6B 6C 6D 6E 6F
			70 71 72 73 74 75 76 77
			78 79 7A 7B 7C 7D 7E 7F
			80 81 82 83 84 85 86 87
			88 89 8A 8B 8C 8D 8E 8F
			90 91 92 93 94 95 96 97
			98 99 9A 9B 9C 9D 9E 9F
			A0 A1 A2 A3 A4 A5 A6 A7
			A8 A9 AA AB AC AD AE AF
			B0 B1 B2 B3 B4 B5 B6 B7
			B8 B9 BA BB BC BD BE BF
			C0 C1 C2 C3 C4 C5 C6 C7
			C8 C9 CA CB CC CD CE CF
			D0 D1 D2 D3 D4 D5 D6 D7
			D8 D9 DA DB DC DD DE DF
			E0 E1 E2 E3 E4 E5 E6 E7
			E8 E9 EA EB EC ED EE EF
			F0 F1 F2 F3 F4 F5 F6 F7
			F8 F9 FA FB FC FD FE FF
						];
		qcom,mdss-dsi-on-command-state = "dsi_lp_mode";
		qcom,mdss-dsi-off-command-state = "dsi_hs_mode";
		zte,mdss-dsi-ce-command-state = "dsi_lp_mode";
		zte,mdss-dsi-cabc-command-state = "dsi_lp_mode";
		zte,mdss-dsi-ce-cabc-command-state = "dsi_lp_mode";
		qcom,mdss-dsi-h-sync-pulse = <1>;
		qcom,mdss-dsi-traffic-mode = "burst_mode";
		qcom,mdss-dsi-lane-map = "lane_map_0123";
		qcom,mdss-dsi-bllp-eof-power-mode;
		qcom,mdss-dsi-bllp-power-mode;
		qcom,mdss-dsi-lane-0-state;
		qcom,mdss-dsi-lane-1-state;
		qcom,mdss-dsi-lane-2-state;
		qcom,mdss-dsi-lane-3-state;
		qcom,mdss-dsi-panel-timings = [D5 32 22 00 60 64 26 36 29 03 04 00];
		qcom,mdss-dsi-t-clk-post = <0x03>;
		qcom,mdss-dsi-t-clk-pre = <0x28>;
		qcom,mdss-dsi-bl-min-level = <1>;
		qcom,mdss-dsi-bl-max-level = <4095>;
		qcom,mdss-dsi-dma-trigger = "trigger_sw";
		qcom,mdss-dsi-mdp-trigger = "none";
		qcom,mdss-dsi-bl-pmic-control-type = "bl_ctrl_wled";
		qcom,mdss-dsi-reset-sequence = <1 5>, <0 1>, <1 5>;
	};
};
