/* Copyright (c) 2013, The Linux Foundation. All rights reserved.
 *
 * This program is free software; you can redistribute it and/or modify
 * it under the terms of the GNU General Public License version 2 and
 * only version 2 as published by the Free Software Foundation.
 *
 * This program is distributed in the hope that it will be useful,
 * but WITHOUT ANY WARRANTY; without even the implied warranty of
 * MERCHANTABILITY or FITNESS FOR A PARTICULAR PURPOSE.  See the
 * GNU General Public License for more details.
 */

/*---------------------------------------------------------------------------
 * This file is autogenerated file using gcdb parser. Please do not edit it.
 * Update input XML file to add a new entry or update variable in this file
 * VERSION = "1.0"
 *---------------------------------------------------------------------------*/
&mdss_mdp {
	dsi_edo_rm67191_1080_5p2_cmd: qcom,mdss_dsi_edo_rm67191_1080p_5p2_command {
		qcom,mdss-dsi-panel-name = "edo rm67191 1080p 5p2 command mode dsi panel";
		qcom,mdss-dsi-panel-controller = <&mdss_dsi0>;
		qcom,mdss-dsi-panel-type = "dsi_cmd_mode";
		qcom,mdss-dsi-panel-destination = "display_1";
		qcom,mdss-dsi-panel-framerate = <60>;
		qcom,mdss-dsi-virtual-channel-id = <0>;
		qcom,mdss-dsi-stream = <0>;
		qcom,mdss-dsi-panel-width = <1080>;
		qcom,mdss-dsi-panel-height = <1920>;
		qcom,mdss-dsi-h-front-porch = <60>;
		qcom,mdss-dsi-h-back-porch = <60>;
		qcom,mdss-dsi-h-pulse-width = <30>;
		qcom,mdss-dsi-h-sync-skew = <0>;
		qcom,mdss-dsi-v-back-porch = <7>;
		qcom,mdss-dsi-v-front-porch = <7>;
		qcom,mdss-dsi-v-pulse-width = <2>;
		qcom,mdss-dsi-h-left-border = <0>;
		qcom,mdss-dsi-h-right-border = <0>;
		qcom,mdss-dsi-v-top-border = <0>;
		qcom,mdss-dsi-v-bottom-border = <0>;
		qcom,mdss-dsi-bpp = <24>;
		qcom,mdss-dsi-color-order = <0>;
		qcom,mdss-dsi-underflow-color = <0xff>;
		qcom,mdss-dsi-border-color = <0>;
		qcom,mdss-dsi-lane-map = "lane_map_0123";
                qcom,mdss-dsi-on-command = [
			15 01 00 00 00 00 02 FE 0B
			15 01 00 00 00 00 02 28 40
			15 01 00 00 00 00 02 29 4F
			15 01 00 00 00 00 02 FE 0E
			15 01 00 00 00 00 02 4B 00
			15 01 00 00 00 00 02 4C 0F
			15 01 00 00 00 00 02 4D 20
			15 01 00 00 00 00 02 4E 40
			15 01 00 00 00 00 02 4F 60
			15 01 00 00 00 00 02 50 A0
			15 01 00 00 00 00 02 51 C0
			15 01 00 00 00 00 02 52 E0
			15 01 00 00 00 00 02 53 FF
			15 01 00 00 00 00 02 FE 0D
			15 01 00 00 00 00 02 08 41
			15 01 00 00 00 00 02 46 02
			15 01 00 00 00 00 02 72 09
			15 01 00 00 00 00 02 1E 04
			15 01 00 00 00 00 02 1E 00
			15 01 00 00 00 00 02 FE 0A
			15 01 00 00 00 00 02 24 17
			15 01 00 00 00 00 02 04 07
			15 01 00 00 00 00 02 1A 0C
			15 01 00 00 00 00 02 FE 04
			15 01 00 00 00 00 02 00 0C
			15 01 00 00 00 00 02 05 10
			15 01 00 00 00 00 02 06 08
			15 01 00 00 00 00 02 08 10
			15 01 00 00 00 00 02 09 08
			15 01 00 00 00 00 02 0A E6
			15 01 00 00 00 00 02 0B 8C
			15 01 00 00 00 00 02 1A 12
			15 01 00 00 00 00 02 1E E0
			15 01 00 00 00 00 02 29 93
			15 01 00 00 00 00 02 2A 93
			15 01 00 00 00 00 02 2F 02
			15 01 00 00 00 00 02 31 02
			15 01 00 00 00 00 02 33 05
			15 01 00 00 00 00 02 37 2D
			15 01 00 00 00 00 02 38 2D
			15 01 00 00 00 00 02 3A 1E
			15 01 00 00 00 00 02 3B 1E
			15 01 00 00 00 00 02 3D 27
			15 01 00 00 00 00 02 3F 80
			15 01 00 00 00 00 02 40 40
			15 01 00 00 00 00 02 41 E0
			15 01 00 00 00 00 02 4F 2F
			15 01 00 00 00 00 02 50 1E
			15 01 00 00 00 00 02 FE 06
			15 01 00 00 00 00 02 00 EC
			15 01 00 00 00 00 02 05 06
			15 01 00 00 00 00 02 07 A2
			15 01 00 00 00 00 02 08 EC
			15 01 00 00 00 00 02 0D 04
			15 01 00 00 00 00 02 0F A2
			15 01 00 00 00 00 02 32 EC
			15 01 00 00 00 00 02 37 07
			15 01 00 00 00 00 02 39 83
			15 01 00 00 00 00 02 3A EC
			15 01 00 00 00 00 02 41 06
			15 01 00 00 00 00 02 43 83
			15 01 00 00 00 00 02 44 EC
			15 01 00 00 00 00 02 49 06
			15 01 00 00 00 00 02 4B A2
			15 01 00 00 00 00 02 4C EC
			15 01 00 00 00 00 02 51 04
			15 01 00 00 00 00 02 53 A2
			15 01 00 00 00 00 02 75 EC
			15 01 00 00 00 00 02 7A 07
			15 01 00 00 00 00 02 7C 83
			15 01 00 00 00 00 02 7D EC
			15 01 00 00 00 00 02 82 06
			15 01 00 00 00 00 02 84 83
			15 01 00 00 00 00 02 85 EC
			15 01 00 00 00 00 02 86 0F
			15 01 00 00 00 00 02 87 FF
			15 01 00 00 00 00 02 88 00
			15 01 00 00 00 00 02 8A 02
			15 01 00 00 00 00 02 8C A2
			15 01 00 00 00 00 02 8D EE
			15 01 00 00 00 00 02 8E 01
			15 01 00 00 00 00 02 8F E8
			15 01 00 00 00 00 02 90 0A
			15 01 00 00 00 00 02 92 06
			15 01 00 00 00 00 02 93 A0
			15 01 00 00 00 00 02 94 A8
			15 01 00 00 00 00 02 95 EC
			15 01 00 00 00 00 02 96 0F
			15 01 00 00 00 00 02 97 FF
			15 01 00 00 00 00 02 98 00
			15 01 00 00 00 00 02 9A 02
			15 01 00 00 00 00 02 9C A2
			15 01 00 00 00 00 02 A6 21
			15 01 00 00 00 00 02 A7 05
			15 01 00 00 00 00 02 A9 06
			15 01 00 00 00 00 02 AC 04
			15 01 00 00 00 00 02 B1 12
			15 01 00 00 00 00 02 B2 17
			15 01 00 00 00 00 02 B3 17
			15 01 00 00 00 00 02 B4 17
			15 01 00 00 00 00 02 B5 17
			15 01 00 00 00 00 02 B6 11
			15 01 00 00 00 00 02 B7 08
			15 01 00 00 00 00 02 B8 09
			15 01 00 00 00 00 02 B9 06
			15 01 00 00 00 00 02 BA 07
			15 01 00 00 00 00 02 BB 17
			15 01 00 00 00 00 02 BC 17
			15 01 00 00 00 00 02 BD 17
			15 01 00 00 00 00 02 BE 17
			15 01 00 00 00 00 02 BF 17
			15 01 00 00 00 00 02 C0 17
			15 01 00 00 00 00 02 C1 17
			15 01 00 00 00 00 02 C2 17
			15 01 00 00 00 00 02 C3 17
			15 01 00 00 00 00 02 C4 0F
			15 01 00 00 00 00 02 C5 0E
			15 01 00 00 00 00 02 C6 00
			15 01 00 00 00 00 02 C7 01
			15 01 00 00 00 00 02 C8 10
			15 01 00 00 00 00 02 FE 00
			15 01 00 00 00 00 02 C2 08
			15 01 00 00 00 00 02 35 00
			29 01 00 00 00 00 03 44 03 80
			15 01 00 00 00 00 02 51 FF
			15 01 00 00 78 00 02 11 00
			15 01 00 00 14 00 02 29 00
		];
		qcom,mdss-dsi-off-command = [
			39 01 00 00 22 00 02 28 00
			39 01 00 00 78 00 02 10 00];
		zte,mdss-dsi-ce-command-off = [
    ];
		zte,mdss-dsi-ce-command-soft = [
			39 01 00 00 00 00 03 E4 00 00
		];
		zte,mdss-dsi-ce-command-std = [
			39 01 00 00 00 00 03 E4 01 01
    ];
		zte,mdss-dsi-ce-command-glow = [
			39 01 00 00 00 00 03 E4 01 03
		];

		zte,mdss-dsi-cabc-command-off = [
		];
		zte,mdss-dsi-ce-command-lever1 = [
		];
		zte,mdss-dsi-ce-command-lever2 = [
		];
		zte,mdss-dsi-ce-command-lever3 = [
		];

		zte,mdss-dsi-ce-cabc-command0 = [
		];
		zte,mdss-dsi-ce-cabc-command1 = [
		];
		zte,mdss-dsi-ce-cabc-command2 = [
		];
		zte,mdss-dsi-ce-cabc-command3 = [
		];
		zte,mdss-dsi-ce-cabc-command4 = [
		];
		zte,mdss-dsi-ce-cabc-command5 = [
		];
    zte,mdss-dsi-ce-cabc-command6 = [
		];
    zte,mdss-dsi-ce-cabc-command7 = [
		];
		zte,mdss-dsi-ce-cabc-command8 = [
		];
    zte,mdss-dsi-ce-cabc-command9 = [
		];
    zte,mdss-dsi-ce-cabc-command10 = [
		];
    zte,mdss-dsi-ce-cabc-command11 = [
		];
		zte,mdss-dsi-ce-cabc-command12 = [
		];
    zte,mdss-dsi-ce-cabc-command13 = [
		];
    zte,mdss-dsi-ce-cabc-command14 = [
		];
    zte,mdss-dsi-ce-cabc-command15 = [
		];

		zte,mdss-dsi-panel-backlight-curve = [
			00 01 02 03 04 05 06 07
			08 09 0A 0B 0C 0D 0E 0F
			10 11 12 13 14 15 16 17
			18 19 1A 1B 1C 1D 1E 1F
			20 21 22 23 24 25 26 27
			28 29 2A 2B 2C 2D 2E 2F
			30 31 32 33 34 35 36 37
			38 39 3A 3B 3C 3D 3E 3F
			40 41 42 43 44 45 46 47
			48 49 4A 4B 4C 4D 4E 4F
			50 51 52 53 54 55 56 57
			58 59 5A 5B 5C 5D 5E 5F
			60 61 62 63 64 65 66 67
			68 69 6A 6B 6C 6D 6E 6F
			70 71 72 73 74 75 76 77
			78 79 7A 7B 7C 7D 7E 7F
			80 81 82 83 84 85 86 87
			88 89 8A 8B 8C 8D 8E 8F
			90 91 92 93 94 95 96 97
			98 99 9A 9B 9C 9D 9E 9F
			A0 A1 A2 A3 A4 A5 A6 A7
			A8 A9 AA AB AC AD AE AF
			B0 B1 B2 B3 B4 B5 B6 B7
			B8 B9 BA BB BC BD BE BF
			C0 C1 C2 C3 C4 C5 C6 C7
			C8 C9 CA CB CC CD CE CF
			D0 D1 D2 D3 D4 D5 D6 D7
			D8 D9 DA DB DC DD DE DF
			E0 E1 E2 E3 E4 E5 E6 E7
			E8 E9 EA EB EC ED EE EF
			F0 F1 F2 F3 F4 F5 F6 F7
			F8 F9 FA FB FC FD FE FF
						];
		qcom,mdss-dsi-on-command-state = "dsi_lp_mode";
		qcom,mdss-dsi-off-command-state = "dsi_hs_mode";
		zte,mdss-dsi-ce-command-state = "dsi_lp_mode";
		zte,mdss-dsi-cabc-command-state = "dsi_lp_mode";
		zte,mdss-dsi-ce-cabc-command-state = "dsi_lp_mode";
		qcom,mdss-dsi-h-sync-pulse = <1>;
		qcom,mdss-dsi-traffic-mode = "burst_mode";
		qcom,mdss-dsi-bllp-eof-power-mode;
		qcom,mdss-dsi-bllp-power-mode;
		qcom,mdss-dsi-lane-0-state;
		qcom,mdss-dsi-lane-1-state;
		qcom,mdss-dsi-lane-2-state;
		qcom,mdss-dsi-lane-3-state;
		//command need start
		qcom,mdss-dsi-te-pin-select = <1>;
		//qcom,mdss-dsi-wr-mem-start = <0x2c>;
		qcom,mdss-dsi-te-dcs-command = <1>;
		qcom,mdss-dsi-te-check-enable;
		qcom,mdss-dsi-te-using-te-pin;
		//command need end
		qcom,mdss-dsi-panel-timings = [E2 36 24 00 66 6A 28 38 2A 03 04 00];
		qcom,mdss-dsi-t-clk-post = <0x0D>;
		qcom,mdss-dsi-t-clk-pre = <0x2E>;
		qcom,mdss-dsi-bl-min-level = <1>;
		qcom,mdss-dsi-bl-max-level = <255>;
		zte,mdss-dsi-colortmp-warm = <0x8000 0x8000 0x7c7c>;
		zte,mdss-dsi-colortmp-natural = <0x8000 0x8000 0x8000>;
		zte,mdss-dsi-colortmp-cool = <0x7d80 0x7d76 0x8000>;
		qcom,mdss-dsi-dma-trigger = "trigger_sw";
		qcom,mdss-dsi-mdp-trigger = "none";
		qcom,mdss-dsi-bl-pmic-control-type = "bl_ctrl_dcs";
		qcom,mdss-dsi-reset-sequence = <1 1>, <0 1>, <1 15>;
		qcom,mdss-pan-physical-width-dimension = <59>;
		qcom,mdss-pan-physical-height-dimension = <104>;
		qcom,mdss-dsi-tx-eot-append;
	};
};
