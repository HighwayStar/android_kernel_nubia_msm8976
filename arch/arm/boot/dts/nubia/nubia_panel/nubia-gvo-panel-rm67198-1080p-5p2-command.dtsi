/* Copyright (c) 2013, The Linux Foundation. All rights reserved.
 *
 * This program is free software; you can redistribute it and/or modify
 * it under the terms of the GNU General Public License version 2 and
 * only version 2 as published by the Free Software Foundation.
 *
 * This program is distributed in the hope that it will be useful,
 * but WITHOUT ANY WARRANTY; without even the implied warranty of
 * MERCHANTABILITY or FITNESS FOR A PARTICULAR PURPOSE.  See the
 * GNU General Public License for more details.
 */

/*---------------------------------------------------------------------------
 * This file is autogenerated file using gcdb parser. Please do not edit it.
 * Update input XML file to add a new entry or update variable in this file
 * VERSION = "1.0"
 *---------------------------------------------------------------------------*/
&mdss_mdp {
	dsi_gvo_rm67198_1080_5p2_cmd: qcom,mdss_dsi_gvo_rm67198_1080p_5p2_command {
		qcom,mdss-dsi-panel-name = "gvo rm67198 1080p 5p2 command mode dsi panel";
		qcom,mdss-dsi-panel-controller = <&mdss_dsi0>;
		qcom,mdss-dsi-panel-type = "dsi_cmd_mode";
		qcom,mdss-dsi-panel-destination = "display_1";
		qcom,mdss-dsi-panel-framerate = <60>;
		qcom,mdss-dsi-virtual-channel-id = <0>;
		qcom,mdss-dsi-stream = <0>;
		qcom,mdss-dsi-panel-width = <1080>;
		qcom,mdss-dsi-panel-height = <1920>;
		qcom,mdss-dsi-h-front-porch = <100>;
		qcom,mdss-dsi-h-back-porch = <80>;
		qcom,mdss-dsi-h-pulse-width = <4>;
		qcom,mdss-dsi-h-sync-skew = <0>;
		qcom,mdss-dsi-v-back-porch = <4>;
		qcom,mdss-dsi-v-front-porch = <8>;
		qcom,mdss-dsi-v-pulse-width = <4>;
		qcom,mdss-dsi-h-left-border = <0>;
		qcom,mdss-dsi-h-right-border = <0>;
		qcom,mdss-dsi-v-top-border = <0>;
		qcom,mdss-dsi-v-bottom-border = <0>;
		qcom,mdss-dsi-bpp = <24>;
		qcom,mdss-dsi-color-order = <0>;
		qcom,mdss-dsi-underflow-color = <0xff>;
		qcom,mdss-dsi-border-color = <0>;
		qcom,mdss-dsi-lane-map = "lane_map_0123";
                qcom,mdss-dsi-on-command = [
			15 01 00 00 00 00 02 FE 60
			15 01 00 00 00 00 02 C1 03
			15 01 00 00 00 00 02 FE 40
			15 01 00 00 00 00 02 79 10
			15 01 00 00 00 00 02 FE F0
			15 01 00 00 00 00 02 00 CD
			15 01 00 00 00 00 02 01 B7
			15 01 00 00 00 00 02 02 83
			15 01 00 00 00 00 02 03 6E
			15 01 00 00 00 00 02 04 90
			15 01 00 00 00 00 02 05 82
			15 01 00 00 00 00 02 06 FF
			15 01 00 00 00 00 02 07 07
			15 01 00 00 00 00 02 08 81
			15 01 00 00 00 00 02 09 28
			15 01 00 00 00 00 02 0A 00
			15 01 00 00 00 00 02 0B 00
			15 01 00 00 00 00 02 0C D8
			15 01 00 00 00 00 02 0D 07
			15 01 00 00 00 00 02 0E 00
			15 01 00 00 00 00 02 0F 03
			15 01 00 00 00 00 02 10 70
			15 01 00 00 00 00 02 11 00
			15 01 00 00 00 00 02 12 0B
			15 01 00 00 00 00 02 13 F0
			15 01 00 00 00 00 02 14 00
			15 01 00 00 00 00 02 15 13
			15 01 00 00 00 00 02 16 70
			15 01 00 00 00 00 02 17 01
			15 01 00 00 00 00 02 18 1D
			15 01 00 00 00 00 02 19 80
			15 01 00 00 00 00 02 1A 02
			15 01 00 00 00 00 02 1B 34
			15 01 00 00 00 00 02 1C 20
			15 01 00 00 00 00 02 1D 04
			15 01 00 00 00 00 02 1E 63
			15 01 00 00 00 00 02 1F C0
			15 01 00 00 00 00 02 20 08
			15 01 00 00 00 00 02 21 BD
			15 01 00 00 00 00 02 22 70
			15 01 00 00 00 00 02 23 13
			15 01 00 00 00 00 02 24 D3
			15 01 00 00 00 00 02 25 11
			15 01 00 00 00 00 02 26 29
			15 01 00 00 00 00 02 27 74
			15 01 00 00 00 00 02 28 B3
			15 01 00 00 00 00 02 29 47
			15 01 00 00 00 00 02 2A A9
			15 01 00 00 00 00 02 2B D5
			15 01 00 00 00 00 02 2D 6F
			15 01 00 00 00 00 02 2F 78
			15 01 00 00 00 00 02 30 C8
			15 01 00 00 00 00 02 31 A1
			15 01 00 00 00 00 02 32 E9
			15 01 00 00 00 00 02 33 FB
			15 01 00 00 00 00 02 34 DD
			15 01 00 00 00 00 02 35 FF
			15 01 00 00 00 00 02 36 0F
			15 01 00 00 00 00 02 37 00
			15 01 00 00 00 00 02 38 03
			15 01 00 00 00 00 02 39 70
			15 01 00 00 00 00 02 3A 00
			15 01 00 00 00 00 02 3B 0B
			15 01 00 00 00 00 02 3D F0
			15 01 00 00 00 00 02 3F 00
			15 01 00 00 00 00 02 40 13
			15 01 00 00 00 00 02 41 70
			15 01 00 00 00 00 02 42 01
			15 01 00 00 00 00 02 43 1D
			15 01 00 00 00 00 02 44 80
			15 01 00 00 00 00 02 45 02
			15 01 00 00 00 00 02 46 34
			15 01 00 00 00 00 02 47 20
			15 01 00 00 00 00 02 48 04
			15 01 00 00 00 00 02 49 63
			15 01 00 00 00 00 02 4A C0
			15 01 00 00 00 00 02 4B 08
			15 01 00 00 00 00 02 4C BD
			15 01 00 00 00 00 02 4D 70
			15 01 00 00 00 00 02 4E 13
			15 01 00 00 00 00 02 4F D3
			15 01 00 00 00 00 02 50 11
			15 01 00 00 00 00 02 51 29
			15 01 00 00 00 00 02 52 74
			15 01 00 00 00 00 02 53 B3
			15 01 00 00 00 00 02 54 47
			15 01 00 00 00 00 02 55 A9
			15 01 00 00 00 00 02 56 D5
			15 01 00 00 00 00 02 58 6F
			15 01 00 00 00 00 02 59 78
			15 01 00 00 00 00 02 5A C8
			15 01 00 00 00 00 02 5B A1
			15 01 00 00 00 00 02 5C E9
			15 01 00 00 00 00 02 5D FB
			15 01 00 00 00 00 02 5E DD
			15 01 00 00 00 00 02 5F FF
			15 01 00 00 00 00 02 60 0F
			15 01 00 00 00 00 02 61 00
			15 01 00 00 00 00 02 62 03
			15 01 00 00 00 00 02 63 70
			15 01 00 00 00 00 02 64 00
			15 01 00 00 00 00 02 65 0B
			15 01 00 00 00 00 02 66 F0
			15 01 00 00 00 00 02 67 00
			15 01 00 00 00 00 02 68 13
			15 01 00 00 00 00 02 69 70
			15 01 00 00 00 00 02 6A 01
			15 01 00 00 00 00 02 6B 1D
			15 01 00 00 00 00 02 6C 80
			15 01 00 00 00 00 02 6D 02
			15 01 00 00 00 00 02 6E 34
			15 01 00 00 00 00 02 6F 20
			15 01 00 00 00 00 02 70 04
			15 01 00 00 00 00 02 71 63
			15 01 00 00 00 00 02 72 C0
			15 01 00 00 00 00 02 73 08
			15 01 00 00 00 00 02 74 BD
			15 01 00 00 00 00 02 75 70
			15 01 00 00 00 00 02 76 13
			15 01 00 00 00 00 02 77 D3
			15 01 00 00 00 00 02 78 11
			15 01 00 00 00 00 02 79 29
			15 01 00 00 00 00 02 7A 74
			15 01 00 00 00 00 02 7B B3
			15 01 00 00 00 00 02 7C 47
			15 01 00 00 00 00 02 7D A9
			15 01 00 00 00 00 02 7E D5
			15 01 00 00 00 00 02 7F 6F
			15 01 00 00 00 00 02 80 78
			15 01 00 00 00 00 02 81 C8
			15 01 00 00 00 00 02 82 A1
			15 01 00 00 00 00 02 83 E9
			15 01 00 00 00 00 02 84 FB
			15 01 00 00 00 00 02 85 DD
			15 01 00 00 00 00 02 86 FF
			15 01 00 00 00 00 02 87 0F
			15 01 00 00 00 00 02 88 00
			15 01 00 00 00 00 02 89 18
			15 01 00 00 00 00 02 8A 80
			15 01 00 00 00 00 02 8B 03
			15 01 00 00 00 00 02 8C 58
			15 01 00 00 00 00 02 8D 80
			15 01 00 00 00 00 02 8E 07
			15 01 00 00 00 00 02 8F 99
			15 01 00 00 00 00 02 90 A0
			15 01 00 00 00 00 02 91 0B
			15 01 00 00 00 00 02 92 DC
			15 01 00 00 00 00 02 93 C0
			15 01 00 00 00 00 02 94 10
			15 01 00 00 00 00 02 95 32
			15 01 00 00 00 00 02 96 01
			15 01 00 00 00 00 02 97 17
			15 01 00 00 00 00 02 98 A4
			15 01 00 00 00 00 02 99 81
			15 01 00 00 00 00 02 9A 1F
			15 01 00 00 00 00 02 9B 40
			15 01 00 00 00 00 02 9C 62
			15 01 00 00 00 00 02 9D 2B
			15 01 00 00 00 00 02 9E 19
			15 01 00 00 00 00 02 9F 83
			15 01 00 00 00 00 02 A0 3B
			15 01 00 00 00 00 02 A2 3D
			15 01 00 00 00 00 02 A3 04
			15 01 00 00 00 00 02 A4 4B
			15 01 00 00 00 00 02 A5 18
			15 01 00 00 00 00 02 A6 95
			15 01 00 00 00 00 02 A7 57
			15 01 00 00 00 00 02 A9 CF
			15 01 00 00 00 00 02 AA F5
			15 01 00 00 00 00 02 AB 66
			15 01 00 00 00 00 02 AC FE
			15 01 00 00 00 00 02 AD 06
			15 01 00 00 00 00 02 AE 78
			15 01 00 00 00 00 02 AF F8
			15 01 00 00 00 00 02 B0 07
			15 01 00 00 00 00 02 B1 00
			15 01 00 00 00 00 02 B2 18
			15 01 00 00 00 00 02 B3 80
			15 01 00 00 00 00 02 B4 03
			15 01 00 00 00 00 02 B5 58
			15 01 00 00 00 00 02 B6 80
			15 01 00 00 00 00 02 B7 07
			15 01 00 00 00 00 02 B8 99
			15 01 00 00 00 00 02 B9 A0
			15 01 00 00 00 00 02 BA 0B
			15 01 00 00 00 00 02 BB DC
			15 01 00 00 00 00 02 BC C0
			15 01 00 00 00 00 02 BD 10
			15 01 00 00 00 00 02 BE 32
			15 01 00 00 00 00 02 BF 01
			15 01 00 00 00 00 02 C0 17
			15 01 00 00 00 00 02 C1 A4
			15 01 00 00 00 00 02 C2 81
			15 01 00 00 00 00 02 C3 1F
			15 01 00 00 00 00 02 C4 40
			15 01 00 00 00 00 02 C5 62
			15 01 00 00 00 00 02 C6 2B
			15 01 00 00 00 00 02 FE E0
			15 01 00 00 00 00 02 4A 19
			15 01 00 00 00 00 02 4B 83
			15 01 00 00 00 00 02 4C 3B
			15 01 00 00 00 00 02 4D 3D
			15 01 00 00 00 00 02 4E 04
			15 01 00 00 00 00 02 4F 4B
			15 01 00 00 00 00 02 50 18
			15 01 00 00 00 00 02 51 95
			15 01 00 00 00 00 02 52 57
			15 01 00 00 00 00 02 53 CF
			15 01 00 00 00 00 02 54 F5
			15 01 00 00 00 00 02 55 66
			15 01 00 00 00 00 02 56 FE
			15 01 00 00 00 00 02 58 06
			15 01 00 00 00 00 02 59 78
			15 01 00 00 00 00 02 5A F8
			15 01 00 00 00 00 02 5B 07
			15 01 00 00 00 00 02 5C 00
			15 01 00 00 00 00 02 5D 18
			15 01 00 00 00 00 02 5E 80
			15 01 00 00 00 00 02 5F 03
			15 01 00 00 00 00 02 60 58
			15 01 00 00 00 00 02 61 80
			15 01 00 00 00 00 02 62 07
			15 01 00 00 00 00 02 63 99
			15 01 00 00 00 00 02 64 A0
			15 01 00 00 00 00 02 65 0B
			15 01 00 00 00 00 02 66 DC
			15 01 00 00 00 00 02 67 C0
			15 01 00 00 00 00 02 68 10
			15 01 00 00 00 00 02 69 32
			15 01 00 00 00 00 02 6A 01
			15 01 00 00 00 00 02 6B 17
			15 01 00 00 00 00 02 6C A4
			15 01 00 00 00 00 02 6D 81
			15 01 00 00 00 00 02 6E 1F
			15 01 00 00 00 00 02 6F 40
			15 01 00 00 00 00 02 70 62
			15 01 00 00 00 00 02 71 2B
			15 01 00 00 00 00 02 72 19
			15 01 00 00 00 00 02 73 83
			15 01 00 00 00 00 02 74 3B
			15 01 00 00 00 00 02 75 3D
			15 01 00 00 00 00 02 76 04
			15 01 00 00 00 00 02 77 4B
			15 01 00 00 00 00 02 78 18
			15 01 00 00 00 00 02 79 95
			15 01 00 00 00 00 02 7A 57
			15 01 00 00 00 00 02 7B CF
			15 01 00 00 00 00 02 7C F5
			15 01 00 00 00 00 02 7D 66
			15 01 00 00 00 00 02 7E FE
			15 01 00 00 00 00 02 7F 06
			15 01 00 00 00 00 02 80 78
			15 01 00 00 00 00 02 81 F8
			15 01 00 00 00 00 02 82 07
			15 01 00 00 00 00 02 FE D0
			15 01 00 00 00 00 02 40 02
			15 01 00 00 00 00 02 4B 4C
			15 01 00 00 00 00 02 FE 40
			15 01 00 00 00 00 02 05 07
			15 01 00 00 00 00 02 06 09
			15 01 00 00 00 00 02 08 07
			15 01 00 00 00 00 02 09 09
			15 01 00 00 00 00 02 0A E6
			15 01 00 00 00 00 02 0B 88
			15 01 00 00 00 00 02 20 93
			15 01 00 00 00 00 02 21 93
			15 01 00 00 00 00 02 24 02
			15 01 00 00 00 00 02 26 02
			15 01 00 00 00 00 02 28 05
			15 01 00 00 00 00 02 2A 05
			15 01 00 00 00 00 02 2D 23
			15 01 00 00 00 00 02 2F 23
			15 01 00 00 00 00 02 30 23
			15 01 00 00 00 00 02 31 23
			15 01 00 00 00 00 02 37 80
			15 01 00 00 00 00 02 38 50
			15 01 00 00 00 00 02 39 00
			15 01 00 00 00 00 02 74 2F
			15 01 00 00 00 00 02 75 19
			15 01 00 00 00 00 02 AD 00
			15 01 00 00 00 00 02 FE 60
			15 01 00 00 00 00 02 00 C4
			15 01 00 00 00 00 02 01 00
			15 01 00 00 00 00 02 02 02
			15 01 00 00 00 00 02 03 00
			15 01 00 00 00 00 02 04 00
			15 01 00 00 00 00 02 05 07
			15 01 00 00 00 00 02 06 00
			15 01 00 00 00 00 02 07 83
			15 01 00 00 00 00 02 09 C4
			15 01 00 00 00 00 02 0A 00
			15 01 00 00 00 00 02 0B 02
			15 01 00 00 00 00 02 0C 00
			15 01 00 00 00 00 02 0D 00
			15 01 00 00 00 00 02 0E 08
			15 01 00 00 00 00 02 0F 00
			15 01 00 00 00 00 02 10 83
			15 01 00 00 00 00 02 12 CC
			15 01 00 00 00 00 02 13 0F
			15 01 00 00 00 00 02 14 FF
			15 01 00 00 00 00 02 15 01
			15 01 00 00 00 00 02 16 00
			15 01 00 00 00 00 02 17 02
			15 01 00 00 00 00 02 18 00
			15 01 00 00 00 00 02 19 C0
			15 01 00 00 00 00 02 1B C4
			15 01 00 00 00 00 02 1C 00
			15 01 00 00 00 00 02 1D 02
			15 01 00 00 00 00 02 1E 00
			15 01 00 00 00 00 02 1F 00
			15 01 00 00 00 00 02 20 07
			15 01 00 00 00 00 02 21 00
			15 01 00 00 00 00 02 22 83
			15 01 00 00 00 00 02 24 C4
			15 01 00 00 00 00 02 25 00
			15 01 00 00 00 00 02 26 02
			15 01 00 00 00 00 02 27 00
			15 01 00 00 00 00 02 28 00
			15 01 00 00 00 00 02 29 08
			15 01 00 00 00 00 02 2A 00
			15 01 00 00 00 00 02 2B 83
			15 01 00 00 00 00 02 2F C4
			15 01 00 00 00 00 02 30 00
			15 01 00 00 00 00 02 31 02
			15 01 00 00 00 00 02 32 00
			15 01 00 00 00 00 02 33 00
			15 01 00 00 00 00 02 34 07
			15 01 00 00 00 00 02 35 00
			15 01 00 00 00 00 02 36 83
			15 01 00 00 00 00 02 38 C4
			15 01 00 00 00 00 02 39 00
			15 01 00 00 00 00 02 3A 02
			15 01 00 00 00 00 02 3B 00
			15 01 00 00 00 00 02 3D 00
			15 01 00 00 00 00 02 3F 08
			15 01 00 00 00 00 02 40 00
			15 01 00 00 00 00 02 41 83
			15 01 00 00 00 00 02 4C C4
			15 01 00 00 00 00 02 4D 00
			15 01 00 00 00 00 02 4E 04
			15 01 00 00 00 00 02 4F 01
			15 01 00 00 00 00 02 50 00
			15 01 00 00 00 00 02 51 08
			15 01 00 00 00 00 02 52 00
			15 01 00 00 00 00 02 53 64
			15 01 00 00 00 00 02 55 C4
			15 01 00 00 00 00 02 56 00
			15 01 00 00 00 00 02 58 04
			15 01 00 00 00 00 02 59 01
			15 01 00 00 00 00 02 5A 00
			15 01 00 00 00 00 02 5B 06
			15 01 00 00 00 00 02 5C 00
			15 01 00 00 00 00 02 5D 64
			15 01 00 00 00 00 02 5F CA
			15 01 00 00 00 00 02 60 00
			15 01 00 00 00 00 02 61 7A
			15 01 00 00 00 00 02 62 12
			15 01 00 00 00 00 02 63 00
			15 01 00 00 00 00 02 64 04
			15 01 00 00 00 00 02 65 00
			15 01 00 00 00 00 02 66 00
			15 01 00 00 00 00 02 9B 03
			15 01 00 00 00 00 02 A9 10
			15 01 00 00 00 00 02 AA 10
			15 01 00 00 00 00 02 AB 03
			15 01 00 00 00 00 02 AC 04
			15 01 00 00 00 00 02 AD 00
			15 01 00 00 00 00 02 AE 01
			15 01 00 00 00 00 02 AF 10
			15 01 00 00 00 00 02 B0 10
			15 01 00 00 00 00 02 B1 10
			15 01 00 00 00 00 02 B2 10
			15 01 00 00 00 00 02 B3 10
			15 01 00 00 00 00 02 B4 10
			15 01 00 00 00 00 02 B5 10
			15 01 00 00 00 00 02 B6 10
			15 01 00 00 00 00 02 B7 10
			15 01 00 00 00 00 02 B8 10
			15 01 00 00 00 00 02 B9 02
			15 01 00 00 00 00 02 BA 0A
			15 01 00 00 00 00 02 BB 08
			15 01 00 00 00 00 02 BC 09
			15 01 00 00 00 00 02 BD 06
			15 01 00 00 00 00 02 BE 05
			15 01 00 00 00 00 02 BF 10
			15 01 00 00 00 00 02 C0 10
			15 01 00 00 00 00 02 C4 80
			15 01 00 00 00 00 02 FE 70
			//15 01 00 00 00 00 02 48 85
			15 01 00 00 00 00 02 7D 30
			15 01 00 00 00 00 02 5D 07
			15 01 00 00 00 00 02 86 07
			15 01 00 00 00 00 02 5A FF
			15 01 00 00 00 00 02 5C F6
			15 01 00 00 00 00 02 52 00
			15 01 00 00 00 00 02 A7 02
			15 01 00 00 00 00 02 A9 2C
			15 01 00 00 00 00 02 FE A0
			15 01 00 00 00 00 02 2B 18
			15 01 00 00 00 00 02 FE 00
			15 01 00 00 00 00 02 5A 11
			15 01 00 00 00 00 02 C2 09
			15 01 00 00 00 00 02 35 00
			15 01 00 00 64 00 02 11 00
			15 01 00 00 00 00 02 29 00
			15 01 00 00 32 00 02 51 00
		];
		qcom,mdss-dsi-off-command = [
			39 01 00 00 22 00 02 28 00
			39 01 00 00 78 00 02 10 00];
	        nubia,mdss-dsi-panel-backlight-curve = [
			00 03 03 03 03 03 03 03
			03 03 03 03 03 04 04 04
			04 04 04 04 04 04 04 04
			05 05 05 05 05 05 05 05
			05 05 06 06 06 06 07 07
			07 07 08 08 08 08 09 09
			09 09 0a 0a 0b 0b 0b 0c
			0c 0c 0d 0d 0e 0e 0e 0f
			0f 0f 10 10 11 11 11 12
			12 13 13 14 14 15 15 16
			16 17 17 18 18 19 19 1a
			1a 1b 1b 1c 1d 1d 1e 1e
			1f 20 20 21 22 22 23 23
			24 25 26 27 28 28 29 2a
			2b 2c 2d 2e 2f 2f 30 31
			32 33 34 35 36 36 37 38
			39 3a 3b 3c 3d 3d 3e 3f
			40 41 42 43 44 45 46 47
			48 49 4b 4c 4d 4e 50 51
			52 53 55 56 57 58 5a 5b
			5c 5d 5e 5f 61 62 63 64
			65 66 68 69 6b 6c 6d 6f
			70 71 72 73 75 76 77 78
			79 7a 7c 7d 7e 7f 81 82
			83 85 87 88 8a 8c 8e 8f
			91 93 94 96 97 99 9a 9c
			9d 9f a1 a3 a5 a7 a9 ab
			ad af b1 b2 b4 b6 b8 b9
			bb bd bf c1 c4 c6 c8 ca
			cc ce d0 d2 d5 d7 d9 db
			dd df e1 e3 e6 e8 ea ec
			ee f0 f3 f5 f8 fa fd ff
		];

		qcom,mdss-dsi-on-command-state = "dsi_lp_mode";
		qcom,mdss-dsi-off-command-state = "dsi_hs_mode";
		zte,mdss-dsi-ce-command-state = "dsi_lp_mode";
		zte,mdss-dsi-cabc-command-state = "dsi_lp_mode";
		zte,mdss-dsi-ce-cabc-command-state = "dsi_lp_mode";
		qcom,mdss-dsi-h-sync-pulse = <1>;
		qcom,mdss-dsi-traffic-mode = "burst_mode";
		qcom,mdss-dsi-bllp-eof-power-mode;
		qcom,mdss-dsi-bllp-power-mode;
		qcom,mdss-dsi-lane-0-state;
		qcom,mdss-dsi-lane-1-state;
		qcom,mdss-dsi-lane-2-state;
		qcom,mdss-dsi-lane-3-state;
		//command need start
		qcom,mdss-dsi-te-pin-select = <1>;
		//qcom,mdss-dsi-wr-mem-start = <0x2c>;
		qcom,mdss-dsi-te-dcs-command = <1>;
		qcom,mdss-dsi-te-check-enable;
		qcom,mdss-dsi-te-using-te-pin;
		//command need end
		qcom,mdss-dsi-panel-timings = [E2 36 24 00 66 6A 28 38 2A 03 04 00];
		qcom,mdss-dsi-t-clk-post = <0x03>;
		qcom,mdss-dsi-t-clk-pre = <0x2D>;
		qcom,mdss-dsi-bl-min-level = <1>;
		qcom,mdss-dsi-bl-max-level = <255>;
		zte,mdss-dsi-colortmp-warm = <0x8000 0x8000 0x7c7c>;
		zte,mdss-dsi-colortmp-natural = <0x8000 0x8000 0x8000>;
		zte,mdss-dsi-colortmp-cool = <0x7d80 0x7d76 0x8000>;
		qcom,mdss-dsi-dma-trigger = "trigger_sw";
		qcom,mdss-dsi-mdp-trigger = "none";
		qcom,mdss-dsi-bl-pmic-control-type = "bl_ctrl_dcs";
		qcom,mdss-dsi-reset-sequence = <1 1>, <1 1>, <1 8>;
		qcom,mdss-pan-physical-width-dimension = <59>;
		qcom,mdss-pan-physical-height-dimension = <104>;
		qcom,mdss-dsi-tx-eot-append;
	};
};
