/*
 * Copyright (c) 2015, The Linux Foundation. All rights reserved.
 *
 * This program is free software; you can redistribute it and/or modify
 * it under the terms of the GNU General Public License version 2 and
 * only version 2 as published by the Free Software Foundation.
 *
 * This program is distributed in the hope that it will be useful,
 * but WITHOUT ANY WARRANTY; without even the implied warranty of
 * MERCHANTABILITY or FITNESS FOR A PARTICULAR PURPOSE.  See the
 * GNU General Public License for more details.
 */

/*---------------------------------------------------------------------------
 * This file is autogenerated file using gcdb parser. Please do not edit it.
 * Update input XML file to add a new entry or update variable in this file
 * VERSION = "1.0"
 *---------------------------------------------------------------------------*/
&mdss_mdp {
	dsi_boe_otm1906c_1080p_5p2_cmd: qcom,mdss_dsi_boe_otm1906c_1080p_5p2_cmd {
		qcom,mdss-dsi-panel-name = "boe otm1906c 1080p 5p2 cmd dsi panel";
		qcom,mdss-dsi-panel-controller = <&mdss_dsi0>;
		qcom,mdss-dsi-panel-type = "dsi_cmd_mode";
		qcom,mdss-dsi-panel-destination = "display_1";
		qcom,mdss-dsi-panel-framerate = <60>;
		qcom,mdss-dsi-virtual-channel-id = <0>;
		qcom,mdss-dsi-stream = <0>;
		qcom,mdss-dsi-panel-width = <1080>;
		qcom,mdss-dsi-panel-height = <1920>;
		qcom,mdss-dsi-h-front-porch = <44>;
		qcom,mdss-dsi-h-back-porch = <44>;
		qcom,mdss-dsi-h-pulse-width = <8>;
		qcom,mdss-dsi-h-sync-skew = <0>;
		qcom,mdss-dsi-v-back-porch = <16>;
		qcom,mdss-dsi-v-front-porch = <16>;
		qcom,mdss-dsi-v-pulse-width = <4>;
		qcom,mdss-dsi-h-left-border = <0>;
		qcom,mdss-dsi-h-right-border = <0>;
		qcom,mdss-dsi-v-top-border = <0>;
		qcom,mdss-dsi-v-bottom-border = <0>;
		qcom,mdss-dsi-bpp = <24>;
		qcom,mdss-dsi-color-order = "rgb_swap_rgb";
		qcom,mdss-dsi-underflow-color = <0xff>;
		qcom,mdss-dsi-border-color = <0>;

#if NUBIA_LCD_ESD_CHECK
		qcom,esd-check-enabled;
		qcom,mdss-dsi-panel-status-command = [06 01 00 01 05 00 01 0A];
		qcom,mdss-dsi-panel-status-command-mode = "dsi_hs_mode";
		qcom,mdss-dsi-panel-status-check-mode = "reg_read";
		qcom,mdss-dsi-panel-status-read-length = <1>;
		qcom,mdss-dsi-panel-status-value = <0x94>;
		qcom,mdss-dsi-panel-max-error-count = <3>;
#endif

		qcom,mdss-dsi-on-command = [
			29 01 00 00 00 00 02 00 00
			29 01 00 00 00 00 04 FF 19 06 01
			29 01 00 00 00 00 02 00 80
			29 01 00 00 00 00 03 FF 19 06
			29 01 00 00 00 00 02 00 A0
			29 01 00 00 00 00 04 C1 00 C0 10
			29 01 00 00 00 00 02 00 91
			29 01 00 00 00 00 03 C5 14 28
			29 01 00 00 00 00 02 00 95
			29 01 00 00 00 00 02 C5 11

			//29 01 00 00 00 00 02 00 00
			//29 01 00 00 00 00 02 D9 9a

			29 01 00 00 00 00 02 00 80
			29 01 00 00 00 00 03 C1 55 55
			29 01 00 00 00 00 02 00 94
			29 01 00 00 00 00 02 C5 67
			29 01 00 00 00 00 02 00 A4
			29 01 00 00 00 00 02 C5 67
			29 01 00 00 00 00 02 00 B0
			29 01 00 00 00 00 04 C5 00 00 01
			29 01 00 00 00 00 02 00 C1
			29 01 00 00 00 00 02 C5 B5
			29 01 00 00 00 00 02 00 B3
			29 01 00 00 00 00 02 C0 88
			29 01 00 00 00 00 02 00 B4

			29 01 00 00 00 00 02 C0 00

			29 01 00 00 00 00 02 00 00
			29 01 00 00 00 00 03 D8 23 23
			29 01 00 00 00 00 02 00 80
			29 01 00 00 00 00 02 C4 81
			29 01 00 00 00 00 02 00 A0
			29 01 00 00 00 00 02 B3 33
			29 01 00 00 00 00 02 00 A6
			29 01 00 00 00 00 02 B3 20

			//do not clear lcd ram
			29 01 00 00 00 00 02 00 90
			29 01 00 00 00 00 02 B4 01

			29 01 00 00 00 00 02 00 E0
			29 01 00 00 00 00 0B B4 5C 19 3F 01 64 5C 01 A0 5F A0
			29 01 00 00 00 00 02 00 F0
			29 01 00 00 00 00 02 B4 64
			29 01 00 00 00 00 02 00 80
			29 01 00 00 00 00 0F C0 00 71 00 0A 0A 00 71 0A 0A 00 71 00 0A 0A
			29 01 00 00 00 00 02 00 90
			29 01 00 00 00 00 07 C0 00 00 00 02 00 04
			29 01 00 00 00 00 02 00 A0
			29 01 00 00 00 00 10 C0 00 00 02 00 04 14 04 33 00 33 00 33 00 33 00
			29 01 00 00 00 00 02 00 D0
			29 01 00 00 00 00 10 C0 00 00 02 00 04 14 04 33 00 33 00 33 00 33 00
			29 01 00 00 00 00 02 00 80
			29 01 00 00 00 00 0D C2 83 01 00 00 82 01 00 00 00 00 00 00
			29 01 00 00 00 00 02 00 90
			29 01 00 00 00 00 0D C2 00 00 00 00 00 00 00 00 00 00 00 00
			29 01 00 00 00 00 02 00 A0
			29 01 00 00 00 00 0E C2 00 00 00 00 00 00 00 00 00 00 00 00 00
			29 01 00 00 00 00 02 00 B0
			29 01 00 00 00 00 10 C2 82 13 00 00 88 81 13 00 00 88 00 13 00 00 88
			29 01 00 00 00 00 02 00 C0
			29 01 00 00 00 00 10 C2 01 13 00 00 88 00 00 00 00 00 00 00 00 00 00
			29 01 00 00 00 00 02 00 D0
			29 01 00 00 00 00 10 C2 00 00 00 00 00 00 00 00 00 00 33 33 33 33 00
			29 01 00 00 00 00 02 00 80
			29 01 00 00 00 00 10 C3 00 00 00 00 00 00 00 00 00 00 00 00 00 00 00
			29 01 00 00 00 00 02 00 A0
			29 01 00 00 00 00 0D C3 83 01 00 00 82 01 00 00 00 00 00 00
			29 01 00 00 00 00 02 00 B0
			29 01 00 00 00 00 0F C3 00 00 00 00 82 02 00 00 88 81 02 00 00 88
			29 01 00 00 00 00 02 00 C0
			29 01 00 00 00 00 10 C3 00 02 00 00 88 01 02 00 00 88 00 00 00 00 00
			29 01 00 00 00 00 02 00 D0
			29 01 00 00 00 00 10 C3 00 00 00 00 00 00 00 00 00 00 00 00 00 00 00
			29 01 00 00 00 00 02 00 E0
			29 01 00 00 00 00 06 C3 33 33 33 33 00
			29 01 00 00 00 00 02 00 80
			29 01 00 00 00 00 0C CB 00 00 00 00 30 00 03 00 00 00 70
			29 01 00 00 00 00 02 00 90
			29 01 00 00 00 00 10 CB 00 00 00 00 00 00 00 00 00 00 00 00 00 00 00
			29 01 00 00 00 00 02 00 A0
			29 01 00 00 00 00 10 CB 00 00 00 BF 00 00 00 00 00 FF 00 00 00 00 00
			29 01 00 00 00 00 02 00 B0
			29 01 00 00 00 00 0D CB 00 00 00 00 00 00 00 00 00 00 77 77
			29 01 00 00 00 00 02 00 C0
			29 01 00 00 00 00 10 CB 01 01 01 01 01 01 01 01 01 01 01 01 01 01 01
			29 01 00 00 00 00 02 00 D0
			29 01 00 00 00 00 10 CB 01 01 01 F3 01 01 01 01 00 F3 00 00 01 00 01
			29 01 00 00 00 00 02 00 E0
			29 01 00 00 00 00 0D CB 00 01 00 01 00 01 00 01 00 00 77 07
			29 01 00 00 00 00 02 00 F0
			29 01 00 00 00 00 0C CB 00 00 FF FF FF FF 03 22 02 00 70
			29 01 00 00 00 00 02 00 80
			29 01 00 00 00 00 0D CC 08 09 18 19 0C 0D 0E 0F 07 07 07 07
			29 01 00 00 00 00 02 00 90
			29 01 00 00 00 00 0D CC 09 08 19 18 0F 0E 0D 0C 07 07 07 07
			29 01 00 00 00 00 02 00 A0
			29 01 00 00 00 00 10 CC 14 15 16 17 1C 1D 1E 1F 01 04 20 07 07 07 00
			29 01 00 00 00 00 02 00 B0
			29 01 00 00 00 00 09 CC 01 02 03 04 05 06 07 07
			29 01 00 00 00 00 02 00 C0
			29 01 00 00 00 00 10 CC 00 00 00 00 00 00 00 00 00 00 00 00 00 00 00
			29 01 00 00 00 00 02 00 D0
			29 01 00 00 00 00 10 CC 00 00 00 00 00 00 00 00 00 00 00 00 00 00 00
			29 01 00 00 00 00 02 00 E0
			29 01 00 00 00 00 10 CC 00 00 00 00 00 00 00 00 00 00 00 00 00 00 00
			29 01 00 00 00 00 02 00 80
			29 01 00 00 00 00 10 CD 1A 01 11 12 1A 05 18 07 1A 1A 23 23 23 1F 1E
			29 01 00 00 00 00 02 00 90
			29 01 00 00 00 00 04 CD 1D 23 23
			29 01 00 00 00 00 02 00 A0
			29 01 00 00 00 00 10 CD 1A 02 11 12 1A 06 18 08 1A 1A 23 23 23 1F 1E
			29 01 00 00 00 00 02 00 B0
			29 01 00 00 00 00 04 CD 1D 23 23
			29 01 00 00 00 00 02 00 80
			29 01 00 00 00 00 0B A4 AF 00 20 04 00 17 15 03 60 00
			29 01 00 00 00 00 02 00 90
			29 01 00 00 00 00 04 A4 00 00 00
			29 01 00 00 00 00 02 00 80
			29 01 00 00 00 00 0D A7 FF 0F 1E 00 20 00 01 98 00 00 00 00
			29 01 00 00 00 00 02 00 90
			29 01 00 00 00 00 0B A7 1D 20 3D 00 00 BE 90 CE 05 F0
			29 01 00 00 00 00 02 00 A0
			29 01 00 00 00 00 02 A7 30
			29 01 00 00 00 00 02 00 B0
			29 01 00 00 00 00 06 A7 00 1E 1E 00 00
			29 01 00 00 00 00 02 00 C0
			29 01 00 00 00 00 0D A7 FF 0F 1E 00 1F 00 01 18 00 00 00 00
			29 01 00 00 00 00 02 00 D0
			29 01 00 00 00 00 0B A7 FF FF 1C 00 01 7C 81 7C 0B E0
			29 01 00 00 00 00 02 00 E0
			29 01 00 00 00 00 02 A7 30
			29 01 00 00 00 00 02 00 F0
			29 01 00 00 00 00 06 A7 00 3C 3C 00 00
			29 01 00 00 00 00 02 00 80
			29 01 00 00 00 00 0D A9 00 00 00 00 00 00 00 00 00 00 00 00
			29 01 00 00 00 00 02 00 90
			29 01 00 00 00 00 0B A9 00 00 00 00 00 00 00 00 00 00
			29 01 00 00 00 00 02 00 A0
			29 01 00 00 00 00 02 A9 00
			29 01 00 00 00 00 02 00 B0
			29 01 00 00 00 00 06 A9 00 00 00 00 00
			29 01 00 00 00 00 02 00 C0
			29 01 00 00 00 00 0F A9 FF 3A 49 00 1E 00 01 00 00 00 00 00 00 77
			29 01 00 00 00 00 02 00 D0
			29 01 00 00 00 00 0B A9 FF FF 1D 00 01 7C 81 7C 0B E0
			29 01 00 00 00 00 02 00 E0
			29 01 00 00 00 00 02 A9 30
			29 01 00 00 00 00 02 00 F0
			29 01 00 00 00 00 06 A9 00 3C 3C 00 00
			29 01 00 00 00 00 02 00 B0
			29 01 00 00 00 00 09 A4 05 F0 0B E0 00 00 0B E0
			29 01 00 00 00 00 02 00 80
			29 01 00 00 00 00 10 AB 05 14 00 00 FF 6A 00 00 00 00 00 00 00 00 00
			29 01 00 00 00 00 02 00 A0
			29 01 00 00 00 00 10 AB 00 00 00 00 00 00 00 07 00 00 00 00 01 00 00
			29 01 00 00 00 00 02 00 B0
			29 01 00 00 00 00 0D AB 00 00 68 0A 00 00 44 04 00 00 00 00
			29 01 00 00 00 00 02 00 93
			29 01 00 00 00 00 02 B3 01
			29 01 00 00 00 00 02 00 80
			29 01 00 00 00 00 08 CE 00 00 00 00 00 00 00
			29 01 00 00 00 00 02 00 87
			29 01 00 00 00 00 08 CE 00 00 33 00 33 00 00
			29 01 00 00 00 00 02 00 F0
			29 01 00 00 00 00 05 CE 00 00 00 00
			29 01 00 00 00 00 02 00 90
			29 01 00 00 00 00 10 CE 00 00 00 F0 00 00 00 00 FC 00 FC 00 00 00 00
			29 01 00 00 00 00 02 00 A0
			29 01 00 00 00 00 08 CE 00 00 40 40 40 00 00
			29 01 00 00 00 00 02 00 B0
			29 01 00 00 00 00 10 CE 01 01 01 01 01 01 01 01 F1 01 F1 01 01 01 01
			29 01 00 00 00 00 02 00 C0
			29 01 00 00 00 00 08 CE 01 01 01 01 01 01 01
			29 01 00 00 00 00 02 00 D0
			29 01 00 00 00 00 10 CE 04 04 04 04 04 04 04 04 F7 04 F7 04 04 00 00
			29 01 00 00 00 00 02 00 E0
			29 01 00 00 00 00 08 CE 00 00 15 15 15 04 04
			29 01 00 00 00 00 02 00 F4
			29 01 00 00 00 00 02 CE 25
			29 01 00 00 00 00 02 00 00
			29 01 00 00 00 00 19 E1 00 07 0D 17 20 28 34 47 53 64 6E 73 88 83 7C 6C 58 44 37 2E 25 18 08 00
			29 01 00 00 00 00 02 00 00
			29 01 00 00 00 00 19 E2 00 07 0D 17 20 28 34 47 53 64 6E 73 88 83 7C 6C 58 44 37 2E 25 18 08 00
			29 01 00 00 00 00 02 00 00
			29 01 00 00 00 00 19 E3 00 07 0D 17 20 28 34 47 53 64 6E 73 88 83 7C 6C 58 44 37 2E 25 18 08 00
			29 01 00 00 00 00 02 00 00
			29 01 00 00 00 00 19 E4 00 07 0D 17 20 28 34 47 53 64 6E 73 88 83 7C 6C 58 44 37 2E 25 18 08 00
			29 01 00 00 00 00 02 00 00
			29 01 00 00 00 00 19 E5 00 07 0D 17 20 28 34 47 53 64 6E 73 88 83 7C 6C 58 44 37 2E 25 18 08 00
			29 01 00 00 00 00 02 00 00
			29 01 00 00 00 00 19 E6 00 07 0D 17 20 28 34 47 53 64 6E 73 88 83 7C 6C 58 44 37 2E 25 18 08 00

			//color enhance
			29 01 00 00 00 00 02 00 a0
			29 01 00 00 00 00 0d d6 0a 00 0a 00 00 00 00 00 0a 00 00 00
			29 01 00 00 00 00 02 00 b0
			29 01 00 00 00 00 0d d6 80 80 5a b3 b3 b3 b3 b3 b3 b3 b3 b3
			29 01 00 00 00 00 02 00 c0
			29 01 00 00 00 00 0d d6 3c 33 77 77 77 77 77 77 77 77 77 77
			29 01 00 00 00 00 02 00 d0
			29 01 00 00 00 00 0d d6 3c 3c 3c 3c 3c 3c 3c 3c 3c 3c 3c 3c
			29 01 00 00 00 00 02 00 82
			29 01 00 00 00 00 02 d6 02
			//ce end

			29 01 00 00 00 00 02 00 F0
			29 01 00 00 00 00 0C CB FF FF FF FF FF FF 03 33 03 00 70
			29 01 00 00 00 00 02 00 82
			29 01 00 00 00 00 02 A5 31
			29 01 00 00 00 00 02 00 81
			29 01 00 00 00 00 02 F5 16
			29 01 00 00 00 00 02 00 83
			29 01 00 00 00 00 02 F5 16
			29 01 00 00 00 00 02 00 8D
			29 01 00 00 00 00 02 F5 17
			29 01 00 00 00 00 02 00 9D
			29 01 00 00 00 00 02 F5 1A
			29 01 00 00 00 00 02 00 A5
			29 01 00 00 00 00 02 F5 16
			29 01 00 00 00 00 02 00 A7
			29 01 00 00 00 00 02 F5 1A
			29 01 00 00 00 00 02 00 E1
			29 01 00 00 00 00 02 F5 16
			29 01 00 00 00 00 02 00 E3
			29 01 00 00 00 00 02 F5 11
			29 01 00 00 00 00 02 00 E5
			29 01 00 00 00 00 02 F5 16
			29 01 00 00 00 00 02 00 ED
			29 01 00 00 00 00 02 F5 16

			//EMI
			29 01 00 00 00 00 02 00 a3
			29 01 00 00 00 00 02 c0 01

			29 01 00 00 00 00 02 00 81
			29 01 00 00 00 00 02 a5 05

			29 01 00 00 00 00 02 00 a7
			29 01 00 00 00 00 09 c0 33 00 33 00 33 00 33 00

			29 01 00 00 00 00 02 00 b0
			29 01 00 00 00 00 04 c5 00 00 01

			//cabc
			29 01 00 00 00 00 02 00 90
			29 01 00 00 00 00 0A CA cc ff bf ff b2 ff 00 00 00

			29 01 00 00 00 00 02 00 00
			29 01 00 00 00 00 02 C6 10
			29 01 00 00 00 00 02 00 00
			29 01 00 00 00 00 13 C7 b0 bb ca cb aa ca bb cc cd a8 8c 88 67 34 22 22 22 22

			29 01 00 00 00 00 02 00 00
			29 01 00 00 00 00 02 C6 11
			29 01 00 00 00 00 02 00 00
			29 01 00 00 00 00 13 C7 b0 ba ba cb 9a ca ba bc cc 8a 8c 88 67 45 33 33 22 22

			29 01 00 00 00 00 02 00 00
			29 01 00 00 00 00 02 C6 12
			29 01 00 00 00 00 02 00 00
			29 01 00 00 00 00 13 C7 a0 ab ba ba 8b bb aa cb bb 8b 8b 88 78 45 33 33 33 33

			29 01 00 00 00 00 02 00 00
			29 01 00 00 00 00 02 C6 13
			29 01 00 00 00 00 02 00 00
			29 01 00 00 00 00 13 C7 a0 aa aa ba 8b ca 99 cc aa 9b 8a 88 78 56 44 34 33 33

			29 01 00 00 00 00 02 00 00
			29 01 00 00 00 00 02 C6 14
			29 01 00 00 00 00 02 00 00
			29 01 00 00 00 00 13 C7 a0 9a aa aa 8b ba 99 cb aa aa 89 88 78 56 44 44 44 44

			29 01 00 00 00 00 02 00 00
			29 01 00 00 00 00 02 C6 15
			29 01 00 00 00 00 02 00 00
			29 01 00 00 00 00 13 C7 90 9a aa aa 7b c9 99 c9 9b aa 89 88 88 67 45 44 44 44

			29 01 00 00 00 00 02 00 00
			29 01 00 00 00 00 02 C6 16
			29 01 00 00 00 00 02 00 00
			29 01 00 00 00 00 13 C7 90 9a a9 9a 8b b9 89 ba 8b 9a 8b 88 88 67 55 55 44 44

			29 01 00 00 00 00 02 00 00
			29 01 00 00 00 00 02 C6 17
			29 01 00 00 00 00 02 00 00
			29 01 00 00 00 00 13 C7 90 99 9a a9 8a b8 8a c8 9a 99 8b 88 88 67 55 55 55 55

			29 01 00 00 00 00 02 00 00
			29 01 00 00 00 00 02 C6 18
			29 01 00 00 00 00 02 00 00
			29 01 00 00 00 00 13 C7 90 99 99 99 8b b8 89 b8 8b 98 8b 88 88 78 66 55 55 55

			29 01 00 00 00 00 02 00 00
			29 01 00 00 00 00 02 C6 19
			29 01 00 00 00 00 02 00 00
			29 01 00 00 00 00 13 C7 80 99 99 99 9a b7 89 a8 aa 88 8a 88 88 78 66 66 66 55

			29 01 00 00 00 00 02 00 00
			29 01 00 00 00 00 02 C6 1a
			29 01 00 00 00 00 02 00 00
			29 01 00 00 00 00 13 C7 80 99 99 98 8a b7 89 98 9b 88 89 88 88 88 67 66 66 66

			29 01 00 00 00 00 02 00 00
			29 01 00 00 00 00 02 C6 1b
			29 01 00 00 00 00 02 00 00
			29 01 00 00 00 00 13 C7 80 89 99 89 99 a7 89 98 9a 88 89 88 88 88 77 77 66 66

			29 01 00 00 00 00 02 00 00
			29 01 00 00 00 00 02 C6 1c
			29 01 00 00 00 00 02 00 00
			29 01 00 00 00 00 13 C7 80 98 98 89 89 98 89 98 8a 79 89 88 88 88 77 77 77 67

			29 01 00 00 00 00 02 00 00
			29 01 00 00 00 00 02 C6 1d
			29 01 00 00 00 00 02 00 00
			29 01 00 00 00 00 13 C7 80 88 89 98 89 88 89 98 89 79 89 88 88 88 88 77 77 77

			29 01 00 00 00 00 02 00 00
			29 01 00 00 00 00 02 C6 1e
			29 01 00 00 00 00 02 00 00
			29 01 00 00 00 00 13 C7 80 88 98 88 89 88 89 88 89 88 88 88 88 88 88 88 78 77

			29 01 00 00 00 00 02 00 00
			29 01 00 00 00 00 02 C6 1f
			29 01 00 00 00 00 02 00 00
			29 01 00 00 00 00 13 C7 80 88 88 88 89 88 88 88 98 88 88 88 88 88 88 88 88 78

			29 01 00 00 00 00 02 00 00
			29 01 00 00 00 00 02 C6 00
			//cabc end

			//cap noise
			29 01 00 00 00 00 02 00 82
			29 01 00 00 00 00 02 c5 c1
			29 01 00 00 00 00 02 00 96
			29 01 00 00 00 00 03 c5 1e 32
			29 01 00 00 00 00 02 00 b4
			29 01 00 00 00 00 02 a7 00
			29 01 00 00 00 00 02 00 f4
			29 01 00 00 00 00 02 a7 00
			29 01 00 00 00 00 02 00 e4
			29 01 00 00 00 00 03 f5 00 00
			29 01 00 00 00 00 02 00 ec
			29 01 00 00 00 00 03 f5 00 00

			29 01 00 00 00 00 02 00 00
			29 01 00 00 00 00 02 fb 01

			29 01 00 00 00 00 02 00 80
			29 01 00 00 00 00 03 FF 00 00
			29 01 00 00 00 00 02 00 00
			29 01 00 00 00 00 04 FF 00 00 00

			29 01 00 00 00 00 02 35 00

			//cabc
			29 01 00 00 00 00 02 51 00
			29 01 00 00 00 00 02 53 2C
			//cabc end

			29 01 00 00 78 00 02 11 00
			29 01 00 00 00 00 02 29 00
			29 01 00 00 00 00 02 2C 00

			//lock cmd1 for esd
			29 01 00 00 00 00 02 00 00
			29 01 00 00 00 00 03 99 00 00];
		qcom,mdss-dsi-off-command = [
			//unlock cmd1
			29 01 00 00 00 00 02 00 00
			29 01 00 00 00 00 03 99 95 27

			29 01 00 00 00 00 02 28 00
			29 01 00 00 78 00 02 10 00];
		qcom,mdss-dsi-on-command-state = "dsi_lp_mode";
		qcom,mdss-dsi-off-command-state = "dsi_hs_mode";

		//ce
		nubia,mdss-dsi-ce-command-off = [
			29 01 00 00 00 00 02 00 00
			29 01 00 00 00 00 03 99 95 27
			29 01 00 00 00 00 02 81 00
			29 01 00 00 00 00 02 00 00
			29 01 00 00 00 00 03 99 00 00
		];
		nubia,mdss-dsi-ce-command-soft = [
			29 01 00 00 00 00 02 00 00
			29 01 00 00 00 00 03 99 95 27
			29 01 00 00 00 00 02 81 00
			29 01 00 00 00 00 02 00 00
			29 01 00 00 00 00 03 99 00 00
		];
		nubia,mdss-dsi-ce-command-std = [
			29 01 00 00 00 00 02 00 00
			29 01 00 00 00 00 03 99 95 27
			29 01 00 00 00 00 02 81 80
			29 01 00 00 00 00 02 00 00
			29 01 00 00 00 00 03 99 00 00
		];
		nubia,mdss-dsi-ce-command-glow = [
			29 01 00 00 00 00 02 00 00
			29 01 00 00 00 00 03 99 95 27
			29 01 00 00 00 00 02 81 83
			29 01 00 00 00 00 02 00 00
			29 01 00 00 00 00 03 99 00 00
		];
		nubia,mdss-dsi-ce-command-state = "dsi_hs_mode";
		nubia,mdss-dsi-ce-cabc-command0 = [
		];
		nubia,mdss-dsi-ce-cabc-command1 = [
		];
		nubia,mdss-dsi-ce-cabc-command2 = [
		];

		//colortmp
		nubia,colortmp-adjustable-blue = <0x3f>;
		nubia,colortmp-adjustable-red = <0x3f>;

		//cabc
		nubia,mdss-dsi-cabc-low-bl = <0x64>;
		nubia,mdss-dsi-cabc-command-off = [
			29 01 00 00 00 00 02 00 00
			29 01 00 00 00 00 03 99 95 27
			29 01 00 00 00 00 02 55 00
			29 01 00 00 00 00 02 00 00
			29 01 00 00 00 00 03 99 00 00
		];
		nubia,mdss-dsi-cabc-command-level1 = [
			29 01 00 00 00 00 02 00 00
			29 01 00 00 00 00 03 99 95 27
			29 01 00 00 00 00 02 55 01
			29 01 00 00 00 00 02 00 00
			29 01 00 00 00 00 03 99 00 00
		];
		nubia,mdss-dsi-cabc-command-level2 = [
			29 01 00 00 00 00 02 00 00
			29 01 00 00 00 00 03 99 95 27
			29 01 00 00 00 00 02 55 02
			29 01 00 00 00 00 02 00 00
			29 01 00 00 00 00 03 99 00 00
		];
		nubia,mdss-dsi-cabc-command-level3 = [
			29 01 00 00 00 00 02 00 00
			29 01 00 00 00 00 03 99 95 27
			29 01 00 00 00 00 02 55 03
			29 01 00 00 00 00 02 00 00
			29 01 00 00 00 00 03 99 00 00
		];

		nubia,mdss-dsi-cabc-command-state = "dsi_hs_mode";
		nubia,mdss-dsi-ce-cabc-command-state = "dsi_lp_mode";

		//backlight
		nubia,mdss-dsi-panel-backlight-curve = [
			00 01 01 01 01 01 01 01 01 01
			01 01 01 01 01 01 01 01 01 01
			01 01 01 01 01 02 02 02 02 02
			02 02 03 03 03 03 03 04 04 04
			04 05 05 05 05 06 06 06 06 07
			07 07 08 08 08 09 09 09 0A 0A
			0B 0B 0B 0C 0C 0D 0D 0D 0E 0E
			0F 0F 10 10 11 11 12 12 13 13
			14 14 15 16 16 17 17 18 19 19
			1A 1A 1B 1C 1C 1D 1E 1E 1F 20
			21 21 22 23 23 24 25 26 27 27
			28 29 2A 2B 2B 2C 2D 2E 2F 30
			31 31 32 33 34 35 36 37 38 39
			3A 3B 3C 3D 3E 3F 40 41 42 43
			44 45 46 47 49 4A 4B 4C 4D 4E
			4F 51 52 53 54 55 57 58 59 5A
			5B 5D 5E 5F 61 62 63 64 66 67
			69 6A 6B 6D 6E 6F 71 72 74 75
			77 78 79 7B 7C 7E 7F 81 82 84
			85 87 89 8A 8C 8D 8F 91 92 94
			95 97 99 9A 9C 9E 9F A1 A3 A5
			A6 A8 AA AC AD AF B1 B3 B5 B6
			B8 BA BC BE C0 C2 C4 C5 C7 C9
			CB CD CF D1 D3 D5 D7 D9 DB DD
			DF E1 E3 E5 E7 EA EC EE F0 F2
			F4 F6 F8 FB FD E9];

		qcom,mdss-dsi-h-sync-pulse = <0>;
		qcom,mdss-dsi-traffic-mode = "burst_mode";
		qcom,mdss-dsi-lane-map = "lane_map_0123";
		qcom,mdss-dsi-bllp-eof-power-mode;
		qcom,mdss-dsi-bllp-power-mode;
		qcom,mdss-dsi-lp11-init;
		qcom,mdss-dsi-init-delay-us = <5>;
		qcom,mdss-dsi-lane-0-state;
		qcom,mdss-dsi-lane-1-state;
		qcom,mdss-dsi-lane-2-state;
		qcom,mdss-dsi-lane-3-state;
		qcom,mdss-dsi-te-pin-select = <1>;
		qcom,mdss-dsi-wr-mem-start = <0x2c>;
		qcom,mdss-dsi-te-dcs-command = <1>;
		qcom,mdss-dsi-te-check-enable;
		qcom,mdss-dsi-te-using-te-pin;
		qcom,mdss-dsi-panel-timings = [6E 3F 36 00 5A 4F 38 41 54 03 04 00];
		qcom,mdss-dsi-panel-timings-8996 = [
			23 1e 07 09 05 03 04 a0
			23 1e 07 09 05 03 04 a0
			23 1e 07 09 05 03 04 a0
			23 1e 07 09 05 03 04 a0
			23 19 07 08 05 03 04 a0];
		qcom,mdss-dsi-t-clk-post = <0x0d>;
		qcom,mdss-dsi-t-clk-pre = <0x2d>;
		qcom,mdss-dsi-dma-trigger = "trigger_sw";
		qcom,mdss-dsi-mdp-trigger = "none";
		qcom,mdss-dsi-bl-pmic-control-type = "bl_ctrl_dcs";
		qcom,mdss-dsi-bl-min-level = <1>;
		qcom,mdss-dsi-bl-max-level = <255>;
		qcom,mdss-dsi-reset-sequence = <1 10>, <0 5>, <1 10>;
		qcom,mdss-pan-physical-width-dimension = <65>;
		qcom,mdss-pan-physical-height-dimension = <115>;
	};
};
