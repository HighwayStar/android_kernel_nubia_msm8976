/* Copyright (c) 2013-2014, The Linux Foundation. All rights reserved.
 *
 * This program is free software; you can redistribute it and/or modify
 * it under the terms of the GNU General Public License version 2 and
 * only version 2 as published by the Free Software Foundation.
 *
 * This program is distributed in the hope that it will be useful,
 * but WITHOUT ANY WARRANTY; without even the implied warranty of
 * MERCHANTABILITY or FITNESS FOR A PARTICULAR PURPOSE.  See the
 * GNU General Public License for more details.
 */

//zte_nx591j_3200mah_averaged_masterslave_feb21st2017


qcom,scud_step3200mah  {
	qcom,fcc-mah = <3200>;
	qcom,nom-batt-capacity-mah = <3200>;
	qcom,default-rbatt-mohm = <128>;
	qcom,max-voltage-uv = <4400000>;
	qcom,rbatt-capacitive-mohm = <50>;
	qcom,v-cutoff-uv = <3400000>;
	qcom,chg-term-ua = <100000>;
	qcom,batt-id-kohm = <47>;
	qcom,battery-beta = <4050>;
	qcom,chg-rslow-comp-c1 = <4207680>;
	qcom,chg-rslow-comp-c2 = <7741246>;
	qcom,chg-rs-to-rslow = <1879026>;
	qcom,chg-rslow-comp-thr = <0xBA>;
	qcom,checksum = <0x70FC>;
	qcom,gui-version = "PMI8950GUI - 2.0.0.16";
	qcom,battery-type = "scud_step3200mah";

	qcom,fg-profile-data = [
		 F5 83 39 7D 
		 EE 80 0A 76 
		 3C 83 E3 72 
		 2D 7E 68 79 
		 0C 81 98 A1 
		 84 C4 E5 D0 
		 65 0E B0 83 
		 69 75 6A 7A 
		 25 6E 39 83 
		 66 79 DB 86 
		 C8 82 82 81 
		 0E A1 91 C4 
		 89 D1 77 0D 
		 9E 0C 93 58 
		 14 70 71 FD 
		 9F 3F 6F 46 
		 AA 42 00 00 
		 E4 3C 98 31 
		 51 47 00 00 
		 00 00 00 00 
		 00 00 00 00 
		 3B 72 6C 71 
		 13 82 8A 8A 
		 9A 6F 74 58 
		 1B 80 55 88 
		 4A 6E 0A 4A 
		 4D 7C 37 B1 
		 17 81 63 80 
		 65 A0 71 0C 
		 28 00 FF 36 
		 F0 11 30 03 
		 00 00 00 0C 
	];
};

