## drivers/nubia/touch/Kconfig
```kconfig
#
# Touchscreen driver configuration
#


menu "nubia driver touchscreens"

config NUBIA_TOUCHSCREEN_SELECT_SYNAPTICS
	bool "nubia synaptics touchscreen"
	default n
	select TOUCHSCREEN_NUBIA_SYNAPTICS_DSX
	select TOUCHSCREEN_NUBIA_SYNAPTICS_DSX_I2C
	select TOUCHSCREEN_NUBIA_SYNAPTICS_DSX_CORE
	select TOUCHSCREEN_NUBIA_SYNAPTICS_DSX_RMI_DEV
	select TOUCHSCREEN_NUBIA_SYNAPTICS_DSX_FW_UPDATE
	select TOUCHSCREEN_NUBIA_SYNAPTICS_DSX_TEST_REPORTING
	select TOUCHSCREEN_NUBIA_SYNAPTICS_DSX_GESTURE
	help
	  Say Y here if you have a SYNAPTICS touchscreen connected
	  to your system.

	  If unsure, say N.

if NUBIA_TOUCHSCREEN_SELECT_SYNAPTICS
source "drivers/nubia/touch/synaptics_dsx/Kconfig"
endif

config NUBIA_TOUCHSCREENS_SYNAPTICS_DSX
	bool "config nubia touchscreens synaptics dsx"
	default n
	help
	  Say Y here if you have a nubia touchscreen synaptics dsx connected
	  to your system.	  If unsure, say N.

if NUBIA_TOUCHSCREENS_SYNAPTICS_DSX
source "drivers/nubia/touch/nubia_synaptics_dsx/Kconfig"
endif

config NUBIA_TOUCHSCREEN_CYPRESS
	bool "config nubia cypress"
	default n
	help
	  Say Y here if you have a Cypress touch connected
	  to your system.

if NUBIA_TOUCHSCREEN_CYPRESS
source "drivers/nubia/touch/cypress_button/Kconfig"
endif

config NUBIA_TOUCHSCREEN_SYNAPTICS_DSX_2_7_0
	bool "config nubia touchscreens synaptics dsx"
	default n
	help
	  Say Y here if you have a nubia touchscreen synaptics dsx connected
	  to your system.	  If unsure, say N.

if NUBIA_TOUCHSCREEN_SYNAPTICS_DSX_2_7_0
source "drivers/nubia/touch/synaptics_dsx_2.7.0/Kconfig"
endif

config NUBIA_TOUCHSCREEN_SYNAPTICS_BTN_2_7_0
	bool "config nubia touchscreens synaptics button dsx"
	default n
	help
	  Say Y here if you have a nubia touchscreen synaptics button dsx connected
	  to your system.	  If unsure, say N.

if NUBIA_TOUCHSCREEN_SYNAPTICS_BTN_2_7_0
source "drivers/nubia/touch/synaptics_btn_2.7.0/Kconfig"
endif

config NUBIA_TOUCHSCREEN_SYNAPTICS_DSX_589
	bool "config nubia touchscreens synaptics dsx"
	default n
	help
	  Say Y here if you have a nubia touchscreen synaptics dsx connected
	  to your system.	  If unsure, say N.

if NUBIA_TOUCHSCREEN_SYNAPTICS_DSX_589
source "drivers/nubia/touch/synaptics_dsx_v589/Kconfig"
endif

config NUBIA_TOUCHBUTTON_SYNAPTICS_1302
	bool "config nubia touchscreens synaptics dsx"
	default n
	help
	  Say Y here if you have a nubia touchscreen synaptics dsx connected
	  to your system.	  If unsure, say N.

if NUBIA_TOUCHBUTTON_SYNAPTICS_1302
source "drivers/nubia/touch/synaptics_s1302/Kconfig"
endif

endmenu
```

## drivers/nubia/touch/cypress_button/Kconfig
```kconfig
#
# Cypress touch button driver configuration
#
config NUBIA_TOUCHSCREEN_CYPRESS_BUTTON
	tristate "Cypress button"
	default n
	help
	  Say Y here if you have a Cypress touch button connected
	  to your system.
```

## drivers/nubia/touch/nubia_synaptics_dsx/Kconfig
```kconfig
#
# Synaptics DSX touchscreen driver configuration
#
menuconfig TOUCHSCREEN_NUBIA_SYNAPTICS_DSX
	bool "Synaptics DSX touchscreen"
	default n
	help
	  Say Y here if you have a Synaptics DSX touchscreen connected
	  to your system.

	  If unsure, say N.

if TOUCHSCREEN_NUBIA_SYNAPTICS_DSX

config TOUCHSCREEN_NUBIA_SYNAPTICS_DSX_IIC
	bool "Synaptics iic"
	default n

config TOUCHSCREEN_NUBIA_SYNAPTICS_DSX_CORE
	tristate "Synaptics DSX core driver module"
	depends on I2C || SPI_MASTER
	help
	  Say Y here to enable basic touch reporting functionality.

	  If unsure, say N.

	  To compile this driver as a module, choose M here: the
	  module will be called synaptics_dsx_core.

config TOUCHSCREEN_NUBIA_SYNAPTICS_DSX_RMI_DEV
	tristate "Synaptics DSX RMI device module"
	depends on TOUCHSCREEN_NUBIA_SYNAPTICS_DSX_CORE
	help
	  Say Y here to enable support for direct RMI register access.

	  If unsure, say N.

	  To compile this driver as a module, choose M here: the
	  module will be called synaptics_dsx_rmi_dev.

config TOUCHSCREEN_NUBIA_SYNAPTICS_DSX_FW_UPDATE
	tristate "Synaptics DSX firmware update module"
	depends on TOUCHSCREEN_NUBIA_SYNAPTICS_DSX_CORE
	help
	  Say Y here to enable support for doing firmware update.

	  If unsure, say N.

	  To compile this driver as a module, choose M here: the
	  module will be called synaptics_dsx_fw_update.

config TOUCHSCREEN_NUBIA_SYNAPTICS_DSX_TEST_REPORTING
	tristate "Synaptics DSX test reporting module"
	depends on TOUCHSCREEN_NUBIA_SYNAPTICS_DSX_CORE
	help
	  Say Y here to enable support for retrieving production test reports.

	  If unsure, say N.

	  To compile this driver as a module, choose M here: the
	  module will be called synaptics_dsx_test_reporting.

config TOUCHSCREEN_NUBIA_SYNAPTICS_DSX_PROXIMITY
	tristate "Synaptics DSX proximity module"
	depends on TOUCHSCREEN_NUBIA_SYNAPTICS_DSX_CORE
	help
	  Say Y here to enable support for proximity functionality.

	  If unsure, say N.

	  To compile this driver as a module, choose M here: the
	  module will be called synaptics_dsx_proximity.

config TOUCHSCREEN_NUBIA_SYNAPTICS_DSX_ACTIVE_PEN
	tristate "Synaptics DSX active pen module"
	depends on TOUCHSCREEN_NUBIA_SYNAPTICS_DSX_CORE
	help
	  Say Y here to enable support for active pen functionality.

	  If unsure, say N.

	  To compile this driver as a module, choose M here: the
	  module will be called synaptics_dsx_active_pen.

config TOUCHSCREEN_NUBIA_SYNAPTICS_DSX_GESTURE
	tristate "Synaptics DSX user defined gesture module"
	depends on TOUCHSCREEN_NUBIA_SYNAPTICS_DSX_CORE
	help
	  Say Y here to enable support for user defined gesture functionality.

	  If unsure, say N.

	  To compile this driver as a module, choose M here: the
	  module will be called synaptics_dsx_gesture.

config TOUCHSCREEN_NUBIA_SYNAPTICS_DSX_VIDEO
	tristate "Synaptics DSX video module"
	depends on TOUCHSCREEN_NUBIA_SYNAPTICS_DSX_CORE
	help
	  Say Y here to enable support for video communication functionality.

	  If unsure, say N.

	  To compile this driver as a module, choose M here: the
	  module will be called synaptics_dsx_video.

config TOUCHSCREEN_NUBIA_FWID_FORCE_UPDATE
	tristate "Force Synaptics DSX firmware update if id not the same"
	depends on TOUCHSCREEN_NUBIA_SYNAPTICS_DSX_CORE
	help
	  Say Y here to enable force fw update if id not the same.

	  If unsure, say N.

config TOUCHSCREEN_NUBIA_USER_TP_UPDATE
        bool "nubia tp user update module"
        default n

endif
```

## drivers/nubia/touch/synaptics_btn_2.7.0/Kconfig
```kconfig
#
# Synaptics Button DSX touchscreen driver configuration
#
menuconfig NUBIA_TOUCHSCREEN_SYNAPTICS_BTN
	bool "Synaptics Button touchscreen"
	default n
	help
	  Say Y here if you have a Synaptics Button touchscreen connected
	  to your system.

	  If unsure, say N.

if NUBIA_TOUCHSCREEN_SYNAPTICS_BTN

choice
	default NUBIA_TOUCHSCREEN_SYNAPTICS_BTN_I2C
	prompt "Synaptics Button bus interface"
config NUBIA_TOUCHSCREEN_SYNAPTICS_BTN_I2C
	bool "RMI over I2C"
	depends on I2C
config NUBIA_TOUCHSCREEN_SYNAPTICS_BTN_SPI
	bool "RMI over SPI"
	depends on SPI_MASTER
config NUBIA_TOUCHSCREEN_SYNAPTICS_BTN_RMI_HID_I2C
	bool "HID over I2C"
	depends on I2C
endchoice

config NUBIA_TOUCHSCREEN_SYNAPTICS_BTN_CORE
	tristate "Synaptics Button core driver module"
	depends on I2C || SPI_MASTER
	help
	  Say Y here to enable basic touch reporting functionality.

	  If unsure, say N.

	  To compile this driver as a module, choose M here: the
	  module will be called synaptics_btn_dsx_core.

config NUBIA_TOUCHSCREEN_SYNAPTICS_BTN_RMI_DEV
	tristate "Synaptics Button RMI device module"
	depends on NUBIA_TOUCHSCREEN_SYNAPTICS_BTN_CORE
	help
	  Say Y here to enable support for direct RMI register access.

	  If unsure, say N.

	  To compile this driver as a module, choose M here: the
	  module will be called synaptics_btn_dsx_rmi_dev.

config NUBIA_TOUCHSCREEN_SYNAPTICS_BTN_FW_UPDATE
	tristate "Synaptics Button firmware update module"
	depends on NUBIA_TOUCHSCREEN_SYNAPTICS_BTN_CORE
	help
	  Say Y here to enable support for doing firmware update.

	  If unsure, say N.

	  To compile this driver as a module, choose M here: the
	  module will be called synaptics_btn_dsx_fw_update.

config NUBIA_TOUCHSCREEN_SYNAPTICS_BTN_TEST_REPORTING
	tristate "Synaptics Button test reporting module"
	depends on NUBIA_TOUCHSCREEN_SYNAPTICS_BTN_CORE
	help
	  Say Y here to enable support for retrieving production test reports.

	  If unsure, say N.

	  To compile this driver as a module, choose M here: the
	  module will be called synaptics_btn_dsx_test_reporting.

config NUBIA_TOUCHSCREEN_SYNAPTICS_BTN_PROXIMITY
	tristate "Synaptics Button proximity module"
	depends on NUBIA_TOUCHSCREEN_SYNAPTICS_BTN_CORE
	help
	  Say Y here to enable support for proximity functionality.

	  If unsure, say N.

	  To compile this driver as a module, choose M here: the
	  module will be called synaptics_btn_dsx_proximity.

config NUBIA_TOUCHSCREEN_SYNAPTICS_BTN_ACTIVE_PEN
	tristate "Synaptics Button active pen module"
	depends on NUBIA_TOUCHSCREEN_SYNAPTICS_BTN_CORE
	help
	  Say Y here to enable support for active pen functionality.

	  If unsure, say N.

	  To compile this driver as a module, choose M here: the
	  module will be called synaptics_btn_dsx_active_pen.

config NUBIA_TOUCHSCREEN_SYNAPTICS_BTN_GESTURE
	tristate "Synaptics Button user defined gesture module"
	depends on NUBIA_TOUCHSCREEN_SYNAPTICS_BTN_CORE
	help
	  Say Y here to enable support for user defined gesture functionality.

	  If unsure, say N.

	  To compile this driver as a module, choose M here: the
	  module will be called synaptics_btn_dsx_gesture.

config NUBIA_TOUCHSCREEN_SYNAPTICS_BTN_VIDEO
	tristate "Synaptics Button video module"
	depends on NUBIA_TOUCHSCREEN_SYNAPTICS_BTN_CORE
	help
	  Say Y here to enable support for video communication functionality.

	  If unsure, say N.

	  To compile this driver as a module, choose M here: the
	  module will be called synaptics_btn_dsx_video.

config NUBIA_TOUCHSCREEN_SYNAPTICS_BTN_DEBUG
	tristate "Synaptics Button debug module"
	depends on NUBIA_TOUCHSCREEN_SYNAPTICS_BTN_CORE
	help
	  Say Y here to enable support for firmware debug functionality.

	  If unsure, say N.

	  To compile this driver as a module, choose M here: the
	  module will be called synaptics_btn_dsx_debug.

endif
```

## drivers/nubia/touch/synaptics_s1302/Kconfig
```kconfig
#
# Synaptics BUTTON touchscreen driver configuration
#
menuconfig NUBIA_TOUCHBUTTON_SYNAPTICS_S1302
	bool "Synaptics BUTTON S1302 touchscreen"
	default n
	help
	  Say Y here if you have a Synaptics BUTTON touchscreen connected
	  to your system.

	  If unsure, say N.

if NUBIA_TOUCHBUTTON_SYNAPTICS_S1302

choice
	default NUBIA_TOUCHBUTTON_SYNAPTICS_S1302_I2C
	prompt "Synaptics BUTTON bus interface"
config NUBIA_TOUCHBUTTON_SYNAPTICS_S1302_I2C
	bool "RMI over I2C"
	depends on I2C
config NUBIA_TOUCHBUTTON_SYNAPTICS_S1302_SPI
	bool "RMI over SPI"
	depends on SPI_MASTER
config NUBIA_TOUCHBUTTON_SYNAPTICS_S1302_RMI_HID_I2C
	bool "HID over I2C"
	depends on I2C
endchoice

config NUBIA_TOUCHBUTTON_SYNAPTICS_S1302_CORE
	tristate "Synaptics BUTTON core driver module"
	depends on I2C || SPI_MASTER
	help
	  Say Y here to enable basic touch reporting functionality.

	  If unsure, say N.

	  To compile this driver as a module, choose M here: the
	  module will be called synaptics_dsx_core.

config NUBIA_TOUCHBUTTON_SYNAPTICS_S1302_RMI_DEV
	tristate "Synaptics BUTTON RMI device module"
	depends on NUBIA_TOUCHBUTTON_SYNAPTICS_S1302_CORE
	help
	  Say Y here to enable support for direct RMI register access.

	  If unsure, say N.

	  To compile this driver as a module, choose M here: the
	  module will be called synaptics_dsx_rmi_dev.

config NUBIA_TOUCHBUTTON_SYNAPTICS_S1302_FW_UPDATE
	tristate "Synaptics BUTTON firmware update module"
	depends on NUBIA_TOUCHBUTTON_SYNAPTICS_S1302_CORE
	help
	  Say Y here to enable support for doing firmware update.

	  If unsure, say N.

	  To compile this driver as a module, choose M here: the
	  module will be called synaptics_dsx_fw_update.

config NUBIA_TOUCHBUTTON_SYNAPTICS_S1302_TEST_REPORTING
	tristate "Synaptics BUTTON test reporting module"
	depends on NUBIA_TOUCHBUTTON_SYNAPTICS_S1302_CORE
	help
	  Say Y here to enable support for retrieving production test reports.

	  If unsure, say N.

	  To compile this driver as a module, choose M here: the
	  module will be called synaptics_dsx_test_reporting.

config NUBIA_TOUCHBUTTON_SYNAPTICS_S1302_PROXIMITY
	tristate "Synaptics BUTTON proximity module"
	depends on NUBIA_TOUCHBUTTON_SYNAPTICS_S1302_CORE
	help
	  Say Y here to enable support for proximity functionality.

	  If unsure, say N.

	  To compile this driver as a module, choose M here: the
	  module will be called synaptics_dsx_proximity.

config NUBIA_TOUCHBUTTON_SYNAPTICS_S1302_ACTIVE_PEN
	tristate "Synaptics BUTTON active pen module"
	depends on NUBIA_TOUCHBUTTON_SYNAPTICS_S1302_CORE
	help
	  Say Y here to enable support for active pen functionality.

	  If unsure, say N.

	  To compile this driver as a module, choose M here: the
	  module will be called synaptics_dsx_active_pen.

config NUBIA_TOUCHBUTTON_SYNAPTICS_S1302_GESTURE
	tristate "Synaptics BUTTON user defined gesture module"
	depends on NUBIA_TOUCHBUTTON_SYNAPTICS_S1302_CORE
	help
	  Say Y here to enable support for user defined gesture functionality.

	  If unsure, say N.

	  To compile this driver as a module, choose M here: the
	  module will be called synaptics_dsx_gesture.

config NUBIA_TOUCHBUTTON_SYNAPTICS_S1302_VIDEO
	tristate "Synaptics BUTTON video module"
	depends on NUBIA_TOUCHBUTTON_SYNAPTICS_S1302_CORE
	help
	  Say Y here to enable support for video communication functionality.

	  If unsure, say N.

	  To compile this driver as a module, choose M here: the
	  module will be called synaptics_dsx_video.

endif
```

## drivers/nubia/vibrator/Kconfig
```kconfig
#
# DRV2605 vibrator configuration
#

config NUBIA_VIBRATOR_DRV2605
	tristate "VIBRATOR TI_DRV2605"
	default n
	help
	  Say Y here if you want to enable vibrator of TI_DRV2605.
```

## drivers/platform/nubia/Kconfig
```kconfig
# Nubia configuration options

config MACH_NUBIA
    bool "NUBIA device"
    depends on ARCH_MSM
    help
      Support for Nubia products

config MACH_NUBIA_MSM8976
    bool "NUBIA MSM8976"
    depends on ARCH_MSM8916
    select MACH_NUBIA
    help
      Support for MSM8976 Nubia variants

menu "Nubia board selection"

config MACH_NUBIA_NX591J
    bool "NUBIA_NX591J board"
    select MACH_NUBIA_MSM8976
    help
      Support for Nubia z17 lite variant

config MACH_NUBIA_NX589J
    bool "NUBIA_NX589J board"
    select MACH_NUBIA_MSM8976
    help
      Support for Nubia z17 mini s variant

endmenu
```
