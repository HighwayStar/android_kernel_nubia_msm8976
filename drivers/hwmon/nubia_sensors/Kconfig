## drivers/hwmon/nubia_sensors/Kconfig
```kconfig
################################################# SENROS START
menuconfig NUBIA_SENSORS
	tristate "NUBIA SENSORS ON"
	default n
	help
		nubia senor
if NUBIA_SENSORS
config FEATURE_NUBIA_SENSORS_LOG_ON
	tristate "NUBIA SENSORS LOG ON"
	depends on NUBIA_SENSORS
	default n
	help
		If you want to enable the sensor log,
		then choose this config
################################################# PROX START
config NUBIA_SENSORS_PROX_PA224
	tristate "support litehole prox sensor driver"
	depends on NUBIA_SENSORS
	default n
	help
		nubia prox device
################################################# AMS START
config NUBIA_SENSORS_TMD2725
	tristate "support litehole light/prox sensor driver"
	depends on NUBIA_SENSORS
	default n
	help
		nubia light prox device
################################################# PROX START
config NUBIA_SENSORS_PROX_PA22X
	tristate "support litehole prox sensor driver"
	depends on NUBIA_SENSORS
	default n
	help
		nubia prox device

################################################# PROX_ALS START
config NUBIA_SENSORS_ALS_PROX_ADSP9922
	tristate "support  als_ps adsp9922 sensor driver"
	depends on NUBIA_SENSORS
	default n
	help
		nubia prox device

################################################# RGB START
config NUBIA_SENSORS_RGB_BH1745
	tristate "support rgb bh1745 driver"
	depends on NUBIA_SENSORS
	default n
	help
		nubia rgb device
################################################# BREATTLIGHT START
config NUBIA_LIQUID_LED_AW2013
    tristate "aw2013 i2c led"
    depends on I2C
    help
      if you say use aw2013, select it.

config NUBIA_LIQUID_LED_OUTN_SWITCH
    tristate "Support for ZTEMT LED Outn Switch Driver"
    depends on I2C
    help
      if you switch outn,select it
################################################# PRESSURE_DEVICE START
config NUBIA_SENSORS_PRESSURE_DEVICE
	tristate "support pressure device driver"
	depends on NUBIA_SENSORS
	default n
	help
		nubia pressure device

################################################# HALL START
config NUBIA_SENSORS_HALL_DEVICE
	tristate "hall devicedriver"
	depends on NUBIA_SENSORS
	default n
	help
	  If you say yes here you get support for
	  hall device
################################################# IR REMOTE START
config NUBIA_SENSORS_IR_REMOTE_I_THREE
	tristate "I_THREE device driver"
	depends on NUBIA_SENSORS
	default n
	help
	  If you say yes here you get support for UEI's
	  IR Remote control i_three
################################################# FINGER_PRINTER START
menuconfig NUBIA_SENSORS_FP
	tristate "NUBIA FP DEVICE"
	depends on NUBIA_SENSORS
	default n

if NUBIA_SENSORS_FP

config NUBIA_FP_AUTODETECT
	tristate "nubia fingerprint autodetect"
	depends on NUBIA_SENSORS_FP
	default n
	help
	  If you say yes here you, will enable fingerprint
	  autodetect function.

################################################# FINGER_PRINTER_GF318M START
source drivers/hwmon/nubia_sensors/gf318m/Kconfig
choice
        prompt "choose the GF318M device style"
        depends on NUBIA_SENSORS_FP_GF318M
		default NUBIA_SENSORS_FP_GF318M_PLATFORM
		help
		  GF318M need to select the work style

config NUBIA_SENSORS_FP_GF318M_SPI
        bool "GF318M work as SPI device"
        help
          If you want GF318M work as SPI device, select it.

config NUBIA_SENSORS_FP_GF318M_PLATFORM
        bool "GF318M work as PLATFORM device"
        help
          If you want GF318M work as PLATFORM device, select it.

endchoice
################################################# FINGER_PRINTER_GF318M END

################################################# FINGER_PRINTER_FPC1020 START
source drivers/hwmon/nubia_sensors/fpc1020/Kconfig
choice
        prompt "choose the FPC1020 device style"
        depends on NUBIA_SENSORS_FP_FPC1020
		default NUBIA_SENSORS_FP_FPC1020_PLATFORM
		help
		  FPC1020 need to select the work style

config NUBIA_SENSORS_FP_FPC1020_SPI
        bool "FPC1020 work as SPI device"
        help
          If you want FPC1020 work as SPI device, select it.

config NUBIA_SENSORS_FP_FPC1020_PLATFORM
        bool "FPC1020 work as PLATFORM device"
        help
          If you want FPC1020 work as PLATFORM device, select it.

endchoice
################################################# FINGER_PRINTER_FPC1020 END

################################################# FINGER_PRINTER_GF3208 START
source drivers/hwmon/nubia_sensors/gf3208/Kconfig
choice
        prompt "choose the GF3208 device style"
        depends on NUBIA_SENSORS_FP_GF3208
		default NUBIA_SENSORS_FP_GF3208_PLATFORM
		help
		  GF3208 need to select the work style

config NUBIA_SENSORS_FP_GF3208_SPI
        bool "GF3208 work as SPI device"
        help
          If you want GF3208 work as SPI device, select it.

config NUBIA_SENSORS_FP_GF3208_PLATFORM
        bool "GF3208 work as PLATFORM device"
        help
          If you want GF3208 work as PLATFORM device, select it.

endchoice
################################################# FINGER_PRINTER_GF3208 END

################################################# FINGER_PRINTER_GF5216M START
source drivers/hwmon/nubia_sensors/gf5216m/Kconfig
choice
        prompt "choose the GF5216M device style"
        depends on NUBIA_SENSORS_FP_GF5216M
        default NUBIA_SENSORS_FP_GF5216M_PLATFORM
        help
           GF5216M need to select the work style

config NUBIA_SENSORS_FP_GF5216M_SPI
        bool "GF5216M work as SPI device"
        help
          If you want GF5216M work as SPI device, select it.

config NUBIA_SENSORS_FP_GF5216M_PLATFORM
        bool "GF5216M work as PLATFORM device"
        help
          If you want GF5216M work as PLATFORM device, select it.

endchoice
################################################# FINGER_PRINTER_GF5216M END

endif
################################################# FINGER_PRINTER END

endif
```

## drivers/hwmon/nubia_sensors/gf3208/Kconfig
```kconfig
config NUBIA_SENSORS_FP_GF3208
	tristate "nubia sensors fp gf3208"
	depends on NUBIA_SENSORS_FP
	default n
	help
	  This is the main file for fingerprint driver for gf3208.
	  Say Y here if you have a gf318m fingerprint connected
	  to your system.
```

## drivers/hwmon/nubia_sensors/gf5216m/Kconfig
```kconfig
config NUBIA_SENSORS_FP_GF5216M
	tristate "nubia sensors fp gf5216m"
	depends on NUBIA_SENSORS_FP
	default n
	help
	  This is the main file for fingerprint driver for gf5216m.
	  Say Y here if you have a gf5216m fingerprint connected
	  to your system.
```

## drivers/nubia/Kconfig
```kconfig
#
# Nubia drivers configuration
#

#menuconfig NUBIA_DRIVERS
menu "nubia drivers"

config NUBIA_DRIVERS
	bool "NUBIA DRIVERS"
	default n
	help
	  Say Y here if you want to enable NUBIA DRIVERS
	  If unsure, say N.

comment "Nubia Device Drivers"

if NUBIA_DRIVERS
# Add nubia drivers configuration here
source drivers/nubia/nubia_typec/Kconfig
config NUBIA_TYPEC
	bool "NUBIA TYPEC"
	default n
	help
	  set Y enabled typec driver.

#switches
config NUBIA_TOUCHSCREENS
	bool "NUBIA_TOUCHSCREENS"
	depends on NUBIA_DRIVERS
	default n
	help
	  Say Y here if you want to enable NUBIA_TOUCHSCREENS
	  If unsure, say N.
config NUBIA_NFC
	bool "NUBIA_NFC"
	default n
	help
	 Say Y here if you have enable NUBIA_NFC
	 IF  unsure ,say N
config NUBIA_FINGERPRINT
	bool "NUBIA_FINGERPRINT"
	default n
	help
	 Say Y here if you have enable NUBIA_FINGERPRINT
	 IF  unsure ,say N

config NUBIA_LEDS
	bool "NUBIA_LEDS"
	depends on NUBIA_DRIVERS
	default n
	help
	  Say Y here if you don't want to enable NUBIA_LEDS
if NUBIA_LEDS
source drivers/nubia/leds/Kconfig
endif
config NUBIA_VIBRATOR
	bool "NUBIA_VIBRATOR"
	depends on NUBIA_DRIVERS
	default n
	help
	  Say Y here if you don't want to enable NUBIA_VIBRATOR
if NUBIA_VIBRATOR
source drivers/nubia/vibrator/Kconfig
endif
config NUBIA_SENSORS
	bool "NUBIA_SENSORS"
	depends on NUBIA_DRIVERS
	default n
	help
	  Say Y here if you don't want to enable NUBIA_SENSORS
if NUBIA_SENSORS
source drivers/nubia/sensors/Kconfig
endif
endif

#source more controled by switches
if NUBIA_TOUCHSCREENS
source "drivers/nubia/touch/Kconfig"
endif

if NUBIA_NFC
source "drivers/nubia/nfc/Kconfig"
endif

if NUBIA_FINGERPRINT
source "drivers/nubia/fingerprint/Kconfig"
endif

endmenu
```

## drivers/nubia/fingerprint/Kconfig
```kconfig
################################################# FINGER_PRINTER START
config  NUBIA_SENSORS_FP
	tristate "NUBIA FP DEVICE"
	default n

if NUBIA_SENSORS_FP

config NUBIA_FP_AUTODETECT
	tristate "nubia fingerprint autodetect"
	depends on NUBIA_SENSORS_FP
	default n
	help
	  If you say yes here you, will enable fingerprint
	  autodetect function.

################################################# FINGER_PRINTER_GF318M START
source drivers/nubia/fingerprint/gf318m/Kconfig
choice
        prompt "choose the GF318M device style"
        depends on NUBIA_SENSORS_FP_GF318M
		default NUBIA_SENSORS_FP_GF318M_PLATFORM
		help
		  GF318M need to select the work style

config NUBIA_SENSORS_FP_GF318M_SPI
        bool "GF318M work as SPI device"
        help
          If you want GF318M work as SPI device, select it.

config NUBIA_SENSORS_FP_GF318M_PLATFORM
        bool "GF318M work as PLATFORM device"
        help
          If you want GF318M work as PLATFORM device, select it.

endchoice
################################################# FINGER_PRINTER_GF318M END

################################################# FINGER_PRINTER_FPC1020 START
source drivers/nubia/fingerprint/fpc1020/Kconfig
choice
        prompt "choose the FPC1020 device style"
        depends on NUBIA_SENSORS_FP_FPC1020
		default NUBIA_SENSORS_FP_FPC1020_PLATFORM
		help
		  FPC1020 need to select the work style

config NUBIA_SENSORS_FP_FPC1020_SPI
        bool "FPC1020 work as SPI device"
        help
          If you want FPC1020 work as SPI device, select it.

config NUBIA_SENSORS_FP_FPC1020_PLATFORM
        bool "FPC1020 work as PLATFORM device"
        help
          If you want FPC1020 work as PLATFORM device, select it.

endchoice
################################################# FINGER_PRINTER_FPC1020 END

################################################# FINGER_PRINTER_GF3208 START
source drivers/nubia/fingerprint/gf3208/Kconfig
choice
        prompt "choose the GF3208 device style"
        depends on NUBIA_SENSORS_FP_GF3208
		default NUBIA_SENSORS_FP_GF3208_PLATFORM
		help
		  GF3208 need to select the work style

config NUBIA_SENSORS_FP_GF3208_SPI
        bool "GF3208 work as SPI device"
        help
          If you want GF3208 work as SPI device, select it.

config NUBIA_SENSORS_FP_GF3208_PLATFORM
        bool "GF3208 work as PLATFORM device"
        help
          If you want GF3208 work as PLATFORM device, select it.

endchoice
################################################# FINGER_PRINTER_GF3208 END

################################################# FINGER_PRINTER_GF5216M START
source drivers/nubia/fingerprint/gf5216m/Kconfig
choice
        prompt "choose the GF5216M device style"
        depends on NUBIA_SENSORS_FP_GF5216M
        default NUBIA_SENSORS_FP_GF5216M_PLATFORM
        help
           GF5216M need to select the work style

config NUBIA_SENSORS_FP_GF5216M_SPI
        bool "GF5216M work as SPI device"
        help
          If you want GF5216M work as SPI device, select it.

config NUBIA_SENSORS_FP_GF5216M_PLATFORM
        bool "GF5216M work as PLATFORM device"
        help
          If you want GF5216M work as PLATFORM device, select it.

endchoice
################################################# FINGER_PRINTER_GF5216M END
endif
```

## drivers/nubia/leds/Kconfig
```kconfig
config NUBIA_LED_AW2013
	tristate "aw2013 leds"
	default n
	help
	  Enable aw2013, which will selcted when aw2013 leds connected
```

## drivers/nubia/nfc/BCM2079X/Kconfig
```kconfig
#
# Near Field Communication (NFC) devices
#

config NUBIA_NFC_BCM2079X
	tristate "BCM2079X NFC driver"
	depends on I2C
	default n
	---help---
	  Say yes if you want BCM20791 Near Field Communication driver.
	  This is for i2c connected version. If unsure, say N here.

	  To compile this driver as a module, choose m here. The module will
	  be called bcm2079x.
```

## drivers/nubia/nfc/Kconfig
```kconfig
#
# Near Field Communication (NFC) devices
#

source "drivers/nubia/nfc/BCM2079X/Kconfig"
```

## drivers/nubia/nubia_typec/Kconfig
```kconfig
menu "NUBIA_TYPEC_CHIP"
config NUBIA_TYPEC_FUSB301
	tristate "Integrated Circuits FAIRCHILD USB TYPE C"
	depends on I2C
	help
	   support usb type c.

config NUBIA_TYPEC_PTN5150
	tristate "Integrated Circuits NXP USB TYPE C"
	depends on I2C
	help
	   support usb type c.

config NUBIA_TYPEC_TUSB320
	tristate "Integrated Circuits TI USB TYPE C"
	depends on I2C
	help
	   support usb type c.

config NUBIA_TYPEC_PI5U
	tristate "Integrated Circuits PERICOM USB TYPE C"
	depends on I2C
	help
	   support usb type c.
endmenu
```

## drivers/nubia/sensors/Kconfig
```kconfig
################################################# SENROS LOG
config FEATURE_NUBIA_SENSORS_LOG_ON
	tristate "NUBIA SENSORS LOG_ON"
	depends on NUBIA_SENSORS
	default n
	help
		Say Y here if you want to enable sensor log
################################################# PROX START
config NUBIA_SENSORS_PROX_PA224
	tristate "support litehole prox sensor driver"
	depends on NUBIA_SENSORS
	default n
	help
		nubia prox device of pa224
################################################# PROX START
config NUBIA_SENSORS_PROX_PA22X
	tristate "support litehole prox sensor driver"
	depends on NUBIA_SENSORS
	default n
	help
		nubia prox device of pa22x
################################################# AMS START
config NUBIA_SENSORS_TMD2725
	tristate "support litehole light/prox sensor driver"
	depends on NUBIA_SENSORS
	default n
	help
		nubia ambient&&prox device of tmd2725
################################################# PROX_ALS START
config NUBIA_SENSORS_ALS_PROX_ADSP9922
	tristate "support  als_ps adsp9922 sensor driver"
	depends on NUBIA_SENSORS
	default n
	help
		nubia prox device
################################################# RGB START
config NUBIA_SENSORS_RGB_BH1745
	tristate "support rgb bh1745 driver"
	depends on NUBIA_SENSORS
	default n
	help
		nubia rgb device

################################################# PRESSURE_DEVICE START
config NUBIA_SENSORS_PRESSURE_DEVICE
	tristate "support pressure device driver"
	depends on NUBIA_SENSORS
	default n
	help
		nubia pressure device

################################################# HALL START
config NUBIA_SENSORS_HALL_DEVICE
	tristate "hall devicedriver"
	depends on NUBIA_SENSORS
	default n
	help
	  If you say yes here you get support for
	  hall device
################################################# IR REMOTE START
config NUBIA_SENSORS_IR_REMOTE_I_THREE
	tristate "I_THREE device driver"
	depends on NUBIA_SENSORS
	default n
	help
	  If you say yes here you get support for UEI's
	  IR Remote control i_three
```
